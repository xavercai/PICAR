/* 
 * 【v8.9-chaos-v4 卡死检测逻辑】这是一个全面贯彻了进化逻辑的代码版本，存储功能也得以实现，因此被命名为OEETestFinal版本时间2026年8月15日17时10分
 * 版本： v8.8-oe-stuck-fixed (修复编译错误) 本版本可以烧录，但是存在死锁，电机永远无法启动，因此废弃。
 ================================================================ 
 * 项目名称：仿草履虫应激机制 - 脱困能力进化系统 
 * 版本： v8.5-fixed (V80行为对齐: normalize阈值/isClear/变异率/COND_IDLE)
 * 适配日期: 2026-08-09   修正日期: 2026-08-10
 * ================================================================ 
 * 烧录成功，系统启动，但是Web显示一切正常，但是解锁后，电机没有响应，LED也不闪烁  烧录成功，系统启动
 * ================================================================
 * SPIFFS 冲突根因说明（ESP32 架构限制）
 * ================================================================
 * 
 * ESP32 只有一片 SPI Flash，同时承担三个角色：
 *   1. 程序代码存储（通过 Cache 执行）
 *   2. SPIFFS 文件系统存储
 *   3. WiFi 协议栈固件存储
 * 
 * 当 SPIFFS 执行页擦除/编程时，Flash 控制器禁用 Cache → 所有
 * 从 Flash 执行的代码（包括 WiFi 中断处理）被暂停。这是硬件级
 * 限制，无法完全消除，但本文件通过以下措施将冲突降到最低：
 * 
 *   - SPIFFS 在 WiFi 之前初始化（setup() 中顺序保证）
 *   - 编码器 ISR 标记 IRAM_ATTR + GPIO寄存器直读（在 RAM 中执行，不被 Flash 写入阻塞）
 *   - 使用原子写入策略（临时文件 + 重命名，避免写入中断导致文件损坏）
 *   - 写入仅在个体死亡时触发（forceSave），非逐帧写入
 *   - 帧日志 CSV 仅在个体测试结束时一次性导出
 *   - 噪声源使用 GPIO35（仅输入 ADC1，不与 Flash SPI 总线共享引脚）
 * 
 * 已知残余风险（可接受）：
 *   - SPIFFS 写入期间 WiFi 可能丢包（~10-50ms 级别），不影响 AP 连接
 *   - Flash 写入时 ADC 读数可能有轻微噪声（电源纹波），但传感器
 *     使用多次采样基准值校准，单次噪声不影响决策
 *   - 如果 SPIFFS 空间耗尽（极罕见），doAtomicWrite 失败 → 数据丢失
 *     → 但 buffer 已清空，不会 OOM（#37 修复）
 * ================================================================ 
 * 
 * ================================================================
 * 【修正汇总】2026-08-10 移植自 v5.9 MotorDriver 电机增益控制逻辑
 * ================================================================
 * 
 * 一、电机增益移植（全局生效）
 * ───────────────────────────────────────────
 * 1. 新增宏 LEFT_GAIN=1.00f / RIGHT_GAIN=1.25f，补偿右电机机械偏弱
 * 2. 新增 writeMotorHardware() 统一入口函数，所有电机 PWM 写入必须
 *    经过此函数，确保增益补偿全局零死角生效
 * 3. 将 analogWrite() 全部替换为 ledcWrite()，匹配 AT8236 驱动芯片
 *    （ledcAttach 5kHz/8bit，在 init() 中初始化）
 * 4. 替换范围覆盖全部 6 个调用点共 10 次写入：
 *    - stopMotors()        → writeMotorHardware(0, 0)
 *    - backwardReset()     → writeMotorHardware(100, 100)
 *    - update()            → writeMotorHardware(currentSpeedL, currentSpeedR)
 *    - executeRecovery()   → writeMotorHardware(...) ×4 次
 *    - updateChaos()       → writeMotorHardware(randSpeedL, randSpeedR)
 * 
 * 二、漏洞修复
 * ───────────────────────────────────────────
 * 5. [修复] 右编码器 ISR 空函数体 → 实现正交解码（B相判断方向）
 * 6. [修复] 左编码器 ISR 仅做 distanceTicks++ → 实现正交解码（区分正反转）
 * 7. [修复] 混沌期间 lastMoveTime 不更新 → writeMotorHardware() 每次写入
 *    自动更新 lastMoveTime，endChaos() 脱困判定现已可靠
 * 
 * 三、附带修复
 * ───────────────────────────────────────────
 * 8. [修复] 删除 lastChaosTime 重复声明（原行 779-780 重复定义）
 * 9. [标注] SPINNING_STUCK_* 三个宏标注为 [预留]（当前未实现旋转卡死检测）
 * 10.[标注] EvolutionEngine 静态访问方式添加注释说明
 * 
 * 四、实车校准注意事项
 * ───────────────────────────────────────────
 * - RIGHT_GAIN=1.25 为预设值，需通过编码器校准工具（源文件
 *   CalibrationTool::calibrateGain()）实测左右轮脉冲差值后修正
 * - 增益后 backwardReset() 中右轮 PWM 略大（125 vs 100），
 *   后退复位可能产生轻微弧线，若场地空间受限可调低 RIGHT_GAIN
 * - 若更换电机或齿轮箱，需重新校准 LEFT_GAIN / RIGHT_GAIN
 * 
 * ================================================================
 * 【修正汇总】2026-08-10 时序与存储系统修复
 * ================================================================
 * 
 * 五、SPIFFS + WiFi 时序冲突修复
 * ───────────────────────────────────────────
 * 11.[致命] RobustStorage::init() 从未被调用 → 在 setup() 中新增调用，
 *    SPIFFS 在 WiFi 之前初始化，避免 Flash 操作与 WiFi 中断冲突
 * 12.[修复] loadHistory() 不存在 → 由 RobustStorage::init() 内部调用
 *    loadHistoryToRAM() 替代
 * 13.[修复] SAVE_INTERVAL_MS 未定义 → 改为 RobustStorage::tick()（内部
 *    使用 STORAGE_SAVE_INTERVAL_MS）
 * 14.[修复] flushIfNeeded() 不存在 → 改为 RobustStorage::tick()
 * 15.[修复] LOOP_DELAY_MS 未定义 → 新增宏定义为 10ms
 * 16.[修复] SensorCalibration::init() 不存在 → 改为 calibrate()
 * 17.[修复] Logger::getRecentLogs() 不存在 → 新增 stub 实现
 * 18.[修复] RobustStorage::clearAll() 不存在 → 新增实现（清除 Flash 文件
 *    及 RAM 缓冲区）
 * 
 * 六、倒车重置时序修复
 * ───────────────────────────────────────────
 * 19.[修复] backwardReset() 双重调用 → loop() 中删除重复的
 *    MotorController::backwardReset()，因为 endCurrentTest() 内部已调用，
 *    避免 5 秒双重阻塞冻结
 * 
 * ================================================================
 * 【修正汇总】2026-08-10 混沌脱困物理姿态修复
 * ================================================================
 * 
 * 七、物理噪声源与随机方向
 * ───────────────────────────────────────────
 * 20.[新增] PIN_NOISE_SOURCE (GPIO6) 悬空ADC引脚，利用半导体热噪声
 *    生成真随机数熵源（移植自 v5.9 的物理随机变异源设计）
 * 21.[新增] SensorCalibration::readNoise() 读取悬空引脚噪声值
 * 22.[新增] setup() 中 randomSeed(物理噪声) 播种随机数生成器
 * 
 * 八、混沌脱困后的物理姿态（贴合生物学应激行为）
 * ───────────────────────────────────────────
 * 23.[新增] escapeRetreat()：混沌成功后，物理噪声源驱动随机方向后退
 *    500ms 逃离危险区域（0=直退, 1=后退左转, 2=后退右转）
 *    避免脱困后车头仍对着障碍物、立刻重新撞入
 * 24.[修复] 混沌脱困失败 → 立即调用 endCurrentTest() + nextIndividual()
 *    模拟"挣扎失败后放弃生命"，不再靠 recovery 苟活稀释进化压力
 * 
 * 九、个体切换时的物理姿态
 * ───────────────────────────────────────────
 * 25.[新增] randomTurn()：个体切换时，backwardReset 后增加物理噪声
 *    驱动的随机原地转向 500ms（左转/右转），打破前任的死亡姿态
 *    ，确保新个体从不同方向出发探索
 * 
 * ================================================================
 * 【修正汇总】2026-08-10 基因表达与数据记录修复
 * ================================================================
 * 
 * 十、死基因激活
 * ───────────────────────────────────────────
 * 26.[修复] chaos_threshold 死基因 → detectDilemma() 中 collisionCount
 *    现在与基因 chaos_threshold 比较，而非硬编码 COLLISION_THRESHOLD=8
 *    （行 1160）。基因值范围 2-20，越小越敏感越早触发混沌
 * 27.[修复] preferred_action 死基因 → update() 畅通时根据偏好注入偏向：
 *    0=直行(无偏向), 1=左转(右轮+25%), 2=右转(左轮+25%)
 *    （行 1097-1102）。使偏好动作真正影响小车探索行为
 * 28.[新增] MotorController::setPreferredAction() + 静态成员
 *    preferred_action，在 applyGeneToMotor() 中传递（行 1005/741）
 * 
 * 十一、逐帧动作日志系统
 * ───────────────────────────────────────────
 * 29.[新增] FrameLogEntry 结构体：每帧记录时间戳、传感器值、电机PWM、
 *    方向、混沌状态、困境类型，共 10 字节/帧（行 264-278）
 * 30.[新增] 256 帧环形缓冲区（FRAME_LOG_SIZE），覆盖约 2.5 秒
 * 31.[新增] logFrame()：每帧在 update() 末尾采集传感器+电机状态
 * 32.[新增] flushFrameLogToFlash()：个体测试结束时导出 CSV 到 SPIFFS
 *    文件名格式 /frm_g{代}_i{个体}.csv
 * 33.[新增] startFrameLog() / getFrameLogSummary() 配套方法
 * 
 * ================================================================
 * 【修正汇总】2026-08-10 存储链路完整性修复
 * ================================================================
 * 
 * 十二、存储流断链与硬件冲突修复
 * ───────────────────────────────────────────
 * 34.[致命] GPIO6 与 Flash SPI CLK 总线冲突 → 改为 GPIO35（仅输入
 *    ADC1 引脚，悬空安全，不与 Flash 总线共享）
 * 35.[修复] 快速死亡个体数据丢失 → endCurrentTest() 中 addRecord()
 *    后追加 forceSave()，确保每个个体死亡时数据立即持久化
 * 36.[修复] 混沌脱困失败时 Web 冻结 5.5 秒 → endChaos() 失败分支
 *    不再调用 nextIndividual()，改为设置 pendingTransition 标志，
 *    由 loop() 在 handleClient() 之后处理，Web 不再被阻塞
 * 37.[修复] flushBuffer() 失败时 buffer 无限增长 → 3 次重试失败后
 *    清空 pendingBuffer 和 unsavedCount，防止内存溢出
 * ================================================================
 * 混沌脱困 → 物理姿态 行为流程图
 * ================================================================
 * 
 *  start() 释放个体
 *    │
 *    ▼
 *  正常行走 ──→ 困境检测 ──→ 触发混沌
 *                                │
 *                      ┌─────────┴─────────┐
 *                      ▼                   ▼
 *                混沌成功脱困          混沌脱困失败
 *                      │                   │
 *                      ▼                   ▼
 *           escapeRetreat()          立即死亡
 *           物理噪声 → 随机方向       endCurrentTest()
 *           ┌───┬───┬───┐            +pendingTransition
 *           │直退│左转│右转│                │
 *           └───┴───┴───┘            loop() 下一轮
 *                后退500ms               │
 *                车头已转向           handleClient() OK
 *                      │                   │
 *                      ▼                   ▼
 *              继续正常行走          nextIndividual()
 *                                    backwardReset()
 *                                    randomTurn()
 *                                          │
 *                                          ▼
 *                                   新个体从随机方向出发
 * ================================================================
 * 遗传数据流图
 * ================================================================
 * 
 * ┌─ 5 个可遗传基因 ─────────────────────────────────────────┐
 * │                                                          │
 * │  k_turn          → 避障转向幅度 (update 中叠加)          │
 * │  speed_bias      → 直行速度     (update 中 targetSpeed)   │
 * │  chaos_threshold → 混沌敏感度   (detectDilemma 碰撞判定)  │
 * │  recovery_mode   → 脱困策略     (executeRecovery switch)  │
 * │  preferred_action→ 探索偏向     (update 畅通时注入)       │
 * │                                                          │
 * └──────────────────────────────────────────────────────────┘
 *                            │
 *       个体测试结束 ──→ endCurrentTest()
 *                            │
 *                ┌───────────┴───────────┐
 *                ▼                       ▼
 *          聚合统计记录              逐帧动作日志
 *        (HistoryRecord)            (FrameLogEntry)
 *                │                       │
 *                ▼                       ▼
 *        addRecord() → 缓冲区      环形缓冲区 256帧
 *                │                       │
 *                ▼                       ▼
 *        定时 flushBuffer()       flushFrameLogToFlash()
 *        → /history.csv           → /frm_g{代}_i{个体}.csv
 *                │                       │
 *                └───────────┬───────────┘
 *                            ▼
 *                       SPIFFS Flash
 *                            │
 *        ┌───────────────────┼───────────────────┐
 *        ▼                                       ▼
 *   下一代 evolve()                      Web 导出查看
 *   精英保留 + 锦标赛选择                /api/history
 *   + 均匀交叉 + 变异                    /api/framelog
 * ================================================================
 */
/* 
 * ================================================================ 
 * 项目名称：仿草履虫应激机制 - 脱困能力进化系统 
 * 版本： v7.3-fixed-v2 (编译错误全面修复)
 * 适配日期: 2026-08-09   修正日期: 2026-08-11
 * ================================================================ 
 *
 * ================================================================
 * 【修正汇总】2026-08-11 编译错误全面修复 (v7.3-fixed → v7.3-fixed-v2)
 * ================================================================
 * 
 * 一、致命编译错误修复
 * ───────────────────────────────────────────
 * 1. [致命] EvolutionEngine 类设计为实例类，但代码中全部以静态方式调用
 *    → 重构为单例+静态包装模式：添加 static instance 成员，所有公有方法
 *      改为静态包装（调用 instance.implXxx()），新增公有访问器方法
 *    → 影响范围：MotorController::endChaos()、CarWebServer 全部路由、
 *      setup()、loop() 中共 30+ 处调用点
 * 
 * 2. [致命] ledcAttach(pin, freq, bits) 三参数函数不存在 (ESP32 Arduino 标准库)
 *    → 拆分为 ledcSetup(chan, freq, bits) + ledcAttachPin(pin, chan)
 *    → 新增 LEDC_CHANNEL_LEFT=0, LEDC_CHANNEL_RIGHT=1 宏定义
 * 
 * 3. [致命] ledcWrite 参数应为通道号，非引脚号
 *    → 全部 ledcWrite(PIN_xxx, val) 改为 ledcWrite(LEDC_CHANNEL_xxx, val)
 *    → 影响范围：writeMotorHardware()、init() 中共 4 处
 * 
 * 4. [致命] case 2: 中声明 int dir 跨越初始化
 *    → 加花括号 case 2: { int dir = ...; ... break; }
 * 
 * 5. [致命] PIN_NOISE_SOURCE 宏重复定义 (GPIO6 vs GPIO35)
 *    → 删除 GPIO6 的定义（与 Flash SPI CLK 总线冲突），仅保留 GPIO35
 *    → 修正注释：PIN_NOISE_SOURCE 不再标注为 GPIO6
 * 
 * 二、编译警告/运行时错误修复
 * ───────────────────────────────────────────
 * 6. [修复] isClear() 函数体内有不可达代码（第二个 return 永远不执行）
 *    → 删除重复的 return 语句，清理函数体
 * 
 * 7. [修复] server.on("/status", handleStatus) 重复注册两次
 *    → 删除重复行，避免运行时崩溃
 * 
 * 8. [修复] 缺少 <cstdio> 头文件（vsnprintf 依赖）
 *    → 添加 #include <cstdio>
 * 
 * 9. [修复] CarWebServer 直接访问 MotorController 的 private 静态成员
 *    → 新增 public getter: getCurrentSpeedL(), getCurrentSpeedR(),
 *      isChaosActive(), getCurrentDilemma()
 * 
 * 10.[修复] CarWebServer 直接访问 EvolutionEngine 的 private 成员
 *    → EvolutionEngine 重构后已有 public 静态访问器方法
 * ================================================================
 *
 * ================================================================
 * v8.0 — 物理结构即算法 开放式进化重构 (2026-08-11)
 * ================================================================
 * 
 * 设计哲学: 从"目标导向优化"转向"行为多样性探索"
 * ───────────────────────────────────────────
 * v7.3 本质是经典遗传算法(GA): 固定适应度函数 → 精英保留 → 收敛到最优。
 * v8.0 将三个维度同时改造，使系统真正检验"物理结构能否涌现智能行为":
 *   - 进化不再预设"什么是好"（取消适应度函数）
 *   - 物理身体不再只是"执行器"（参与决策和计时）
 *   - 行为不再由程序员硬编码（进化可以发明策略）
 * 
 * ================================================================
 * 维度一: Novelty Search 新奇度驱动进化
 * ================================================================
 * 
 * 核心思想: 不问"谁表现好"，问"谁的行为是档案里没见过的"
 * 
 * 行为描述符 (BehaviorDescriptor, 12维):
 * ┌─────────────────────────────────────────────────────────────┐
 * │ 传感器维度(4): 左均值/右均值/方差/不对称度                  │
 * │ 运动维度(4):   平均速度/速度方差/转向偏向/总距离            │
 * │ 策略维度(4):   直行占比/转向占比/后退占比/静止占比          │
 * └─────────────────────────────────────────────────────────────┘
 * 
 * 新奇度计算:
 *   个体测试结束 → 帧日志提取行为描述符 → 归一化 →
 *   计算到档案中 k=5 个最近邻的平均欧氏距离 → 新奇度得分
 *   新奇度 > 阈值(0.15) → 加入档案 (最多200条)
 * 
 * 新奇度档案 (NoveltyArchive):
 *   - 存储历史行为描述符，驱动进化向行为空间未探索区域扩展
 *   - 自动归一化: 跟踪各维度历史最大值，新描述符动态归一化
 *   - 环形淘汰: 档案满时替换最旧条目
 * 
 * 选择机制变换:
 *   旧: fitness排序 → 精英保留前25% → 锦标赛选fitness高的
 *   新: novelty排序 → 精英保留前25% → 锦标赛选novelty高的
 * 
 * 自适应变异率:
 *   新奇度停滞(avg < best*0.5) → 加大变异率 → 探索新行为空间
 *   新奇度健康(avg > best*0.8) → 降低变异率 → 精细调整
 * 
 * 预期效果:
 *   - 不再奖励"活得久但行为平庸"的个体
 *   - 自然涌现多样性: "撞墙专家""旋转专家""贴墙走专家"
 *   - 不需要预设什么是"好"行为 — 系统自己发现行为空间
 * 
 * ================================================================
 * 维度二: 物理结构承担计算
 * ================================================================
 * 
 * 核心思想: 物理身体不再只是"执行PWM指令的被动执行器"，
 *           而是参与决策、计时和运动平滑的计算主体
 * 
 * 2.1 物理终止条件 (physicsTerminatedAction)
 * ───────────────────────────────────────────
 * 旧: 所有动作使用固定 delay(ms) 计时
 *    executeRecovery case0: delay(500)
 *    executeRecovery case1: delay(800)
 *    escapeRetreat:        while(millis()-start<500)
 *    backwardReset:        delay(2500)
 * 
 * 新: 动作持续时间由物理现实决定
 *    physicsTerminatedAction(pwm, dir, minDuration):
 *      每10ms检测编码器增量 → 连续10帧编码器不动 = 物理已停止
 *      → 动作自动终止
 *      → 安全兜底: 最多3秒
 * 
 * 物理含义:
 *   - 电机扭矩大的个体 → 后退时间短 → 物理决定了动作时长
 *   - 摩擦力大的地面 → 自然延长动作 → 环境参与决策
 *   - 齿轮箱磨损 → 不同个体表现不同 → 物理的"个性"
 * 
 * 2.2 噪声连续调制 (Noise Modulation)
 * ───────────────────────────────────────────
 * 旧: GPIO35 仅用于 randomSeed() 一次性播种
 * 新: 每帧读取 GPIO35，调制所有行为参数
 * 
 *   噪声调制因子 = 0.7 + 噪声(0~0.999) * 0.6 → 范围 0.7~1.3
 *   调制对象:
 *     - 规则电机PWM: motorL *= noiseMod
 *     - 规则持续时间: durationMs *= noiseMod
 *     - 实际转向幅度: 基因决定基础值 + 噪声波动 ±30%
 * 
 * 物理含义:
 *   - 同一基因在不同时刻表现不同行为
 *   - 两个基因完全相同的个体，因噪声采样时间序列不同而行为分化
 *   - 创造"同一基因型 → 多种表现型"的物理涌现条件
 * 
 * 2.3 脉冲式控制 (Impulse Control)
 * ───────────────────────────────────────────
 * 旧: 逐帧平滑过渡
 *    currentSpeed = min(currentSpeed+MAX_SPEED_CHANGE_PER_FRAME, target)
 * 
 * 新: 直接施加目标 PWM，不做代码级平滑
 *    currentSpeed = targetSpeed
 *    writeMotorHardware(currentSpeedL, currentSpeedR)
 * 
 * 物理含义:
 *   - 速度变化曲线由物理系统决定: 电机电感响应时间、齿轮箱惯性、
 *     轮胎摩擦力 — 这些是代码不可控的物理变量
 *   - 不同电机老化程度 → 不同响应曲线 → 物理的"个性"
 *   - 代码不再"手工平滑" — 物理自己完成
 * 
 * ================================================================
 * 维度三: 可变长度行为表基因
 * ================================================================
 * 
 * 核心思想: 从"调5个参数"变为"进化可以发明行为规则"
 * 
 * 旧基因型 (5个固定参数):
 *   k_turn, speed_bias, chaos_threshold, recovery_mode, preferred_action
 *   → 只能调参，不能改变行为逻辑结构
 * 
 * 新基因型 (BehaviorRule 表):
 *   struct BehaviorRule {
 *     condType:   传感器/距离/时间/空闲/无条件 (8种)
 *     condValue:  阈值 (-3000~3000)
 *     condOp:     > / < / ==
 *     motorL:     左电机PWM (-255~255, 负=反转)
 *     motorR:     右电机PWM
 *     durationMs: 持续时间 (物理终止条件下限)
 *     nextRule:   0=重新评估, 1-N=跳转到指定规则
 *   };
 *   每个个体 2~16 条规则，规则数量本身可进化
 * 
 * 条件类型 (8种):
 * ┌──────────────────┬────────────────────────────────────┐
 * │ COND_SENSOR_LEFT │ 左传感器超过阈值                    │
 * │ COND_SENSOR_RIGHT│ 右传感器超过阈值                    │
 * │ COND_SENSOR_BOTH │ 两侧传感器都超过阈值                │
 * │ COND_SENSOR_ANY  │ 任一侧传感器超过阈值                │
 * │ COND_DISTANCE    │ 编码器距离超过阈值                  │
 * │ COND_TIME        │ 测试时间超过阈值                    │
 * │ COND_IDLE        │ 两侧传感器均低于阈值 (空闲)         │
 * │ COND_ALWAYS      │ 无条件触发                          │
 * └──────────────────┴────────────────────────────────────┘
 * 
 * 运行时行为表引擎:
 *   loop() 每帧:
 *     for 每条规则:
 *       if 条件满足:
 *         停止评估 → 执行该规则 → physicsTerminatedAction
 *         → 如果 nextRule>0: 跳转到指定规则继续执行
 *         → 否则: 重新评估条件
 *       → 没有规则匹配: 停止电机
 * 
 * 交叉: 随机切割点交叉
 *   父本1取前k1条规则，父本2取后k2条规则，k1、k2为随机数
 *   拼接后规则数约束在2~16之间，若不足则循环补齐
 * 
 * 变异 (10种操作):
 *   1. 微调condValue参数
 *   2. 微调motorL参数
 *   3. 微调motorR参数
 *   4. 微调durationMs参数
 *   5. 变更条件类型 (condType)
 *   6. 变更比较操作符 (condOp)
 *   7. 变更跳转目标 (nextRule)
 *   8. 增加一条规则 (ruleCount++)
 *   9. 删除一条规则 (ruleCount--)
 *  10. 交换两条规则顺序
 * 
 * 进化可以自发发现的策略示例:
 *   - "左传感器高时，右转随机角度前进" → 非程序员编码
 *   - "每3秒后退一次" → 自发涌现的探索节奏
 *   - "先左转200ms，如果传感器还高就右转400ms" → 多步策略链
 *   - "空闲时原地旋转寻找新方向" → 利用 COND_IDLE 条件
 * 
 * ================================================================
 * 新架构运行时数据流
 * ================================================================
 * 
 * setup():
 *   SPIFFS初始化 → 物理噪声播种 → 传感器校准 → 电机初始化
 *   → 进化引擎初始化(种群16个行为表基因) → Web控制台启动
 * 
 * loop():
 *   ┌─ 测试活跃? ─→ MotorController::update(gene)
 *   │                 │
 *   │                 ├─ 读取传感器 + 噪声
 *   │                 ├─ 行为表规则评估
 *   │                 │   ├─ 条件匹配 → 噪声调制参数 → 物理终止动作
 *   │                 │   └─ 无匹配 → 停止
 *   │                 └─ 记录帧日志
 *   │
 *   ├─ 测试超时? → endCurrentTest() → nextIndividual()
 *   │
 *   ├─ Web请求处理 (handleClient)
 *   │
 *   └─ 存储定时刷新 (RobustStorage::tick)
 * 
 * 个体测试结束 → endCurrentTest():
 *   统计存活时间+距离 → 帧日志提取行为描述符 →
 *   NoveltyArchive::computeNovelty() → 加入档案 →
 *   记录历史 → 帧日志CSV导出 → 检查是否新纪录
 * 
 * 一代结束 → evolve():
 *   按新奇度排序 → 精英保留 → 新奇度锦标赛选亲本 →
 *   规则子集交叉 → 变异 → 自适应变异率 → 下一轮
 * 
 * 数据持久化:
 *   /oe_history.csv: 每代每个体的新奇度+存活+距离+规则数
 *   /frm_g{代}_i{个体}.csv: 256帧逐帧传感器+电机日志
 * 
 * ================================================================
 * 与旧版(v7.3)关键差异对照
 * ================================================================
 * 
 * ┌──────────────────┬─────────────────────┬─────────────────────┐
 * │ 维度             │ v7.3 (经典GA)       │ v8.0 (物理即算法)   │
 * ├──────────────────┼─────────────────────┼─────────────────────┤
 * │ 进化目标         │ 最大化适应度        │ 探索行为多样性      │
 * │ 选择依据         │ 存活+距离+脱困      │ 新奇度(行为距离)    │
 * │ 基因型           │ 5个固定参数         │ 2~16条行为规则      │
 * │ 行为来源         │ 程序员硬编码        │ 进化产生IF-THEN表   │
 * │ 动作计时         │ 固定delay(ms)       │ 编码器物理终止      │
 * │ 速度控制         │ 逐帧平滑过渡        │ 脉冲式+物理惯性     │
 * │ 噪声角色         │ 仅播种随机数        │ 连续调制所有参数    │
 * │ 物理身体角色     │ 被动执行器          │ 参与决策+计时+平滑  │
 * │ 精英保留         │ fitness前25%        │ novelty前25%        │
 * │ 混沌/恢复/困境   │ 硬编码case分支      │ 行为表规则替代      │
 * │ 适应度停滞       │ 加大变异→收敛       │ 加大变异→探索新区间 │
 * └──────────────────┴─────────────────────┴─────────────────────┘
 * ================================================================ */

/*
 * ================================================================ 
 * 项目名称：仿草履虫应激机制 - 脱困能力进化系统 
 * 版本： v8.0-fixed (LEDC修复 + abs类型修复)
 * ================================================================ 
 */

/*
 * ================================================================ 
 * 项目名称：仿草履虫应激机制 - 脱困能力进化系统 
 * 版本： v8.1-fixed (循环引用修复 + LEDC包含)
 * ================================================================ 
 */

/*
 * ================================================================ 
 * 项目名称：仿草履虫应激机制 - 脱困能力进化系统 
 * 版本： v8.2-fixed (LEDC修复 + 循环引用彻底解决)
 * ================================================================ 
 */


/*
 * ================================================================ 
 * 项目名称：仿草履虫应激机制 - 脱困能力进化系统 
 * 版本： v8.0-fixed (编译错误全面修复)
 * 适配日期: 2026-08-11   修正日期: 2026-08-12
 * ================================================================ 
 * 由于ESP32 Arduino环境可能不支持 ledcSetup，使用最兼容的方式 - 使用 ledcAttach 函数（这是ESP32 Arduino早期版本就支持的)
 
 */

/* 
 * ================================================================ 
 * 项目名称：仿草履虫应激机制 - 脱困能力进化系统 
 * 版本： v8.0-final (完整修复版)
 * 适配日期: 2026-08-12
 * ================================================================ 
 * 
 * 设计哲学: 从"目标导向优化"转向"行为多样性探索"
 * - Novelty Search 新奇度驱动进化
 * - 物理结构承担计算 (物理终止条件 + 噪声连续调制)
 * - 可变长度行为表基因 (2~16条IF-THEN规则)
 * ================================================================ 
 */

/* 
 * ================================================================ 
 * 项目名称：仿草履虫应激机制 - 脱困能力进化系统 
 * 版本： v8.0-final (完整可用版)
 * 适配日期: 2026-08-12
 * ================================================================ 
 * 
 * 设计哲学: Novelty Search 新奇度驱动进化 + 行为表基因
 * ================================================================ 
 */

/* 
 * ================================================================ 
 * 项目名称：仿草履虫应激机制 - 脱困能力进化系统 
 * 版本： v8.0-final (完整可用版)
 * 适配日期: 2026-08-12
 * ================================================================ 
 * 
 * 设计哲学: Novelty Search 新奇度驱动进化 + 行为表基因
 * ================================================================ 
 */

/* 
 * ================================================================ 
 * 项目名称：仿草履虫应激机制 - 脱困能力进化系统 
 * 版本： v8.0-final (完整可用版)
 * 适配日期: 2026-08-12
 * ================================================================ 
 * 
 * 设计哲学: Novelty Search 新奇度驱动进化 + 行为表基因
 * ================================================================ 
 */

/* 
 * ================================================================ 
 * 项目名称：仿草履虫应激机制 - 脱困能力进化系统 
 * 版本： v8.5-final (轮询编码器方案)
 * ================================================================ 
 */

/* 
 * ================================================================ 
 * 项目名称：仿草履虫应激机制 - 脱困能力进化系统 
 * 版本： v8.5-final (ESP32兼容LEDC)
 * ================================================================ 
 */

/*
 * ================================================================ 
 * 项目名称：仿草履虫应激机制 - 脱困能力进化系统 
 * 版本： v8.5-final (SPIFFS已禁用)
 * 适配日期: 2026-08-12
 * ================================================================ 
 * 
 * SPIFFS已被禁用 - 所有数据仅保存在RAM中
 * 如需持久化数据，请取消注释SPIFFS相关代码并重新格式化Flash
 * ================================================================ 
 */

/* 
 * ================================================================ 
 * 项目名称：仿草履虫应激机制 - 脱困能力进化系统 
 * 版本： v8.6-nonblocking (非阻塞状态机重构)
 * 适配日期: 2026-08-13
 * ================================================================ 
 * 
 * 【重要更改】2026-08-13 非阻塞状态机重构
 * ================================================================
 * 
 * 一、根因修复：RTC看门狗复位 (rst:0x10)
 * ───────────────────────────────────────────
 * 问题：physicsTerminatedAction() 内部使用 while(1) + delay()
 *       最长阻塞 3 秒，期间不喂狗 → 触发 RTCWDT_RTC_RST
 * 
 * 修复：重构为非阻塞状态机
 *   - physicsTerminatedAction() → startPhysicsAction() + updatePhysicsAction()
 *   - startPhysicsAction(): 设置电机并记录起始状态
 *   - updatePhysicsAction(): 每帧调用，检测编码器停滞 → 自动终止
 *   - loop() 中每帧调用 updatePhysicsAction()
 * 
 * 二、移除所有阻塞 delay()
 * ───────────────────────────────────────────
 *   - physicsTerminatedAction() 中的 while 循环已移除
 *   - 所有动作现在由状态机驱动，不阻塞主循环
 *   - Web 控制台在动作执行期间保持响应
 * 
 * 三、新增接口
 * ───────────────────────────────────────────
 *   - MotorController::isActionInProgress(): 查询是否有物理动作正在执行
 *   - MotorController::updatePhysicsAction(): 状态机更新，需在 loop() 中调用
 *   - MotorController::forceStopAction(): 强制终止当前动作
 * 
 * 四、修复类型错误
 * ───────────────────────────────────────────
 *   - setMotor(int pwm, bool isLeft, bool forward) 第三个参数是 bool forward
 *   - 之前调用 setMotor(leftPWM, true, dirL) 正确，但 dirL 含义需明确
 *   - 新增 getMotorDirection() 辅助函数统一处理
 * ================================================================ 
 */

/* 
 * ================================================================ 
 * 项目名称：仿草履虫应激机制 - 脱困能力进化系统 
 * 版本： v8.5-final (SPIFFS已禁用)
 * 适配日期: 2026-08-12
 * ================================================================ 
 * 
 * SPIFFS已被禁用 - 所有数据仅保存在RAM中
 * 如需持久化数据，请取消注释SPIFFS相关代码并重新格式化Flash
 * ================================================================ 
 */

/* 
 * ================================================================ 
 * 项目名称：仿草履虫应激机制 - 脱困能力进化系统 
 * 版本： v8.6.1-hardware-fixed (基于v8.6非阻塞状态机 + 硬件引脚/电机逻辑修复)
 * 适配日期: 2026-08-14
 * ================================================================ 
 * 
 * 【修复说明】2026-08-14 硬件电机控制逻辑全面修复
 * ================================================================
 * 
 * 基于 v5.9 已验证的 AT8236 电机驱动逻辑，修复以下问题：
 * 
 * 1. [致命] 左方向引脚 PIN_LEFT_DIR2 从 21 修正为 46
 * 2. [致命] 右方向引脚 PIN_RIGHT_DIR2 从 33 修正为 15
 * 3. [致命] 方向引脚未初始化为 LOW（停止状态）
 * 4. [致命] 方向控制与 PWM 控制分离，导致某些调用路径方向未设置
 * 5. [修复] setMotorSigned() 重写为 setMotorSpeed()，同时控制方向和PWM
 * 6. [修复] writeMotorHardware() 删除，统一使用 setMotorSpeed()
 * 7. [修复] stopMotors() 改为直接调用 setMotorSpeed(0, 0)
 * 8. [修复] 所有电机控制调用点统一使用 setMotorSpeed()
 * 9. [修复] 右电机正反转方向与 v5.9 对齐
 * ================================================================ 
 */

/*
 * ================================================================ 
 * 项目名称：仿草履虫应激机制 - 脱困能力进化系统 
 * 版本： v8.5-final (SPIFFS已禁用)
 * 适配日期: 2026-08-12
 * ================================================================ 
 * 
 * SPIFFS已被禁用 - 所有数据仅保存在RAM中
 * 如需持久化数据，请取消注释SPIFFS相关代码并重新格式化Flash
 * ================================================================ 
 */

/* 
 * ================================================================ 
 * 项目名称：仿草履虫应激机制 - 脱困能力进化系统 
 * 版本： v8.6-nonblocking (非阻塞状态机重构)
 * 适配日期: 2026-08-13
 * ================================================================ 
 * 
 * 【重要更改】2026-08-13 非阻塞状态机重构
 * ================================================================
 * 
 * 一、根因修复：RTC看门狗复位 (rst:0x10)
 * ───────────────────────────────────────────
 * 问题：physicsTerminatedAction() 内部使用 while(1) + delay()
 *       最长阻塞 3 秒，期间不喂狗 → 触发 RTCWDT_RTC_RST
 * 
 * 修复：重构为非阻塞状态机
 *   - physicsTerminatedAction() → startPhysicsAction() + updatePhysicsAction()
 *   - startPhysicsAction(): 设置电机并记录起始状态
 *   - updatePhysicsAction(): 每帧调用，检测编码器停滞 → 自动终止
 *   - loop() 中每帧调用 updatePhysicsAction()
 * 
 * 二、移除所有阻塞 delay()
 * ───────────────────────────────────────────
 *   - physicsTerminatedAction() 中的 while 循环已移除
 *   - 所有动作现在由状态机驱动，不阻塞主循环
 *   - Web 控制台在动作执行期间保持响应
 * 
 * 三、新增接口
 * ───────────────────────────────────────────
 *   - MotorController::isActionInProgress(): 查询是否有物理动作正在执行
 *   - MotorController::updatePhysicsAction(): 状态机更新，需在 loop() 中调用
 *   - MotorController::forceStopAction(): 强制终止当前动作
 * 
 * 四、修复类型错误
 * ───────────────────────────────────────────
 *   - setMotor(int pwm, bool isLeft, bool forward) 第三个参数是 bool forward
 *   - 之前调用 setMotor(leftPWM, true, dirL) 正确，但 dirL 含义需明确
 *   - 新增 getMotorDirection() 辅助函数统一处理
 * ================================================================ 
 */

/* 
 * ================================================================ 
 * 项目名称：仿草履虫应激机制 - 脱困能力进化系统 
 * 版本： v8.5-final (SPIFFS已禁用)
 * 适配日期: 2026-08-12
 * ================================================================ 
 * 
 * SPIFFS已被禁用 - 所有数据仅保存在RAM中
 * 如需持久化数据，请取消注释SPIFFS相关代码并重新格式化Flash
 * ================================================================ 
 */

/*
 * ================================================================ 
 * 项目名称：仿草履虫应激机制 - 脱困能力进化系统 
 * 版本： v8.6.2-stable (SPIFFS启用 + 关键Bug修复)
 * 适配日期: 2026-08-14
 * ================================================================ 
 * 
 * 【修复说明】2026-08-14 三个关键问题修复
 * ================================================================
 * 
 * 修复1: 历史数据导出为空
 * ───────────────────────────────────────────
 * 问题: getCSVData() 从 pendingBuffer 读取，但数据被 flushBuffer() 清空
 * 修复: 改为从 ramHistory 数组构建 CSV，同时支持 SPIFFS 持久化
 * 
 * 修复2: 进化在第3个个体后停止
 * ───────────────────────────────────────────
 * 问题: stopMotors() 未重置 ruleActive 标志，导致后续个体无法匹配规则
 * 修复: stopMotors() 中增加 ruleActive = false
 * 
 * 修复3: 启用 SPIFFS 持久化存储
 * ───────────────────────────────────────────
 * 问题: 数据仅保存在RAM，重启丢失
 * 修复: 启用 SPIFFS，数据同时写入 Flash 和 RAM，双重保障
 * 
 * ================================================================ 
 * 
 * 硬件引脚: 基于 v5.9 已验证的 AT8236 电机驱动逻辑
 * 状态机: 基于 v8.6 非阻塞状态机
 * ================================================================ 
 */

/* 
 * ================================================================ 
 * 项目名称：仿草履虫应激机制 - 脱困能力进化系统 
 * 版本： v8.6.3-sensor-fixed (传感器校准修复版)
 * 适配日期: 2026-08-14
 * ================================================================ 
 * 
 * 【修复说明】2026-08-14 传感器-控制链路修复
 * ================================================================
 * 
 * 问题根因：
 *   1. 传感器校准值与原始值混用，导致行为表条件永远无法触发
 *   2. isClear() 中右传感器减了 leftBase 而非 rightBase
 *   3. 阈值定义与实际 GP2Y0A21 传感器输出范围不匹配
 *   4. 初始种群缺乏对传感器有反应的个体
 * 
 * 修复内容：
 *   A. SensorCalibration 类重构
 *      - getLeftRaw() / getRightRaw(): 返回原始ADC值
 *      - getLeftCalibrated() / getRightCalibrated(): 返回校准值
 *      - isObstacleLeft() / isObstacleRight(): 基于原始值判断
 *      - isClear(): 修复右传感器基准值错误
 * 
 *   B. 阈值重新定义
 *      - CLEAR_ADC_THRESH: 600 (无障碍物)
 *      - OBSTACLE_ADC_THRESH: 1500 (30cm障碍物)
 *      - DANGER_ADC_THRESH: 2400 (10cm近距离)
 * 
 *   C. Gene::evaluateCondition() 修复
 *      - COND_IDLE 使用原始ADC值判断
 *      - COND_SENSOR_BOTH/ANY 直接比较原始值
 * 
 *   D. 注入"避障种子个体"
 *      - 个体0预设3条规则：左转避障/右转避障/直行
 *      - 确保进化开始时有可工作的行为
 * 
 *   E. 增加传感器调试日志
 *      - 每100帧输出传感器ADC值
 *      - 便于验证传感器-控制链路是否导通
 * 
 * ================================================================ 
 */

/* 
 * ================================================================ 
 * 项目名称：仿草履虫应激机制 - 脱困能力进化系统 
 * 版本： v8.6.4-fixed (distanceTicks下溢修复 + 个体切换修复)
 * 适配日期: 2026-08-09   修正日期: 2026-08-14
 * ================================================================ 
 * 
 * ================================================================
 * 【修正汇总】2026-08-14 实机运行数据分析与关键Bug修复 (v8.6.4)
 * ================================================================
 * 
 * 问题背景：2026-08-14 对烧录后硬件平台实际运行记录（mmexport截图）进行分析，
 * 发现以下致命问题导致进化无法有效进行。
 * 
 * ───────────────────────────────────────────
 * 实机运行数据（mmexport截图）：
 * ───────────────────────────────────────────
 * 进化历史数据（3条记录）：
 *   timestamp  generation  noveltyScore  survivalTime  distance_ticks  ruleCount
 *   88402      1           1.0000        25693         4294967257      12
 *   209516     1           1.0000        30056         4294967220      3
 *   239631     1           0.8717        30066         4294967204      11
 * 
 * 系统信息：
 *   SPIFFS状态：已挂载
 *   进化代数：2
 * 
 * ───────────────────────────────────────────
 * 问题1（致命）：distanceTicks 的 uint32_t 下溢溢出
 * ───────────────────────────────────────────
 *   - distanceTicks 被声明为 volatile uint32_t（无符号类型）
 *   - 编码器ISR在电机后退时执行 distanceTicks--（第1618/1624行）
 *   - 当小车后退（如个体切换时的复位操作），distanceTicks 从0递减
 *     到下溢，绕回到 UINT32_MAX（约43亿）
 *   - 实际数据显示：4294967257, 4294967220, 4294967204
 *     对应有符号值：-39, -76, -92（逐个体累积恶化）
 *   - 修复：将 distanceTicks 改为 volatile int32_t
 * 
 * ───────────────────────────────────────────
 * 问题2（致命）：distanceTicks 在个体之间从未重置
 * ───────────────────────────────────────────
 *   - distanceTicks 仅在 MotorController::init() 中初始化为0
 *     （系统启动时调用一次）
 *   - startCurrentTestImpl() 和 enableMotor() 都没有重置
 *   - 导致每个个体的后退复位累积叠加下溢，数值越来越"负"
 *   - 修复：在 startCurrentTestImpl() 中新增 resetDistanceTicks() 调用
 * 
 * ───────────────────────────────────────────
 * 问题3（致命）：下溢值污染行为描述符，破坏新奇度计算
 * ───────────────────────────────────────────
 *   - extractFromFrameLog() 中 totalDistance = distanceTicks / 1000 ≈ 430万
 *   - 行为描述符是12维向量，totalDistance 是其中一维
 *   - 其他维度（传感器均值、速度、转向偏置等）在正常数值范围（0~几千）
 *   - totalDistance 高达430万，经归一化后所有个体该维度都接近1.0
 *   - 但该维度实际上是假的（来自下溢，不是真实行驶距离）
 *   - 12维空间中有一个维度被完全污染，新奇度计算（欧氏距离）
 *     无法区分真正不同的行为
 *   - 修复：改用 int32_t + abs()，确保 totalDistance 反映真实位移
 * 
 * ───────────────────────────────────────────
 * 问题4（中等）：种子个体可能未被首先测试
 * ───────────────────────────────────────────
 *   - 种子个体（population[0]，3条规则的基本避障行为）应在首位测试
 *   - 但第一条记录显示 ruleCount=12，第二条才显示 ruleCount=3
 *   - 原因：如果用户先按"下一个体"而非"开始进化"，handleEvolution
 *     的 action="next" 路径中 endCurrentTest()（此时testActive=false）
 *     无操作，然后 nextIndividual() 中 currentIndividual++ 从0跳到1，
 *     导致第0号个体（种子）被跳过
 *   - 修复：handleEvolution 的 action="next" 中移除重复的
 *     endCurrentTest() 调用（nextIndividual() 内部已调用），
 *     并在 startCurrentTest() 首次调用时确保从个体0开始
 * 
 * ───────────────────────────────────────────
 * 问题5（显示）：系统显示"进化代数: 2"但只有3条记录
 * ───────────────────────────────────────────
 *   - nextIndividualImpl() 中，只有 currentIndividual >= POPULATION_SIZE(16)
 *     时才会调用 evolveImpl() 并递增 currentGeneration
 *   - 3条记录不应该触发代数递增，但系统显示"进化代数: 2"
 *   - 说明 handleEvolution 的 action="next" 路径中 endCurrentTest() +
 *     nextIndividual() 的双重调用在某些边界条件下导致
 *     currentIndividual 异常递增
 *   - 修复：同问题4的修复，移除重复的 endCurrentTest() 调用
 * 
 * ───────────────────────────────────────────
 * 进化能否发生？结论：修复前无法有效进化
 * ───────────────────────────────────────────
 *   原因链：
 *   distanceTicks下溢 → totalDistance≈430万
 *   → 行为描述符12维空间被一个假维度主导
 *   → 所有个体的行为在归一化后看起来高度相似
 *   → 新奇度计算无法区分真正不同的行为
 *   → 锦标赛选择变得随机
 *   → 进化退化为随机游走，无法累积适应性改进
 * 
 *   数据佐证：前两个个体新奇度都是1.0000（第一个因archive为空默认
 *   返回1.0，第二个也恰好是1.0表明归一化后距离计算异常），
 *   三个个体的存活时间几乎相同（25-30秒，都是TEST_DURATION_MS=30000
 *   的超时死亡），说明没有个体展现出更优的生存策略。
 * 
 * ───────────────────────────────────────────
 * 修复清单（v8.6.4）：
 * ───────────────────────────────────────────
 * 38.[致命] distanceTicks 类型从 volatile uint32_t 改为 volatile int32_t
 *     （第1545行 + 第1864行），消除下溢溢出
 * 39.[致命] 新增 MotorController::resetDistanceTicks() 公开方法
 * 40.[致命] startCurrentTestImpl() 中调用 resetDistanceTicks()，
 *     确保每个个体独立计数
 * 41.[修复] actionLastTicks 类型从 uint32_t 改为 int32_t（第1562/1882行）
 * 42.[修复] updatePhysicsAction() 中 currentTicks 类型改为 int32_t（第1725行）
 * 43.[修复] update() 中 dist 变量类型改为 int32_t（第1817行）
 * 44.[修复] getDistanceTicks() 返回类型改为 int32_t（第1855行）
 * 45.[修复] Gene::distance_ticks 类型从 uint32_t 改为 int32_t（第1459行）
 * 46.[修复] HistoryRecord::distance_ticks 类型从 uint32_t 改为 int32_t（第1028行）
 * 47.[修复] evaluateCondition() distance 参数类型改为 int32_t（第1472行）
 * 48.[修复] extractFromFrameLog() totalDistance 参数改为 int32_t，
 *     内部使用 abs() 确保正值（第1403/1431行）
 * 49.[修复] handleEvolution action="next" 中移除重复的 endCurrentTest()
 *     调用（第2292行），nextIndividual() 内部已调用 endCurrentTestImpl()
 * ================================================================
 * 
 * 烧录成功，系统启动，但是Web显示一切正常，但是解锁后，电机没有响应，LED也不闪烁  烧录成功，系统启动
 * ================================================================
 * SPIFFS 冲突根因说明（ESP32 架构限制）
 * ================================================================
 * 
 * ESP32 只有一片 SPI Flash，同时承担三个角色：
 *   1. 程序代码存储（通过 Cache 执行）
 *   2. SPIFFS 文件系统存储
 *   3. WiFi 协议栈固件存储
 * 
 * 当 SPIFFS 执行页擦除/编程时，Flash 控制器禁用 Cache → 所有
 * 从 Flash 执行的代码（包括 WiFi 中断处理）被暂停。这是硬件级
 * 限制，无法完全消除，但本文件通过以下措施将冲突降到最低：
 * 
 *   - SPIFFS 在 WiFi 之前初始化（setup() 中顺序保证）
 *   - 编码器 ISR 标记 IRAM_ATTR + GPIO寄存器直读（在 RAM 中执行，不被 Flash 写入阻塞）
 *   - 使用原子写入策略（临时文件 + 重命名，避免写入中断导致文件损坏）
 *   - 写入仅在个体死亡时触发（forceSave），非逐帧写入
 *   - 帧日志 CSV 仅在个体测试结束时一次性导出
 *   - 噪声源使用 GPIO35（仅输入 ADC1，不与 Flash SPI 总线共享引脚）
 * 
 * 已知残余风险（可接受）：
 *   - SPIFFS 写入期间 WiFi 可能丢包（~10-50ms 级别），不影响 AP 连接
 *   - Flash 写入时 ADC 读数可能有轻微噪声（电源纹波），但传感器
 *     使用多次采样基准值校准，单次噪声不影响决策
 *   - 如果 SPIFFS 空间耗尽（极罕见），doAtomicWrite 失败 → 数据丢失
 *     → 但 buffer 已清空，不会 OOM（#37 修复）
 * ================================================================ 
 * 
 * ================================================================
 * 【修正汇总】2026-08-10 移植自 v5.9 MotorDriver 电机增益控制逻辑
 * ================================================================
 * 
 * 一、电机增益移植（全局生效）
 * ───────────────────────────────────────────
 * 1. 新增宏 LEFT_GAIN=1.00f / RIGHT_GAIN=1.25f，补偿右电机机械偏弱
 * 2. 新增 writeMotorHardware() 统一入口函数，所有电机 PWM 写入必须
 *    经过此函数，确保增益补偿全局零死角生效
 * 3. 将 analogWrite() 全部替换为 ledcWrite()，匹配 AT8236 驱动芯片
 *    （ledcAttach 5kHz/8bit，在 init() 中初始化）
 * 4. 替换范围覆盖全部 6 个调用点共 10 次写入：
 *    - stopMotors()        → writeMotorHardware(0, 0)
 *    - backwardReset()     → writeMotorHardware(100, 100)
 *    - update()            → writeMotorHardware(currentSpeedL, currentSpeedR)
 *    - executeRecovery()   → writeMotorHardware(...) ×4 次
 *    - updateChaos()       → writeMotorHardware(randSpeedL, randSpeedR)
 * 
 * 二、漏洞修复
 * ───────────────────────────────────────────
 * 5. [修复] 右编码器 ISR 空函数体 → 实现正交解码（B相判断方向）
 * 6. [修复] 左编码器 ISR 仅做 distanceTicks++ → 实现正交解码（区分正反转）
 * 7. [修复] 混沌期间 lastMoveTime 不更新 → writeMotorHardware() 每次写入
 *    自动更新 lastMoveTime，endChaos() 脱困判定现已可靠
 * 
 * 三、附带修复
 * ───────────────────────────────────────────
 * 8. [修复] 删除 lastChaosTime 重复声明（原行 779-780 重复定义）
 * 9. [标注] SPINNING_STUCK_* 三个宏标注为 [预留]（当前未实现旋转卡死检测）
 * 10.[标注] EvolutionEngine 静态访问方式添加注释说明
 * 
 * 四、实车校准注意事项
 * ───────────────────────────────────────────
 * - RIGHT_GAIN=1.25 为预设值，需通过编码器校准工具（源文件
 *   CalibrationTool::calibrateGain()）实测左右轮脉冲差值后修正
 * - 增益后 backwardReset() 中右轮 PWM 略大（125 vs 100），
 *   后退复位可能产生轻微弧线，若场地空间受限可调低 RIGHT_GAIN
 * - 若更换电机或齿轮箱，需重新校准 LEFT_GAIN / RIGHT_GAIN
 * 
 * ================================================================
 * 【修正汇总】2026-08-10 时序与存储系统修复
 * ================================================================
 * 
 * 五、SPIFFS + WiFi 时序冲突修复
 * ───────────────────────────────────────────
 * 11.[致命] RobustStorage::init() 从未被调用 → 在 setup() 中新增调用，
 *    SPIFFS 在 WiFi 之前初始化，避免 Flash 操作与 WiFi 中断冲突
 * 12.[修复] loadHistory() 不存在 → 由 RobustStorage::init() 内部调用
 *    loadHistoryToRAM() 替代
 * 13.[修复] SAVE_INTERVAL_MS 未定义 → 改为 RobustStorage::tick()（内部
 *    使用 STORAGE_SAVE_INTERVAL_MS）
 * 14.[修复] flushIfNeeded() 不存在 → 改为 RobustStorage::tick()
 * 15.[修复] LOOP_DELAY_MS 未定义 → 新增宏定义为 10ms
 * 16.[修复] SensorCalibration::init() 不存在 → 改为 calibrate()
 * 17.[修复] Logger::getRecentLogs() 不存在 → 新增 stub 实现
 * 18.[修复] RobustStorage::clearAll() 不存在 → 新增实现（清除 Flash 文件
 *    及 RAM 缓冲区）
 * 
 * 六、倒车重置时序修复
 * ───────────────────────────────────────────
 * 19.[修复] backwardReset() 双重调用 → loop() 中删除重复的
 *    MotorController::backwardReset()，因为 endCurrentTest() 内部已调用，
 *    避免 5 秒双重阻塞冻结
 * 
 * ================================================================
 * 【修正汇总】2026-08-10 混沌脱困物理姿态修复
 * ================================================================
 * 
 * 七、物理噪声源与随机方向
 * ───────────────────────────────────────────
 * 20.[新增] PIN_NOISE_SOURCE (GPIO6) 悬空ADC引脚，利用半导体热噪声
 *    生成真随机数熵源（移植自 v5.9 的物理随机变异源设计）
 * 21.[新增] SensorCalibration::readNoise() 读取悬空引脚噪声值
 * 22.[新增] setup() 中 randomSeed(物理噪声) 播种随机数生成器
 * 
 * 八、混沌脱困后的物理姿态（贴合生物学应激行为）
 * ───────────────────────────────────────────
 * 23.[新增] escapeRetreat()：混沌成功后，物理噪声源驱动随机方向后退
 *    500ms 逃离危险区域（0=直退, 1=后退左转, 2=后退右转）
 *    避免脱困后车头仍对着障碍物、立刻重新撞入
 * 24.[修复] 混沌脱困失败 → 立即调用 endCurrentTest() + nextIndividual()
 *    模拟"挣扎失败后放弃生命"，不再靠 recovery 苟活稀释进化压力
 * 
 * 九、个体切换时的物理姿态
 * ───────────────────────────────────────────
 * 25.[新增] randomTurn()：个体切换时，backwardReset 后增加物理噪声
 *    驱动的随机原地转向 500ms（左转/右转），打破前任的死亡姿态
 *    ，确保新个体从不同方向出发探索
 * 
 * ================================================================
 * 【修正汇总】2026-08-10 基因表达与数据记录修复
 * ================================================================
 * 
 * 十、死基因激活
 * ───────────────────────────────────────────
 * 26.[修复] chaos_threshold 死基因 → detectDilemma() 中 collisionCount
 *    现在与基因 chaos_threshold 比较，而非硬编码 COLLISION_THRESHOLD=8
 *    （行 1160）。基因值范围 2-20，越小越敏感越早触发混沌
 * 27.[修复] preferred_action 死基因 → update() 畅通时根据偏好注入偏向：
 *    0=直行(无偏向), 1=左转(右轮+25%), 2=右转(左轮+25%)
 *    （行 1097-1102）。使偏好动作真正影响小车探索行为
 * 28.[新增] MotorController::setPreferredAction() + 静态成员
 *    preferred_action，在 applyGeneToMotor() 中传递（行 1005/741）
 * 
 * 十一、逐帧动作日志系统
 * ───────────────────────────────────────────
 * 29.[新增] FrameLogEntry 结构体：每帧记录时间戳、传感器值、电机PWM、
 *    方向、混沌状态、困境类型，共 10 字节/帧（行 264-278）
 * 30.[新增] 256 帧环形缓冲区（FRAME_LOG_SIZE），覆盖约 2.5 秒
 * 31.[新增] logFrame()：每帧在 update() 末尾采集传感器+电机状态
 * 32.[新增] flushFrameLogToFlash()：个体测试结束时导出 CSV 到 SPIFFS
 *    文件名格式 /frm_g{代}_i{个体}.csv
 * 33.[新增] startFrameLog() / getFrameLogSummary() 配套方法
 * 
 * ================================================================
 * 【修正汇总】2026-08-10 存储链路完整性修复
 * ================================================================
 * 
 * 十二、存储流断链与硬件冲突修复
 * ───────────────────────────────────────────
 * 34.[致命] GPIO6 与 Flash SPI CLK 总线冲突 → 改为 GPIO35（仅输入
 *    ADC1 引脚，悬空安全，不与 Flash 总线共享）
 * 35.[修复] 快速死亡个体数据丢失 → endCurrentTest() 中 addRecord()
 *    后追加 forceSave()，确保每个个体死亡时数据立即持久化
 * 36.[修复] 混沌脱困失败时 Web 冻结 5.5 秒 → endChaos() 失败分支
 *    不再调用 nextIndividual()，改为设置 pendingTransition 标志，
 *    由 loop() 在 handleClient() 之后处理，Web 不再被阻塞
 * 37.[修复] flushBuffer() 失败时 buffer 无限增长 → 3 次重试失败后
 *    清空 pendingBuffer 和 unsavedCount，防止内存溢出
 * ================================================================
 * 混沌脱困 → 物理姿态 行为流程图
 * ================================================================
 * 
 *  start() 释放个体
 *    │
 *    ▼
 *  正常行走 ──→ 困境检测 ──→ 触发混沌
 *                                │
 *                      ┌─────────┴─────────┐
 *                      ▼                   ▼
 *                混沌成功脱困          混沌脱困失败
 *                      │                   │
 *                      ▼                   ▼
 *           escapeRetreat()          立即死亡
 *           物理噪声 → 随机方向       endCurrentTest()
 *           ┌───┬───┬───┐            +pendingTransition
 *           │直退│左转│右转│                │
 *           └───┴───┴───┘            loop() 下一轮
 *                后退500ms               │
 *                车头已转向           handleClient() OK
 *                      │                   │
 *                      ▼                   ▼
 *              继续正常行走          nextIndividual()
 *                                    backwardReset()
 *                                    randomTurn()
 *                                          │
 *                                          ▼
 *                                   新个体从随机方向出发
 * ================================================================
 * 遗传数据流图
 * ================================================================
 * 
 * ┌─ 5 个可遗传基因 ─────────────────────────────────────────┐
 * │                                                          │
 * │  k_turn          → 避障转向幅度 (update 中叠加)          │
 * │  speed_bias      → 直行速度     (update 中 targetSpeed)   │
 * │  chaos_threshold → 混沌敏感度   (detectDilemma 碰撞判定)  │
 * │  recovery_mode   → 脱困策略     (executeRecovery switch)  │
 * │  preferred_action→ 探索偏向     (update 畅通时注入)       │
 * │                                                          │
 * └──────────────────────────────────────────────────────────┘
 *                            │
 *       个体测试结束 ──→ endCurrentTest()
 *                            │
 *                ┌───────────┴───────────┐
 *                ▼                       ▼
 *          聚合统计记录              逐帧动作日志
 *        (HistoryRecord)            (FrameLogEntry)
 *                │                       │
 *                ▼                       ▼
 *        addRecord() → 缓冲区      环形缓冲区 256帧
 *                │                       │
 *                ▼                       ▼
 *        定时 flushBuffer()       flushFrameLogToFlash()
 *        → /history.csv           → /frm_g{代}_i{个体}.csv
 *                │                       │
 *                └───────────┬───────────┘
 *                            ▼
 *                       SPIFFS Flash
 *                            │
 *        ┌───────────────────┼───────────────────┐
 *        ▼                                       ▼
 *   下一代 evolve()                      Web 导出查看
 *   精英保留 + 锦标赛选择                /api/history
 *   + 均匀交叉 + 变异                    /api/framelog
 * ================================================================
 */
/* 
 * ================================================================ 
 * 项目名称：仿草履虫应激机制 - 脱困能力进化系统 
 * 版本： v7.3-fixed-v2 (编译错误全面修复)
 * 适配日期: 2026-08-09   修正日期: 2026-08-11
 * ================================================================ 
 *
 * ================================================================
 * 【修正汇总】2026-08-11 编译错误全面修复 (v7.3-fixed → v7.3-fixed-v2)
 * ================================================================
 * 
 * 一、致命编译错误修复
 * ───────────────────────────────────────────
 * 1. [致命] EvolutionEngine 类设计为实例类，但代码中全部以静态方式调用
 *    → 重构为单例+静态包装模式：添加 static instance 成员，所有公有方法
 *      改为静态包装（调用 instance.implXxx()），新增公有访问器方法
 *    → 影响范围：MotorController::endChaos()、CarWebServer 全部路由、
 *      setup()、loop() 中共 30+ 处调用点
 * 
 * 2. [致命] ledcAttach(pin, freq, bits) 三参数函数不存在 (ESP32 Arduino 标准库)
 *    → 拆分为 ledcSetup(chan, freq, bits) + ledcAttachPin(pin, chan)
 *    → 新增 LEDC_CHANNEL_LEFT=0, LEDC_CHANNEL_RIGHT=1 宏定义
 * 
 * 3. [致命] ledcWrite 参数应为通道号，非引脚号
 *    → 全部 ledcWrite(PIN_xxx, val) 改为 ledcWrite(LEDC_CHANNEL_xxx, val)
 *    → 影响范围：writeMotorHardware()、init() 中共 4 处
 * 
 * 4. [致命] case 2: 中声明 int dir 跨越初始化
 *    → 加花括号 case 2: { int dir = ...; ... break; }
 * 
 * 5. [致命] PIN_NOISE_SOURCE 宏重复定义 (GPIO6 vs GPIO35)
 *    → 删除 GPIO6 的定义（与 Flash SPI CLK 总线冲突），仅保留 GPIO35
 *    → 修正注释：PIN_NOISE_SOURCE 不再标注为 GPIO6
 * 
 * 二、编译警告/运行时错误修复
 * ───────────────────────────────────────────
 * 6. [修复] isClear() 函数体内有不可达代码（第二个 return 永远不执行）
 *    → 删除重复的 return 语句，清理函数体
 * 
 * 7. [修复] server.on("/status", handleStatus) 重复注册两次
 *    → 删除重复行，避免运行时崩溃
 * 
 * 8. [修复] 缺少 <cstdio> 头文件（vsnprintf 依赖）
 *    → 添加 #include <cstdio>
 * 
 * 9. [修复] CarWebServer 直接访问 MotorController 的 private 静态成员
 *    → 新增 public getter: getCurrentSpeedL(), getCurrentSpeedR(),
 *      isChaosActive(), getCurrentDilemma()
 * 
 * 10.[修复] CarWebServer 直接访问 EvolutionEngine 的 private 成员
 *    → EvolutionEngine 重构后已有 public 静态访问器方法
 * ================================================================
 *
 * ================================================================
 * v8.0 — 物理结构即算法 开放式进化重构 (2026-08-11)
 * ================================================================
 * 
 * 设计哲学: 从"目标导向优化"转向"行为多样性探索"
 * ───────────────────────────────────────────
 * v7.3 本质是经典遗传算法(GA): 固定适应度函数 → 精英保留 → 收敛到最优。
 * v8.0 将三个维度同时改造，使系统真正检验"物理结构能否涌现智能行为":
 *   - 进化不再预设"什么是好"（取消适应度函数）
 *   - 物理身体不再只是"执行器"（参与决策和计时）
 *   - 行为不再由程序员硬编码（进化可以发明策略）
 * 
 * ================================================================
 * 维度一: Novelty Search 新奇度驱动进化
 * ================================================================
 * 
 * 核心思想: 不问"谁表现好"，问"谁的行为是档案里没见过的"
 * 
 * 行为描述符 (BehaviorDescriptor, 12维):
 * ┌─────────────────────────────────────────────────────────────┐
 * │ 传感器维度(4): 左均值/右均值/方差/不对称度                  │
 * │ 运动维度(4):   平均速度/速度方差/转向偏向/总距离            │
 * │ 策略维度(4):   直行占比/转向占比/后退占比/静止占比          │
 * └─────────────────────────────────────────────────────────────┘
 * 
 * 新奇度计算:
 *   个体测试结束 → 帧日志提取行为描述符 → 归一化 →
 *   计算到档案中 k=5 个最近邻的平均欧氏距离 → 新奇度得分
 *   新奇度 > 阈值(0.15) → 加入档案 (最多200条)
 * 
 * 新奇度档案 (NoveltyArchive):
 *   - 存储历史行为描述符，驱动进化向行为空间未探索区域扩展
 *   - 自动归一化: 跟踪各维度历史最大值，新描述符动态归一化
 *   - 环形淘汰: 档案满时替换最旧条目
 * 
 * 选择机制变换:
 *   旧: fitness排序 → 精英保留前25% → 锦标赛选fitness高的
 *   新: novelty排序 → 精英保留前25% → 锦标赛选novelty高的
 * 
 * 自适应变异率:
 *   新奇度停滞(avg < best*0.5) → 加大变异率 → 探索新行为空间
 *   新奇度健康(avg > best*0.8) → 降低变异率 → 精细调整
 * 
 * 预期效果:
 *   - 不再奖励"活得久但行为平庸"的个体
 *   - 自然涌现多样性: "撞墙专家""旋转专家""贴墙走专家"
 *   - 不需要预设什么是"好"行为 — 系统自己发现行为空间
 * 
 * ================================================================
 * 维度二: 物理结构承担计算
 * ================================================================
 * 
 * 核心思想: 物理身体不再只是"执行PWM指令的被动执行器"，
 *           而是参与决策、计时和运动平滑的计算主体
 * 
 * 2.1 物理终止条件 (physicsTerminatedAction)
 * ───────────────────────────────────────────
 * 旧: 所有动作使用固定 delay(ms) 计时
 *    executeRecovery case0: delay(500)
 *    executeRecovery case1: delay(800)
 *    escapeRetreat:        while(millis()-start<500)
 *    backwardReset:        delay(2500)
 * 
 * 新: 动作持续时间由物理现实决定
 *    physicsTerminatedAction(pwm, dir, minDuration):
 *      每10ms检测编码器增量 → 连续10帧编码器不动 = 物理已停止
 *      → 动作自动终止
 *      → 安全兜底: 最多3秒
 * 
 * 物理含义:
 *   - 电机扭矩大的个体 → 后退时间短 → 物理决定了动作时长
 *   - 摩擦力大的地面 → 自然延长动作 → 环境参与决策
 *   - 齿轮箱磨损 → 不同个体表现不同 → 物理的"个性"
 * 
 * 2.2 噪声连续调制 (Noise Modulation)
 * ───────────────────────────────────────────
 * 旧: GPIO35 仅用于 randomSeed() 一次性播种
 * 新: 每帧读取 GPIO35，调制所有行为参数
 * 
 *   噪声调制因子 = 0.7 + 噪声(0~0.999) * 0.6 → 范围 0.7~1.3
 *   调制对象:
 *     - 规则电机PWM: motorL *= noiseMod
 *     - 规则持续时间: durationMs *= noiseMod
 *     - 实际转向幅度: 基因决定基础值 + 噪声波动 ±30%
 * 
 * 物理含义:
 *   - 同一基因在不同时刻表现不同行为
 *   - 两个基因完全相同的个体，因噪声采样时间序列不同而行为分化
 *   - 创造"同一基因型 → 多种表现型"的物理涌现条件
 * 
 * 2.3 脉冲式控制 (Impulse Control)
 * ───────────────────────────────────────────
 * 旧: 逐帧平滑过渡
 *    currentSpeed = min(currentSpeed+MAX_SPEED_CHANGE_PER_FRAME, target)
 * 
 * 新: 直接施加目标 PWM，不做代码级平滑
 *    currentSpeed = targetSpeed
 *    writeMotorHardware(currentSpeedL, currentSpeedR)
 * 
 * 物理含义:
 *   - 速度变化曲线由物理系统决定: 电机电感响应时间、齿轮箱惯性、
 *     轮胎摩擦力 — 这些是代码不可控的物理变量
 *   - 不同电机老化程度 → 不同响应曲线 → 物理的"个性"
 *   - 代码不再"手工平滑" — 物理自己完成
 * 
 * ================================================================
 * 维度三: 可变长度行为表基因
 * ================================================================
 * 
 * 核心思想: 从"调5个参数"变为"进化可以发明行为规则"
 * 
 * 旧基因型 (5个固定参数):
 *   k_turn, speed_bias, chaos_threshold, recovery_mode, preferred_action
 *   → 只能调参，不能改变行为逻辑结构
 * 
 * 新基因型 (BehaviorRule 表):
 *   struct BehaviorRule {
 *     condType:   传感器/距离/时间/空闲/无条件 (8种)
 *     condValue:  阈值 (-3000~3000)
 *     condOp:     > / < / ==
 *     motorL:     左电机PWM (-255~255, 负=反转)
 *     motorR:     右电机PWM
 *     durationMs: 持续时间 (物理终止条件下限)
 *     nextRule:   0=重新评估, 1-N=跳转到指定规则
 *   };
 *   每个个体 2~16 条规则，规则数量本身可进化
 * 
 * 条件类型 (8种):
 * ┌──────────────────┬────────────────────────────────────┐
 * │ COND_SENSOR_LEFT │ 左传感器超过阈值                    │
 * │ COND_SENSOR_RIGHT│ 右传感器超过阈值                    │
 * │ COND_SENSOR_BOTH │ 两侧传感器都超过阈值                │
 * │ COND_SENSOR_ANY  │ 任一侧传感器超过阈值                │
 * │ COND_DISTANCE    │ 编码器距离超过阈值                  │
 * │ COND_TIME        │ 测试时间超过阈值                    │
 * │ COND_IDLE        │ 两侧传感器均低于阈值 (空闲)         │
 * │ COND_ALWAYS      │ 无条件触发                          │
 * └──────────────────┴────────────────────────────────────┘
 * 
 * 运行时行为表引擎:
 *   loop() 每帧:
 *     for 每条规则:
 *       if 条件满足:
 *         停止评估 → 执行该规则 → physicsTerminatedAction
 *         → 如果 nextRule>0: 跳转到指定规则继续执行
 *         → 否则: 重新评估条件
 *       → 没有规则匹配: 停止电机
 * 
 * 交叉: 随机切割点交叉
 *   父本1取前k1条规则，父本2取后k2条规则，k1、k2为随机数
 *   拼接后规则数约束在2~16之间，若不足则循环补齐
 * 
 * 变异 (10种操作):
 *   1. 微调condValue参数
 *   2. 微调motorL参数
 *   3. 微调motorR参数
 *   4. 微调durationMs参数
 *   5. 变更条件类型 (condType)
 *   6. 变更比较操作符 (condOp)
 *   7. 变更跳转目标 (nextRule)
 *   8. 增加一条规则 (ruleCount++)
 *   9. 删除一条规则 (ruleCount--)
 *  10. 交换两条规则顺序
 * 
 * 进化可以自发发现的策略示例:
 *   - "左传感器高时，右转随机角度前进" → 非程序员编码
 *   - "每3秒后退一次" → 自发涌现的探索节奏
 *   - "先左转200ms，如果传感器还高就右转400ms" → 多步策略链
 *   - "空闲时原地旋转寻找新方向" → 利用 COND_IDLE 条件
 * 
 * ================================================================
 * 新架构运行时数据流
 * ================================================================
 * 
 * setup():
 *   SPIFFS初始化 → 物理噪声播种 → 传感器校准 → 电机初始化
 *   → 进化引擎初始化(种群16个行为表基因) → Web控制台启动
 * 
 * loop():
 *   ┌─ 测试活跃? ─→ MotorController::update(gene)
 *   │                 │
 *   │                 ├─ 读取传感器 + 噪声
 *   │                 ├─ 行为表规则评估
 *   │                 │   ├─ 条件匹配 → 噪声调制参数 → 物理终止动作
 *   │                 │   └─ 无匹配 → 停止
 *   │                 └─ 记录帧日志
 *   │
 *   ├─ 测试超时? → endCurrentTest() → nextIndividual()
 *   │
 *   ├─ Web请求处理 (handleClient)
 *   │
 *   └─ 存储定时刷新 (RobustStorage::tick)
 * 
 * 个体测试结束 → endCurrentTest():
 *   统计存活时间+距离 → 帧日志提取行为描述符 →
 *   NoveltyArchive::computeNovelty() → 加入档案 →
 *   记录历史 → 帧日志CSV导出 → 检查是否新纪录
 * 
 * 一代结束 → evolve():
 *   按新奇度排序 → 精英保留 → 新奇度锦标赛选亲本 →
 *   规则子集交叉 → 变异 → 自适应变异率 → 下一轮
 * 
 * 数据持久化:
 *   /oe_history.csv: 每代每个体的新奇度+存活+距离+规则数
 *   /frm_g{代}_i{个体}.csv: 256帧逐帧传感器+电机日志
 * 
 * ================================================================
 * 与旧版(v7.3)关键差异对照
 * ================================================================
 * 
 * ┌──────────────────┬─────────────────────┬─────────────────────┐
 * │ 维度             │ v7.3 (经典GA)       │ v8.0 (物理即算法)   │
 * ├──────────────────┼─────────────────────┼─────────────────────┤
 * │ 进化目标         │ 最大化适应度        │ 探索行为多样性      │
 * │ 选择依据         │ 存活+距离+脱困      │ 新奇度(行为距离)    │
 * │ 基因型           │ 5个固定参数         │ 2~16条行为规则      │
 * │ 行为来源         │ 程序员硬编码        │ 进化产生IF-THEN表   │
 * │ 动作计时         │ 固定delay(ms)       │ 编码器物理终止      │
 * │ 速度控制         │ 逐帧平滑过渡        │ 脉冲式+物理惯性     │
 * │ 噪声角色         │ 仅播种随机数        │ 连续调制所有参数    │
 * │ 物理身体角色     │ 被动执行器          │ 参与决策+计时+平滑  │
 * │ 精英保留         │ fitness前25%        │ novelty前25%        │
 * │ 混沌/恢复/困境   │ 硬编码case分支      │ 行为表规则替代      │
 * │ 适应度停滞       │ 加大变异→收敛       │ 加大变异→探索新区间 │
 * └──────────────────┴─────────────────────┴─────────────────────┘
 * ================================================================ */

/*
 * ================================================================ 
 * 项目名称：仿草履虫应激机制 - 脱困能力进化系统 
 * 版本： v8.0-fixed (LEDC修复 + abs类型修复)
 * ================================================================ 
 */

/*
 * ================================================================ 
 * 项目名称：仿草履虫应激机制 - 脱困能力进化系统 
 * 版本： v8.1-fixed (循环引用修复 + LEDC包含)
 * ================================================================ 
 */

/*
 * ================================================================ 
 * 项目名称：仿草履虫应激机制 - 脱困能力进化系统 
 * 版本： v8.2-fixed (LEDC修复 + 循环引用彻底解决)
 * ================================================================ 
 */


/*
 * ================================================================ 
 * 项目名称：仿草履虫应激机制 - 脱困能力进化系统 
 * 版本： v8.0-fixed (编译错误全面修复)
 * 适配日期: 2026-08-11   修正日期: 2026-08-12
 * ================================================================ 
 * 由于ESP32 Arduino环境可能不支持 ledcSetup，使用最兼容的方式 - 使用 ledcAttach 函数（这是ESP32 Arduino早期版本就支持的)
 
 */

/* 
 * ================================================================ 
 * 项目名称：仿草履虫应激机制 - 脱困能力进化系统 
 * 版本： v8.0-final (完整修复版)
 * 适配日期: 2026-08-12
 * ================================================================ 
 * 
 * 设计哲学: 从"目标导向优化"转向"行为多样性探索"
 * - Novelty Search 新奇度驱动进化
 * - 物理结构承担计算 (物理终止条件 + 噪声连续调制)
 * - 可变长度行为表基因 (2~16条IF-THEN规则)
 * ================================================================ 
 */

/* 
 * ================================================================ 
 * 项目名称：仿草履虫应激机制 - 脱困能力进化系统 
 * 版本： v8.0-final (完整可用版)
 * 适配日期: 2026-08-12
 * ================================================================ 
 * 
 * 设计哲学: Novelty Search 新奇度驱动进化 + 行为表基因
 * ================================================================ 
 */

/* 
 * ================================================================ 
 * 项目名称：仿草履虫应激机制 - 脱困能力进化系统 
 * 版本： v8.0-final (完整可用版)
 * 适配日期: 2026-08-12
 * ================================================================ 
 * 
 * 设计哲学: Novelty Search 新奇度驱动进化 + 行为表基因
 * ================================================================ 
 */

/* 
 * ================================================================ 
 * 项目名称：仿草履虫应激机制 - 脱困能力进化系统 
 * 版本： v8.0-final (完整可用版)
 * 适配日期: 2026-08-12
 * ================================================================ 
 * 
 * 设计哲学: Novelty Search 新奇度驱动进化 + 行为表基因
 * ================================================================ 
 */

/* 
 * ================================================================ 
 * 项目名称：仿草履虫应激机制 - 脱困能力进化系统 
 * 版本： v8.5-final (轮询编码器方案)
 * ================================================================ 
 */

/* 
 * ================================================================ 
 * 项目名称：仿草履虫应激机制 - 脱困能力进化系统 
 * 版本： v8.5-final (ESP32兼容LEDC)
 * ================================================================ 
 */

/*
 * ================================================================ 
 * 项目名称：仿草履虫应激机制 - 脱困能力进化系统 
 * 版本： v8.5-final (SPIFFS已禁用)
 * 适配日期: 2026-08-12
 * ================================================================ 
 * 
 * SPIFFS已被禁用 - 所有数据仅保存在RAM中
 * 如需持久化数据，请取消注释SPIFFS相关代码并重新格式化Flash
 * ================================================================ 
 */

/* 
 * ================================================================ 
 * 项目名称：仿草履虫应激机制 - 脱困能力进化系统 
 * 版本： v8.6-nonblocking (非阻塞状态机重构)
 * 适配日期: 2026-08-13
 * ================================================================ 
 * 
 * 【重要更改】2026-08-13 非阻塞状态机重构
 * ================================================================
 * 
 * 一、根因修复：RTC看门狗复位 (rst:0x10)
 * ───────────────────────────────────────────
 * 问题：physicsTerminatedAction() 内部使用 while(1) + delay()
 *       最长阻塞 3 秒，期间不喂狗 → 触发 RTCWDT_RTC_RST
 * 
 * 修复：重构为非阻塞状态机
 *   - physicsTerminatedAction() → startPhysicsAction() + updatePhysicsAction()
 *   - startPhysicsAction(): 设置电机并记录起始状态
 *   - updatePhysicsAction(): 每帧调用，检测编码器停滞 → 自动终止
 *   - loop() 中每帧调用 updatePhysicsAction()
 * 
 * 二、移除所有阻塞 delay()
 * ───────────────────────────────────────────
 *   - physicsTerminatedAction() 中的 while 循环已移除
 *   - 所有动作现在由状态机驱动，不阻塞主循环
 *   - Web 控制台在动作执行期间保持响应
 * 
 * 三、新增接口
 * ───────────────────────────────────────────
 *   - MotorController::isActionInProgress(): 查询是否有物理动作正在执行
 *   - MotorController::updatePhysicsAction(): 状态机更新，需在 loop() 中调用
 *   - MotorController::forceStopAction(): 强制终止当前动作
 * 
 * 四、修复类型错误
 * ───────────────────────────────────────────
 *   - setMotor(int pwm, bool isLeft, bool forward) 第三个参数是 bool forward
 *   - 之前调用 setMotor(leftPWM, true, dirL) 正确，但 dirL 含义需明确
 *   - 新增 getMotorDirection() 辅助函数统一处理
 * ================================================================ 
 */

/* 
 * ================================================================ 
 * 项目名称：仿草履虫应激机制 - 脱困能力进化系统 
 * 版本： v8.5-final (SPIFFS已禁用)
 * 适配日期: 2026-08-12
 * ================================================================ 
 * 
 * SPIFFS已被禁用 - 所有数据仅保存在RAM中
 * 如需持久化数据，请取消注释SPIFFS相关代码并重新格式化Flash
 * ================================================================ 
 */

/* 
 * ================================================================ 
 * 项目名称：仿草履虫应激机制 - 脱困能力进化系统 
 * 版本： v8.6.1-hardware-fixed (基于v8.6非阻塞状态机 + 硬件引脚/电机逻辑修复)
 * 适配日期: 2026-08-14
 * ================================================================ 
 * 
 * 【修复说明】2026-08-14 硬件电机控制逻辑全面修复
 * ================================================================
 * 
 * 基于 v5.9 已验证的 AT8236 电机驱动逻辑，修复以下问题：
 * 
 * 1. [致命] 左方向引脚 PIN_LEFT_DIR2 从 21 修正为 46
 * 2. [致命] 右方向引脚 PIN_RIGHT_DIR2 从 33 修正为 15
 * 3. [致命] 方向引脚未初始化为 LOW（停止状态）
 * 4. [致命] 方向控制与 PWM 控制分离，导致某些调用路径方向未设置
 * 5. [修复] setMotorSigned() 重写为 setMotorSpeed()，同时控制方向和PWM
 * 6. [修复] writeMotorHardware() 删除，统一使用 setMotorSpeed()
 * 7. [修复] stopMotors() 改为直接调用 setMotorSpeed(0, 0)
 * 8. [修复] 所有电机控制调用点统一使用 setMotorSpeed()
 * 9. [修复] 右电机正反转方向与 v5.9 对齐
 * ================================================================ 
 */

/*
 * ================================================================ 
 * 项目名称：仿草履虫应激机制 - 脱困能力进化系统 
 * 版本： v8.5-final (SPIFFS已禁用)
 * 适配日期: 2026-08-12
 * ================================================================ 
 * 
 * SPIFFS已被禁用 - 所有数据仅保存在RAM中
 * 如需持久化数据，请取消注释SPIFFS相关代码并重新格式化Flash
 * ================================================================ 
 */

/* 
 * ================================================================ 
 * 项目名称：仿草履虫应激机制 - 脱困能力进化系统 
 * 版本： v8.6-nonblocking (非阻塞状态机重构)
 * 适配日期: 2026-08-13
 * ================================================================ 
 * 
 * 【重要更改】2026-08-13 非阻塞状态机重构
 * ================================================================
 * 
 * 一、根因修复：RTC看门狗复位 (rst:0x10)
 * ───────────────────────────────────────────
 * 问题：physicsTerminatedAction() 内部使用 while(1) + delay()
 *       最长阻塞 3 秒，期间不喂狗 → 触发 RTCWDT_RTC_RST
 * 
 * 修复：重构为非阻塞状态机
 *   - physicsTerminatedAction() → startPhysicsAction() + updatePhysicsAction()
 *   - startPhysicsAction(): 设置电机并记录起始状态
 *   - updatePhysicsAction(): 每帧调用，检测编码器停滞 → 自动终止
 *   - loop() 中每帧调用 updatePhysicsAction()
 * 
 * 二、移除所有阻塞 delay()
 * ───────────────────────────────────────────
 *   - physicsTerminatedAction() 中的 while 循环已移除
 *   - 所有动作现在由状态机驱动，不阻塞主循环
 *   - Web 控制台在动作执行期间保持响应
 * 
 * 三、新增接口
 * ───────────────────────────────────────────
 *   - MotorController::isActionInProgress(): 查询是否有物理动作正在执行
 *   - MotorController::updatePhysicsAction(): 状态机更新，需在 loop() 中调用
 *   - MotorController::forceStopAction(): 强制终止当前动作
 * 
 * 四、修复类型错误
 * ───────────────────────────────────────────
 *   - setMotor(int pwm, bool isLeft, bool forward) 第三个参数是 bool forward
 *   - 之前调用 setMotor(leftPWM, true, dirL) 正确，但 dirL 含义需明确
 *   - 新增 getMotorDirection() 辅助函数统一处理
 * ================================================================ 
 */

/* 
 * ================================================================ 
 * 项目名称：仿草履虫应激机制 - 脱困能力进化系统 
 * 版本： v8.5-final (SPIFFS已禁用)
 * 适配日期: 2026-08-12
 * ================================================================ 
 * 
 * SPIFFS已被禁用 - 所有数据仅保存在RAM中
 * 如需持久化数据，请取消注释SPIFFS相关代码并重新格式化Flash
 * ================================================================ 
 */

/*
 * ================================================================ 
 * 项目名称：仿草履虫应激机制 - 脱困能力进化系统 
 * 版本： v8.6.2-stable (SPIFFS启用 + 关键Bug修复)
 * 适配日期: 2026-08-14
 * ================================================================ 
 * 
 * 【修复说明】2026-08-14 三个关键问题修复
 * ================================================================
 * 
 * 修复1: 历史数据导出为空
 * ───────────────────────────────────────────
 * 问题: getCSVData() 从 pendingBuffer 读取，但数据被 flushBuffer() 清空
 * 修复: 改为从 ramHistory 数组构建 CSV，同时支持 SPIFFS 持久化
 * 
 * 修复2: 进化在第3个个体后停止
 * ───────────────────────────────────────────
 * 问题: stopMotors() 未重置 ruleActive 标志，导致后续个体无法匹配规则
 * 修复: stopMotors() 中增加 ruleActive = false
 * 
 * 修复3: 启用 SPIFFS 持久化存储
 * ───────────────────────────────────────────
 * 问题: 数据仅保存在RAM，重启丢失
 * 修复: 启用 SPIFFS，数据同时写入 Flash 和 RAM，双重保障
 * 
 * ================================================================ 
 * 
 * 硬件引脚: 基于 v5.9 已验证的 AT8236 电机驱动逻辑
 * 状态机: 基于 v8.6 非阻塞状态机
 * ================================================================ 
 */

/* 
 * ================================================================ 
 * 项目名称：仿草履虫应激机制 - 脱困能力进化系统 
 * 版本： v8.6.3-sensor-fixed (传感器校准修复版)
 * 适配日期: 2026-08-14
 * ================================================================ 
 * 
 * 【修复说明】2026-08-14 传感器-控制链路修复
 * ================================================================
 * 
 * 问题根因：
 *   1. 传感器校准值与原始值混用，导致行为表条件永远无法触发
 *   2. isClear() 中右传感器减了 leftBase 而非 rightBase
 *   3. 阈值定义与实际 GP2Y0A21 传感器输出范围不匹配
 *   4. 初始种群缺乏对传感器有反应的个体
 * 
 * 修复内容：
 *   A. SensorCalibration 类重构
 *      - getLeftRaw() / getRightRaw(): 返回原始ADC值
 *      - getLeftCalibrated() / getRightCalibrated(): 返回校准值
 *      - isObstacleLeft() / isObstacleRight(): 基于原始值判断
 *      - isClear(): 修复右传感器基准值错误
 * 
 *   B. 阈值重新定义
 *      - CLEAR_ADC_THRESH: 600 (无障碍物)
 *      - OBSTACLE_ADC_THRESH: 1500 (30cm障碍物)
 *      - DANGER_ADC_THRESH: 2400 (10cm近距离)
 * 
 *   C. Gene::evaluateCondition() 修复
 *      - COND_IDLE 使用原始ADC值判断
 *      - COND_SENSOR_BOTH/ANY 直接比较原始值
 * 
 *   D. 注入"避障种子个体"
 *      - 个体0预设3条规则：左转避障/右转避障/直行
 *      - 确保进化开始时有可工作的行为
 * 
 *   E. 增加传感器调试日志
 *      - 每100帧输出传感器ADC值
 *      - 便于验证传感器-控制链路是否导通
 * 
 * ================================================================ 
 * 20260815 首次烧录时完成了一个代码修改： initWiFi() 函数中的日志调用，使用 Logger::logf() 或先将 String 转换为 const char*：
 * 可惜本代码没有基因存储代码，20代的基因全部丢失。而且本代码也没有卡死检测，所以完全没有进化，有完整的数据，也有录像资料。
 */
/* 
 * ================================================================ 
 * 项目名称：仿草履虫应激机制 - 脱困能力进化系统 
 * 版本： v8.7-robust (完整基因存储 + 二进制帧日志 + 原子写入)
 * 适配日期: 2026-08-15
 * ================================================================ 
 * 
 * 【v8.7 重大改动说明】
 * ================================================================
 * 
 * 改动原因：
 *   1. 原代码仅保存历史摘要（新颖度/存活/距离/规则数），
 *      完整基因（每条规则的具体内容）从未被持久化。
 *   2. 帧日志（FrameLogEntry）仅保存在RAM环形缓冲区，
 *      测试结束后丢失，无法用于行为分析。
 *   3. 数据写入无原子性保证，SPIFFS写入中断可能导致文件损坏。
 *   4. 实验状态无法恢复，重启后所有RAM数据丢失。
 * 
 * 新增功能：
 *   1. GeneStorage 类：完整基因的原子保存与加载
 *      - 种群快照：/pop_gen_N.bin（二进制，含所有个体的完整规则）
 *      - 个体记录：/gen_N_id_X.csv（CSV，人类可读的规则详情）
 *      - 帧日志：/frm_N_iX.bin（二进制，每帧11字节）
 *      - 汇总历史：/oe_history.csv（与之前兼容）
 * 
 *   2. 原子写入策略（FileUtils::atomicWrite）
 *      - 先写临时文件 → 验证大小 → 重命名为正式文件
 *      - 任何步骤失败都不会留下损坏的文件
 * 
 *   3. 实验生命周期管理
 *      - 每轮固定20代，自动检测新实验并清理旧数据
 *      - 实验状态持久化到 /experiment_state.mrk
 *      - 重启后自动恢复实验进度
 * 
 *   4. 数据完整性保证
 *      - 写入后立即验证
 *      - 文件头包含魔数和版本号
 *      - 所有操作都有错误日志
 * 
 * 存储空间需求（二进制帧日志）：
 *   - 种群快照：~3KB/代 × 20 = 60KB
 *   - 个体记录：~1KB/代 × 20 = 20KB
 *   - 帧日志：~45KB/代 × 20 = 900KB
 *   - 汇总历史：~1KB
 *   - 总计：~1MB（适合1.5-2MB SPIFFS）
 * 
 * ================================================================
 * 【Python 解析二进制数据的方法】
 * ================================================================
 * 
 * 一、解析种群快照 /pop_gen_N.bin
 * 
 * 文件格式：
 *   Offset  Size    Field
 *   0       4       magic = 0x47454E45 ("GENE")
 *   4       2       version = 0x0002
 *   6       2       population_size (16)
 *   8       4       generation
 *   12      4       experiment_id
 *   16      ...     每个个体依次存储
 * 
 * 每个个体的格式：
 *   Offset  Size    Field
 *   0       1       ruleCount (2-16)
 *   1       N*12    规则数组 (N = ruleCount)
 *   1+N*12  4       survival_time (uint32_t)
 *   5+N*12  4       distance_ticks (int32_t)
 *   9+N*12  4       noveltyScore (float)
 * 
 * 每条规则的格式 (BehaviorRule, 12字节)：
 *   Offset  Size    Field
 *   0       1       condType (0-7)
 *   1       2       condValue (int16_t)
 *   3       1       condOp (0-2)
 *   4       2       motorL (int16_t, -255~255)
 *   6       2       motorR (int16_t, -255~255)
 *   8       2       durationMs (uint16_t)
 *   10      1       nextRule (0~ruleCount)
 *   11      1       padding (对齐)
 * 
 * Python 解析代码见文件末尾注释。
 * 
 * 二、解析帧日志 /frm_N_iX.bin
 * 
 * 文件格式：每帧固定 11 字节，无文件头，连续存储
 * 
 * 每帧格式：
 *   Offset  Size    Field
 *   0       4       timestamp_ms (uint32_t)
 *   4       2       sensorLeft (int16_t, ADC值 0-4095)
 *   6       2       sensorRight (int16_t, ADC值 0-4095)
 *   8       1       motorLeftPWM (uint8_t, 0-255)
 *   9       1       motorRightPWM (uint8_t, 0-255)
 *   10      1       direction (bit0=dirL, bit1=dirR)
 * 
 * 方向解码：
 *   dirL = (direction >> 0) & 1
 *   dirR = (direction >> 1) & 1
 * 
 * Python 解析代码见文件末尾注释。
 * 
 * ================================================================
 */


/* 
 * ================================================================ 
 * 项目名称：仿草履虫应激机制 - 脱困能力进化系统 
 * 版本： v8.8-oe-stuck (卡死感知 + 混沌脱困融合版)
 * 适配日期: 2026-08-15
 * ================================================================ 
 * 
 * 【v8.8 重大改动说明】
 * ================================================================
 * 
 * 改动原因：
 *   1. v8.0-v8.7 重构时，原有的混沌/卡死检测逻辑（v7.3）被"行为表规则替代"，
 *      但没有等价功能补上，导致小车卡死后轮子空转但感知不到。
 *   2. 卡死后编码器仍计数，物理动作永不终止，所有个体都活满30秒，
 *      进化没有选择压力，退化为随机游走。
 * 
 * 新增功能：
 *   1. 卡死检测（硬编码基础设施）
 *      - 检测条件：轮子在转（速度>50）但传感器变化很小（<30）
 *      - 持续50帧（约0.5秒）触发 stuckFlag = true
 * 
 *   2. COND_STUCK 条件类型（基因可触发）
 *      - 行为表规则可以检测卡死状态
 *      - 触发后执行脱困动作（转向/后退）
 * 
 *   3. COND_ESCAPE 条件类型（防止循环触发）
 *      - 脱困执行期间标记 escapeActive = true
 *      - 防止脱困过程中重复触发卡死
 * 
 *   4. 种子个体包含卡死脱困规则
 *      - 规则4: 卡死时后退右转脱困
 * 
 * 设计哲学：
 *   - 卡死检测 = 硬编码基础设施（生存保障，不预设"什么是好行为"）
 *   - 脱困行为 = 基因中的规则控制（可进化，符合OEE理念）
 *   - 阈值 = 固定（后续版本可进化为基因参数）
 * 
 * ================================================================
 */

/* 
 * ================================================================ 
 * 项目名称：仿草履虫应激机制 - 脱困能力进化系统 
 * 版本： v8.8-oe-stuck-fixed (修复编译错误)
 * 适配日期: 2026-08-15
 * ================================================================ 
 * 
 * 【修复说明】
 * 将 GeneStorage 类的定义移到 Gene 结构体之后，
 * 解决 "invalid use of incomplete type 'struct Gene'" 编译错误。
 * ================================================================
 */

/* 
 * ================================================================ 
 * 项目名称：仿草履虫应激机制 - 脱困能力进化系统 
 * 版本： v8.9-robust-stable (鲁棒性增强版)
 * 适配日期: 2026-08-15
 * ================================================================ 
 * 
 * 【v8.9 鲁棒性增强 - 修复电机无法启动问题】
 * ================================================================
 * 
 * 问题根因分析 (基于 v8.8-oe-stuck 实机测试)：
 * ───────────────────────────────────────────
 * 问题现象：烧录后 Web 显示正常，解锁电机后没有任何响应，LED也不闪烁。
 * 
 * 根因1（致命）：状态机死锁
 *   - ruleActive=true 但 actionInProgress=false 时，update() 进入 else 分支
 *   - 如果 nextRule=0，ruleActive 永远不会被重置为 false
 *   - 导致状态机永远停留在"已激活但无动作"状态，无法重新匹配规则
 *   - 修复：stopMotors() 中强制重置 ruleActive=false，同时重置 currentRuleIndex
 * 
 * 根因2（致命）：种群数据损坏或无有效个体
 *   - loadPopulation() 加载的种群可能 ruleCount=0 或全零规则
 *   - 规则循环不执行 → stopMotors() 被调用 → 电机永远停止
 *   - 修复：loadPopulation() 中增加数据完整性验证，自动修复损坏个体
 * 
 * 根因3（致命）：种子个体被覆盖或未正确创建
 *   - 加载失败时创建种子个体，但加载成功时可能个体0被损坏数据覆盖
 *   - 修复：initImpl() 末尾强制验证并重建种子个体
 * 
 * 根因4（严重）：startPhysicsAction() 未检查 motorEnabled
 *   - 电机锁定时调用 startPhysicsAction() 会静默失败
 *   - 修复：startPhysicsAction() 开头检查 motorEnabled，返回 false 表示失败
 * 
 * 根因5（严重）：update() 中无规则匹配时没有 logFrame()
 *   - 导致帧日志缺失，无法分析行为
 *   - 修复：无规则匹配时也记录帧日志
 * 
 * 根因6（中等）：Web 状态未显示关键调试信息
 *   - 看不到 ruleCount、stuckFlag、escapeActive 等状态
 *   - 修复：handleStatus() 增加这些字段
 * 
 * ================================================================
 * 【v8.9 具体修复措施】
 * ================================================================
 * 
 * 一、状态机鲁棒性增强
 * ───────────────────────────────────────────
 * 1. stopMotors() 完整重置：actionInProgress=false, ruleActive=false, 
 *    currentRuleIndex=0, actionStallFrames=0
 * 2. 新增 emergencyReset() 紧急重置所有状态
 * 3. startPhysicsAction() 返回 bool，检查 motorEnabled
 * 
 * 二、种群数据完整性保障
 * ───────────────────────────────────────────
 * 4. GeneStorage::validateIndividual() 验证个体完整性
 * 5. GeneStorage::repairIndividual() 自动修复损坏个体
 * 6. loadPopulation() 加载后自动验证并修复
 * 7. initImpl() 末尾强制确保 population[0] 有效
 * 
 * 三、种子个体强化
 * ───────────────────────────────────────────
 * 8. createSeedIndividual() 规则数从5增加到6，增加兜底规则
 * 9. 规则顺序优化：传感器→空闲→卡死→始终（确保有规则匹配）
 * 10. createSeededPopulation() 创建多个种子个体
 * 
 * 四、日志与调试增强
 * ───────────────────────────────────────────
 * 11. update() 中增加 ruleCount 日志
 * 12. handleStatus() 增加 ruleCount, stuckFlag, escapeActive
 * 13. 启动时打印种群摘要
 * 
 * 五、硬件自检增强
 * ───────────────────────────────────────────
 * 14. HardwareTest::runQuick() 快速自检
 * 15. 启动时自动运行快速自检
 * 
 * ================================================================
 * 【与 v8.8 的关键差异】
 * ================================================================
 * 
 * ┌──────────────────┬─────────────────────┬─────────────────────┐
 * │ 维度             │ v8.8-oe-stuck       │ v8.9-robust-stable  │
 * ├──────────────────┼─────────────────────┼─────────────────────┤
 * │ stopMotors()     │ 重置部分状态        │ 完整重置所有状态    │
 * │ 种群加载         │ 无验证              │ 自动验证+修复       │
 * │ 种子个体保障     │ 仅加载失败时创建    │ 始终确保有效        │
 * │ startPhysicsAction│ 无返回值           │ 返回bool表示成功    │
 * │ 帧日志           │ 动作中记录          │ 所有状态都记录      │
 * │ 调试信息         │ 基本状态            │ 完整状态+规则数     │
 * │ 硬件自检         │ 需手动调用          │ 自动快速自检        │
 * └──────────────────┴─────────────────────┴─────────────────────┘
 * ================================================================
 */

/* 
 * ================================================================ 
 * 项目名称：仿草履虫应激机制 - 脱困能力进化系统 
 * 版本： v8.7-robust (完整基因存储 + 二进制帧日志 + 原子写入)
 * 适配日期: 2026-08-15
 * ================================================================ 
 * 
 * 【v8.7 重大改动说明】
 * ================================================================
 * 
 * 改动原因：
 *   1. 原代码仅保存历史摘要（新颖度/存活/距离/规则数），
 *      完整基因（每条规则的具体内容）从未被持久化。
 *   2. 帧日志（FrameLogEntry）仅保存在RAM环形缓冲区，
 *      测试结束后丢失，无法用于行为分析。
 *   3. 数据写入无原子性保证，SPIFFS写入中断可能导致文件损坏。
 *   4. 实验状态无法恢复，重启后所有RAM数据丢失。
 * 
 * 新增功能：
 *   1. GeneStorage 类：完整基因的原子保存与加载
 *      - 种群快照：/pop_gen_N.bin（二进制，含所有个体的完整规则）
 *      - 个体记录：/gen_N_id_X.csv（CSV，人类可读的规则详情）
 *      - 帧日志：/frm_N_iX.bin（二进制，每帧11字节）
 *      - 汇总历史：/oe_history.csv（与之前兼容）
 * 
 *   2. 原子写入策略（FileUtils::atomicWrite）
 *      - 先写临时文件 → 验证大小 → 重命名为正式文件
 *      - 任何步骤失败都不会留下损坏的文件
 * 
 *   3. 实验生命周期管理
 *      - 每轮固定20代，自动检测新实验并清理旧数据
 *      - 实验状态持久化到 /experiment_state.mrk
 *      - 重启后自动恢复实验进度
 * 
 *   4. 数据完整性保证
 *      - 写入后立即验证
 *      - 文件头包含魔数和版本号
 *      - 所有操作都有错误日志
 * 
 * 存储空间需求（二进制帧日志）：
 *   - 种群快照：~3KB/代 × 20 = 60KB
 *   - 个体记录：~1KB/代 × 20 = 20KB
 *   - 帧日志：~45KB/代 × 20 = 900KB
 *   - 汇总历史：~1KB
 *   - 总计：~1MB（适合1.5-2MB SPIFFS）
 * 
 * ================================================================
 * 【Python 解析二进制数据的方法】
 * ================================================================
 * 
 * 一、解析种群快照 /pop_gen_N.bin
 * 
 * 文件格式：
 *   Offset  Size    Field
 *   0       4       magic = 0x47454E45 ("GENE")
 *   4       2       version = 0x0002
 *   6       2       population_size (16)
 *   8       4       generation
 *   12      4       experiment_id
 *   16      ...     每个个体依次存储
 * 
 * 每个个体的格式：
 *   Offset  Size    Field
 *   0       1       ruleCount (2-16)
 *   1       N*12    规则数组 (N = ruleCount)
 *   1+N*12  4       survival_time (uint32_t)
 *   5+N*12  4       distance_ticks (int32_t)
 *   9+N*12  4       noveltyScore (float)
 * 
 * 每条规则的格式 (BehaviorRule, 12字节)：
 *   Offset  Size    Field
 *   0       1       condType (0-7)
 *   1       2       condValue (int16_t)
 *   3       1       condOp (0-2)
 *   4       2       motorL (int16_t, -255~255)
 *   6       2       motorR (int16_t, -255~255)
 *   8       2       durationMs (uint16_t)
 *   10      1       nextRule (0~ruleCount)
 *   11      1       padding (对齐)
 * 
 * Python 解析代码见文件末尾注释。
 * 
 * 二、解析帧日志 /frm_N_iX.bin
 * 
 * 文件格式：每帧固定 11 字节，无文件头，连续存储
 * 
 * 每帧格式：
 *   Offset  Size    Field
 *   0       4       timestamp_ms (uint32_t)
 *   4       2       sensorLeft (int16_t, ADC值 0-4095)
 *   6       2       sensorRight (int16_t, ADC值 0-4095)
 *   8       1       motorLeftPWM (uint8_t, 0-255)
 *   9       1       motorRightPWM (uint8_t, 0-255)
 *   10      1       direction (bit0=dirL, bit1=dirR)
 * 
 * 方向解码：
 *   dirL = (direction >> 0) & 1
 *   dirR = (direction >> 1) & 1
 * 
 * Python 解析代码见文件末尾注释。
 * 
 * ================================================================
 */

/* 
 * ================================================================ 
 * 项目名称：仿草履虫应激机制 - 脱困能力进化系统 
 * 版本： v8.9-chaos (混沌机制完整实现版)
 * 适配日期: 2026-08-15
 * ================================================================ 
 * 
 * 【v8.9-chaos 基于 v8.9-robust-stable 的增量修改】
 * ================================================================
 * 
 * 问题背景：
 *   1. v8.8 中加入了 COND_STUCK 和 COND_ESCAPE 条件类型，
 *      但 evaluateCondition() 从未实现这两种条件的判断逻辑
 *   2. 卡死检测变量（stuckFlag, stuckCounter, escapeActive）
 *      未在 MotorController 中正确定义和初始化
 *   3. 静态成员变量缺少类外部定义，导致链接错误/运行时崩溃
 *   4. 种子个体包含 COND_STUCK 规则，但永远无法被触发
 *   5. 硬件初始化因静态变量未定义而失败
 * 
 * ================================================================
 * 【v8.9-chaos 新增/修改内容】
 * ================================================================
 * 
 * 一、枚举类型扩展
 * ───────────────────────────────────────────
 * 1. [新增] CondType 枚举增加 COND_STUCK = 8, COND_ESCAPE = 9
 * 
 * 二、MotorController 混沌变量
 * ───────────────────────────────────────────
 * 2. [新增] 静态成员变量：stuckFlag, stuckCounter, escapeActive,
 *    lastSensorSum, lastSpeedSum
 * 3. [新增] 静态变量在类外定义并初始化为 0/false
 * 4. [新增] 访问器方法：isStuck(), isEscapeActive(), 
 *    setEscapeActive(), resetStuck()
 * 
 * 三、卡死检测逻辑 (物理感知)
 * ───────────────────────────────────────────
 * 5. [新增] MotorController::update() 中实现卡死检测：
 *    - 检测条件：轮子在转（速度>50）且传感器变化很小（<30）
 *    - 持续 50 帧（约 0.5 秒）触发 stuckFlag = true
 *    - 传感器变化大时自动恢复
 * 
 * 四、条件评估支持混沌条件
 * ───────────────────────────────────────────
 * 6. [修复] Gene::evaluateCondition() 增加 case COND_STUCK 和
 *    case COND_ESCAPE，调用 MotorController 的静态方法
 * 
 * 五、规则执行状态管理
 * ───────────────────────────────────────────
 * 7. [新增] 规则匹配时检测 condType == COND_STUCK → 设置 escapeActive
 * 8. [新增] 规则匹配时检测 condType == COND_ESCAPE → 清除 escapeActive
 * 
 * 六、种子个体增强 (混沌脱困行为)
 * ───────────────────────────────────────────
 * 9. [增强] createSeedIndividual() 规则数从 3 增加到 6
 * 10.[新增] 规则3: COND_STUCK → 后退右转脱困 (nextRule=4)
 * 11.[新增] 规则4: COND_ESCAPE → 清除状态
 * 12.[新增] 规则5: 兜底规则 → 前进
 * 
 * 七、Web 界面增强
 * ───────────────────────────────────────────
 * 13.[新增] handleStatus() JSON 增加 stuckFlag, escapeActive, stuckCounter
 * 14.[新增] Web 界面显示卡死/脱困状态指示器
 * 
 * ================================================================
 * 【与 v8.9-robust-stable 的关键差异】
 * ================================================================
 * 
 * ┌──────────────────┬─────────────────────────┬─────────────────────────┐
 * │ 维度             │ v8.9-robust-stable      │ v8.9-chaos              │
 * ├──────────────────┼─────────────────────────┼─────────────────────────┤
 * │ 卡死检测         │ 无                      │ ✅ 轮转传感器不动       │
 * │ COND_STUCK       │ 定义但不可用            │ ✅ 完整实现             │
 * │ COND_ESCAPE      │ 定义但不可用            │ ✅ 完整实现             │
 * │ 混沌变量         │ 未定义                  │ ✅ 正确声明+定义        │
 * │ 种子个体规则数   │ 3 条                    │ 6 条 (含混沌脱困)       │
 * │ Web 混沌状态显示 │ 无                      │ ✅ 卡死/脱困指示灯     │
 * └──────────────────┴─────────────────────────┴─────────────────────────┘
 * 
 * ================================================================
 * 【硬件初始化失败根因与修复】
 * ================================================================
 * 
 * 问题：烧录后硬件无法初始化，电机无响应，LED不闪烁
 * 
 * 根因分析：
 *   1. 在 MotorController 类中声明了静态成员变量 (stuckFlag等)
 *   2. 但未在类外定义它们 (分配存储空间)
 *   3. 编译通过（声明存在），但链接/运行时这些变量指向未分配内存
 *   4. 硬件初始化函数访问未定义变量时导致崩溃
 * 
 * 修复方法：
 *   - 在文件末尾（静态变量定义区域）为每个静态成员提供定义
 *   - 定义格式：类型 ClassName::variableName = 初始值;
 *   - 确保所有静态变量在使用前已定义
 * 
 * ================================================================
 */

/* 
 * ================================================================ 
 * 项目名称：仿草履虫应激机制 - 脱困能力进化系统 
 * 版本： v8.9-chaos-v2 (纯编码器差值卡死检测)
 * 适配日期: 2026-08-15
 * ================================================================ 
 * 
 * 【设计思路】
 * ================================================================
 * 
 * 一、核心思想
 * ───────────────────────────────────────────
 * 卡死 = 轮子转（电机有PWM）但车不动（左右编码器差值持续增大）
 * 
 * 二、检测算法
 * ───────────────────────────────────────────
 *   1. 分别累计左编码器（leftTicks）和右编码器（rightTicks）
 *   2. 计算差值：diff = abs(leftTicks - rightTicks)
 *   3. 检测条件：
 *      - diff > 100（差值超过阈值）
 *      - diff 持续增大（diff > lastDiff + 5）
 *      - 轮子在转（currentSpeedL > 30 || currentSpeedR > 30）
 *      - 不在脱困状态（!escapeActive）
 *   4. 持续时间 > 1 秒 → 确认卡死，触发 COND_STUCK
 * 
 * 三、为什么不用传感器
 * ───────────────────────────────────────────
 *   - 红外传感器受环境光、物体颜色、角度影响大
 *   - 读数跳动剧烈，误报率极高
 *   - 编码器是物理测量，可靠得多
 * 
 * ================================================================
 */

/* 
 * ================================================================ 
 * 项目名称：仿草履虫应激机制 - 脱困能力进化系统 
 * 版本： v8.9-chaos-v4 (双模式卡死检测 + 完整Web下载)
 * 适配日期: 2026-08-15
 * ================================================================ 
 * 
 * 【v8.9-chaos-v4 卡死检测逻辑】
 * ================================================================
 * 
 * 模式1：编码器差值卡死 (两轮都转但差值持续增大)
 *   - 条件：diff > 50 且持续增大，两轮都在转
 *   - 持续 1 秒 → 触发卡死
 * 
 * 模式2：单轮卡死 (一个轮子转，另一个轮子停)
 *   - 条件：左轮转(>30) 且 右轮停(<10) 或 反之
 *   - 持续 1 秒 → 触发卡死
 * 
 * 模式3：大差值兜底
 *   - 条件：diff > 100，任意轮子在转
 *   - 持续 1 秒 → 触发卡死
 * 
 * ================================================================
 */

#include <WiFi.h>
#include <WebServer.h>
#include <FS.h>
#include <SPIFFS.h>
#include <vector>
#include <algorithm>
#include <cstdarg>
#include <cstdio>
#include <cmath>
#include <cstring>

// ================================================================
// 硬件引脚定义
// ================================================================
#define PIN_SENSOR_LEFT     4
#define PIN_SENSOR_RIGHT    5
#define PIN_NOISE_SOURCE    35
#define PIN_OBSTACLE_INT    39
#define PIN_LED             14
#define PIN_LEFT_PWM        9
#define PIN_LEFT_DIR2       46
#define PIN_RIGHT_PWM       16
#define PIN_RIGHT_DIR2      15
#define PIN_LEFT_ENC_A      18
#define PIN_LEFT_ENC_B      17
#define PIN_RIGHT_ENC_A     11
#define PIN_RIGHT_ENC_B     10

// ================================================================
// LEDC 配置
// ================================================================
#define LEDC_FREQ           5000
#define LEDC_RESOLUTION     8
#define LEDC_CHANNEL_LEFT   0
#define LEDC_CHANNEL_RIGHT  1

// ================================================================
// 电机方向定义
// ================================================================
#define LEFT_FORWARD   HIGH
#define LEFT_REVERSE   LOW
#define RIGHT_FORWARD  LOW
#define RIGHT_REVERSE  HIGH

// ================================================================
// 电机增益
// ================================================================
#define LEFT_GAIN   1.00f
#define RIGHT_GAIN  1.00f

// ================================================================
// WiFi 配置
// ================================================================
#define WIFI_SSID           "CarLogger"
#define WIFI_PASSWORD       "12345678"

// ================================================================
// 进化参数
// ================================================================
#define POPULATION_SIZE     16
#define TEST_DURATION_MS    30000
#define LOOP_DELAY_MS       10

// ================================================================
// 物理动作参数
// ================================================================
#define PHYSICS_STALL_FRAMES    10
#define PHYSICS_MAX_ACTION_MS   3000

// ================================================================
// 传感器阈值
// ================================================================
#define CLEAR_ADC_THRESH     600
#define OBSTACLE_ADC_THRESH  1500

// ================================================================
// 行为规则参数
// ================================================================
#define MAX_RULES           16
#define MIN_RULES           2
#define MAX_RULE_DURATION   2000
#define MIN_RULE_DURATION   50

// ================================================================
// Novelty Search 参数
// ================================================================
#define NOVELTY_ARCHIVE_MAX    200
#define NOVELTY_K_NEAREST      5
#define NOVELTY_ADD_THRESHOLD  0.15f

// ================================================================
// 存储参数
// ================================================================
#define STORAGE_SAVE_INTERVAL_MS  10000
#define FRAME_LOG_SIZE            256

// ================================================================
// 固件版本
// ================================================================
#define FIRMWARE_VERSION "v8.9-chaos-v4"
#define VERSION_MARKER_FILE "/version_" FIRMWARE_VERSION ".mrk"

// ================================================================
// 【v8.9-chaos-v4】卡死检测参数
// ================================================================
#define ENCODER_DIFF_THRESHOLD   50     // 差值阈值
#define ENCODER_STUCK_DURATION   1000   // 持续1秒确认卡死
#define ENCODER_DIFF_MIN         5      // 差值最小增量
#define WHEEL_SPIN_THRESHOLD     30     // 轮子转动速度阈值
#define WHEEL_STOP_THRESHOLD     10     // 轮子停止速度阈值

// ================================================================
// 条件类型枚举
// ================================================================
enum CondType : uint8_t {
    COND_SENSOR_LEFT  = 0,
    COND_SENSOR_RIGHT = 1,
    COND_SENSOR_BOTH  = 2,
    COND_SENSOR_ANY   = 3,
    COND_DISTANCE     = 4,
    COND_TIME         = 5,
    COND_IDLE         = 6,
    COND_ALWAYS       = 7,
    COND_STUCK        = 8,
    COND_ESCAPE       = 9
};

enum CondOp : uint8_t {
    OP_GREATER = 0,
    OP_LESS    = 1,
    OP_EQUAL   = 2
};

// ================================================================
// 行为规则结构体
// ================================================================
struct BehaviorRule {
    uint8_t  condType;
    int16_t  condValue;
    uint8_t  condOp;
    int16_t  motorL;
    int16_t  motorR;
    uint16_t durationMs;
    uint8_t  nextRule;
    uint8_t  _padding;

    void randomize() {
        condType   = random(0, 10);
        condValue  = random(-3000, 3000);
        condOp     = random(0, 3);
        motorL     = random(-255, 255);
        motorR     = random(-255, 255);
        durationMs = random(MIN_RULE_DURATION, MAX_RULE_DURATION);
        nextRule   = random(0, 3);
        _padding   = 0;
    }
    
    void clamp() {
        motorL     = constrain(motorL, -255, 255);
        motorR     = constrain(motorR, -255, 255);
        durationMs = constrain(durationMs, MIN_RULE_DURATION, MAX_RULE_DURATION);
        condType   = constrain(condType, (uint8_t)0, (uint8_t)9);
        condOp     = constrain(condOp, (uint8_t)0, (uint8_t)2);
    }
    
    bool compare(int value, int op, int threshold) const {
        switch (op) {
            case OP_GREATER: return value > threshold;
            case OP_LESS:    return value < threshold;
            case OP_EQUAL:   return abs(value - threshold) < 50;
            default: return false;
        }
    }
};

// ================================================================
// 行为描述符
// ================================================================
struct BehaviorDescriptor {
    float leftSensorMean, rightSensorMean;
    float sensorVariance, sensorAsymmetry;
    float avgSpeed, speedVariance, turnBias, totalDistance;
    float forwardRatio, turnRatio, reverseRatio, idleRatio;

    void init() {
        leftSensorMean = rightSensorMean = 0;
        sensorVariance = sensorAsymmetry = 0;
        avgSpeed = speedVariance = turnBias = totalDistance = 0;
        forwardRatio = turnRatio = reverseRatio = idleRatio = 0;
    }

    float distance(const BehaviorDescriptor& other) const {
        float sum = 0, d;
        d = leftSensorMean - other.leftSensorMean; sum += d*d;
        d = rightSensorMean - other.rightSensorMean; sum += d*d;
        d = sensorVariance - other.sensorVariance; sum += d*d;
        d = sensorAsymmetry - other.sensorAsymmetry; sum += d*d;
        d = avgSpeed - other.avgSpeed; sum += d*d;
        d = speedVariance - other.speedVariance; sum += d*d;
        d = turnBias - other.turnBias; sum += d*d;
        d = totalDistance - other.totalDistance; sum += d*d;
        d = forwardRatio - other.forwardRatio; sum += d*d;
        d = turnRatio - other.turnRatio; sum += d*d;
        d = reverseRatio - other.reverseRatio; sum += d*d;
        d = idleRatio - other.idleRatio; sum += d*d;
        return sqrtf(sum);
    }

    void normalize(const BehaviorDescriptor& maxVals) {
        if (maxVals.leftSensorMean > 0) leftSensorMean /= maxVals.leftSensorMean;
        if (maxVals.rightSensorMean > 0) rightSensorMean /= maxVals.rightSensorMean;
        if (maxVals.sensorVariance > 0) sensorVariance /= maxVals.sensorVariance;
        if (maxVals.avgSpeed > 0) avgSpeed /= maxVals.avgSpeed;
        if (maxVals.speedVariance > 0) speedVariance /= maxVals.speedVariance;
        if (maxVals.totalDistance > 0) totalDistance /= maxVals.totalDistance;
    }
};

// ================================================================
// 帧日志条目
// ================================================================
struct FrameLogEntry {
    uint32_t timestamp_ms;
    int16_t  sensorLeft;
    int16_t  sensorRight;
    uint8_t  motorLeftPWM;
    uint8_t  motorRightPWM;
    uint8_t  directionL : 1;
    uint8_t  directionR : 1;
    uint8_t  reserved   : 6;
};

// ================================================================
// 历史记录
// ================================================================
struct HistoryRecord {
    uint32_t timestamp;
    uint32_t generation;
    float    noveltyScore;
    uint32_t survivalTime;
    int32_t  distance_ticks;
    uint8_t  ruleCount;
    uint8_t  reserved[3];
};

// ================================================================
// 前向声明
// ================================================================
struct Gene;
class Logger;
class SensorCalibration;
class RobustStorage;
class GeneStorage;
class NoveltyArchive;
class MotorController;
class EvolutionEngine;
class CarWebServer;

// ================================================================
// Logger 类
// ================================================================
class Logger {
public:
    static void init() { Serial.begin(115200); delay(500); }
    static void log(const char* msg) {
        Serial.println("[OE] " + String(millis()/1000) + "s " + String(msg));
    }
    static void logf(const char* fmt, ...) {
        char buf[256];
        va_list args;
        va_start(args, fmt);
        vsnprintf(buf, sizeof(buf), fmt, args);
        va_end(args);
        log(buf);
    }
};

// ================================================================
// SensorCalibration 类
// ================================================================
class SensorCalibration {
private:
    static int leftBase, rightBase;
    
public:
    static void calibrate() {
        Logger::log("传感器校准中...");
        delay(1000);
        const int samples = 50;
        long sumL = 0, sumR = 0;
        for (int i = 0; i < samples; i++) {
            sumL += analogRead(PIN_SENSOR_LEFT);
            sumR += analogRead(PIN_SENSOR_RIGHT);
            delay(10);
        }
        leftBase = sumL / samples;
        rightBase = sumR / samples;
        Logger::logf("校准完成: 左Base=%d 右Base=%d", leftBase, rightBase);
    }
    
    static int getLeftRaw() { return analogRead(PIN_SENSOR_LEFT); }
    static int getRightRaw() { return analogRead(PIN_SENSOR_RIGHT); }
    static bool isObstacleLeft() { return analogRead(PIN_SENSOR_LEFT) > OBSTACLE_ADC_THRESH; }
    static bool isObstacleRight() { return analogRead(PIN_SENSOR_RIGHT) > OBSTACLE_ADC_THRESH; }
    static bool isClear() {
        return (analogRead(PIN_SENSOR_LEFT) < CLEAR_ADC_THRESH && 
                analogRead(PIN_SENSOR_RIGHT) < CLEAR_ADC_THRESH);
    }
    static uint16_t readNoise() { return analogRead(PIN_NOISE_SOURCE); }
};

int SensorCalibration::leftBase = 0;
int SensorCalibration::rightBase = 0;

// ================================================================
// RobustStorage 类
// ================================================================
class RobustStorage {
private:
    static const char* HISTORY_FILE;
    static bool fsReady;
    static uint32_t lastSaveTime;
    static uint32_t unsavedCount;
    static uint32_t totalSaved;
    static String pendingBuffer;
    static const size_t MAX_BUFFER_SIZE = 4096;
    static HistoryRecord ramHistory[1000];
    static int ramHistoryCount;

    static bool appendToFile(const char* path, const String& data) {
        if (!fsReady) return false;
        File file = SPIFFS.open(path, FILE_APPEND);
        if (!file) {
            file = SPIFFS.open(path, FILE_WRITE);
            if (!file) return false;
        }
        size_t written = file.print(data);
        file.close();
        return written == data.length();
    }

    static void loadHistory() {
        if (!fsReady) return;
        File file = SPIFFS.open(HISTORY_FILE, FILE_READ);
        if (!file) return;
        int count = 0;
        while (file.available() && count < 1000) {
            String line = file.readStringUntil('\n');
            if (line.length() < 10) continue;
            int partIdx = 0;
            String parts[6];
            for (int i = 0; i < line.length() && partIdx < 6; i++) {
                if (line[i] == ',') { partIdx++; continue; }
                parts[partIdx] += line[i];
            }
            if (partIdx == 5) {
                ramHistory[count].timestamp = parts[0].toInt();
                ramHistory[count].generation = parts[1].toInt();
                ramHistory[count].noveltyScore = parts[2].toFloat();
                ramHistory[count].survivalTime = parts[3].toInt();
                ramHistory[count].distance_ticks = parts[4].toInt();
                ramHistory[count].ruleCount = parts[5].toInt();
                count++;
            }
        }
        ramHistoryCount = count;
        file.close();
    }

public:
    static void init() {
        fsReady = false;
        lastSaveTime = 0;
        unsavedCount = 0;
        totalSaved = 0;
        ramHistoryCount = 0;
        pendingBuffer.reserve(MAX_BUFFER_SIZE);
        if (!SPIFFS.begin(true)) {
            Logger::log("⚠️ SPIFFS 挂载失败，使用 RAM 模式");
            fsReady = false;
        } else {
            fsReady = true;
            Logger::log("✅ SPIFFS 挂载成功");
            loadHistory();
        }
    }

    static void addRecord(const HistoryRecord& record) {
        if (ramHistoryCount < 1000) {
            ramHistory[ramHistoryCount++] = record;
        } else {
            for (int i = 1; i < 1000; i++) ramHistory[i-1] = ramHistory[i];
            ramHistory[999] = record;
        }
        char line[256];
        snprintf(line, sizeof(line), "%lu,%lu,%.4f,%lu,%ld,%d\n",
                 record.timestamp, record.generation, record.noveltyScore,
                 record.survivalTime, record.distance_ticks, record.ruleCount);
        pendingBuffer += String(line);
        unsavedCount++;
        totalSaved++;
        if (pendingBuffer.length() > MAX_BUFFER_SIZE || unsavedCount >= 5) flushBuffer();
    }

    static bool flushBuffer() {
        if (pendingBuffer.length() == 0) { unsavedCount = 0; return true; }
        if (!fsReady) {
            pendingBuffer = "";
            unsavedCount = 0;
            lastSaveTime = millis();
            return true;
        }
        bool success = appendToFile(HISTORY_FILE, pendingBuffer);
        if (success) {
            pendingBuffer = "";
            unsavedCount = 0;
            lastSaveTime = millis();
        }
        return success;
    }

    static void forceSave() { if (pendingBuffer.length() > 0) flushBuffer(); }
    static bool isReady() { return fsReady; }
    static uint32_t getTotalSaved() { return totalSaved; }
    static void tick() {
        if (millis() - lastSaveTime > STORAGE_SAVE_INTERVAL_MS && pendingBuffer.length() > 0) flushBuffer();
    }
    static void clearAll() { pendingBuffer = ""; unsavedCount = 0; ramHistoryCount = 0; }
    static String getCSVData() {
        if (pendingBuffer.length() > 0) flushBuffer();
        if (fsReady) {
            File file = SPIFFS.open(HISTORY_FILE, FILE_READ);
            if (file) { String content = file.readString(); file.close(); return content; }
        }
        String csv = "timestamp,generation,noveltyScore,survivalTime,distance_ticks,ruleCount\n";
        for (int i = 0; i < ramHistoryCount; i++) {
            csv += String(ramHistory[i].timestamp) + ",";
            csv += String(ramHistory[i].generation) + ",";
            csv += String(ramHistory[i].noveltyScore, 4) + ",";
            csv += String(ramHistory[i].survivalTime) + ",";
            csv += String(ramHistory[i].distance_ticks) + ",";
            csv += String(ramHistory[i].ruleCount) + "\n";
        }
        return csv;
    }
};

const char* RobustStorage::HISTORY_FILE = "/oe_history.csv";
bool RobustStorage::fsReady = false;
uint32_t RobustStorage::lastSaveTime = 0;
uint32_t RobustStorage::unsavedCount = 0;
uint32_t RobustStorage::totalSaved = 0;
String RobustStorage::pendingBuffer = "";
HistoryRecord RobustStorage::ramHistory[1000];
int RobustStorage::ramHistoryCount = 0;

// ================================================================
// FirmwareVersionManager 类
// ================================================================
class FirmwareVersionManager {
public:
    static bool isNewVersion() {
        if (!RobustStorage::isReady()) return true;
        if (!SPIFFS.exists(VERSION_MARKER_FILE)) return true;
        File marker = SPIFFS.open(VERSION_MARKER_FILE, FILE_READ);
        if (!marker) return true;
        String savedVersion = marker.readString();
        marker.close();
        savedVersion.trim();
        return savedVersion != String(FIRMWARE_VERSION);
    }
    
    static void cleanAllData() {
        if (!RobustStorage::isReady()) return;
        File root = SPIFFS.open("/");
        if (!root) return;
        while (File file = root.openNextFile()) {
            String name = String(file.name());
            bool shouldDelete = false;
            if (name.startsWith("/pop_gen_")) shouldDelete = true;
            if (name.startsWith("/gen_")) shouldDelete = true;
            if (name.startsWith("/frm_")) shouldDelete = true;
            if (name == "/oe_history.csv") shouldDelete = true;
            if (name == "/experiment_state.mrk") shouldDelete = true;
            if (name.startsWith("/version_") && name != String(VERSION_MARKER_FILE)) shouldDelete = true;
            if (shouldDelete) { file.close(); SPIFFS.remove(name); }
        }
        root.close();
        writeVersionMarker();
    }
    
    static void writeVersionMarker() {
        if (!RobustStorage::isReady()) return;
        if (SPIFFS.exists(VERSION_MARKER_FILE)) SPIFFS.remove(VERSION_MARKER_FILE);
        File marker = SPIFFS.open(VERSION_MARKER_FILE, FILE_WRITE);
        if (marker) { marker.println(FIRMWARE_VERSION); marker.close(); }
    }
};

// ================================================================
// FileUtils 类
// ================================================================
class FileUtils {
public:
    static bool atomicWrite(const String& path, const uint8_t* data, size_t len) {
        if (!RobustStorage::isReady()) return false;
        String tempPath = path + ".tmp";
        if (SPIFFS.exists(tempPath)) SPIFFS.remove(tempPath);
        File tempFile = SPIFFS.open(tempPath, FILE_WRITE);
        if (!tempFile) return false;
        size_t written = tempFile.write(data, len);
        tempFile.close();
        if (written != len) { SPIFFS.remove(tempPath); return false; }
        if (SPIFFS.exists(path)) SPIFFS.remove(path);
        if (!SPIFFS.rename(tempPath, path)) { SPIFFS.remove(tempPath); return false; }
        return true;
    }
    
    static bool atomicWriteString(const String& path, const String& content) {
        return atomicWrite(path, (const uint8_t*)content.c_str(), content.length());
    }
    
    static String safeRead(const String& path) {
        if (!RobustStorage::isReady()) return "";
        if (!SPIFFS.exists(path)) return "";
        File file = SPIFFS.open(path, FILE_READ);
        if (!file) return "";
        String content = file.readString();
        file.close();
        return content;
    }
    
    static size_t getFileSize(const String& path) {
        if (!RobustStorage::isReady()) return 0;
        if (!SPIFFS.exists(path)) return 0;
        File file = SPIFFS.open(path, FILE_READ);
        if (!file) return 0;
        size_t size = file.size();
        file.close();
        return size;
    }
};

// ================================================================
// Gene 结构体 (只声明)
// ================================================================
struct Gene {
    uint8_t ruleCount;
    BehaviorRule rules[MAX_RULES];
    uint32_t survival_time;
    int32_t  distance_ticks;
    float noveltyScore;
    BehaviorDescriptor behavior;

    void init() {
        ruleCount = random(MIN_RULES, MAX_RULES + 1);
        for (int i = 0; i < ruleCount; i++) rules[i].randomize();
        survival_time = 0; distance_ticks = 0;
        noveltyScore = 0; behavior.init();
    }

    bool evaluateCondition(int ruleIdx, int leftSensor, int rightSensor, 
                           int32_t distance, uint32_t elapsed) const;

    void mutate(float mutationRate) {
        for (int i = 0; i < ruleCount; i++) {
            if (random(0, 1000) < mutationRate * 1000) { rules[i].condValue += random(-200,200); rules[i].clamp(); }
            if (random(0, 1000) < mutationRate * 1000) { rules[i].motorL += random(-50,50); rules[i].clamp(); }
            if (random(0, 1000) < mutationRate * 1000) { rules[i].motorR += random(-50,50); rules[i].clamp(); }
            if (random(0, 1000) < mutationRate * 500) { rules[i].durationMs += random(-200,200); rules[i].clamp(); }
            if (random(0, 1000) < mutationRate * 300) { rules[i].condType = random(0, 10); }
            if (random(0, 1000) < mutationRate * 300) { rules[i].condOp = random(0, 3); }
            if (random(0, 1000) < mutationRate * 200) { rules[i].nextRule = random(0, min(ruleCount, (uint8_t)3)); }
        }
        if (random(0, 1000) < mutationRate * 150 && ruleCount < MAX_RULES) {
            rules[ruleCount].randomize(); ruleCount++;
        }
        if (random(0, 1000) < mutationRate * 100 && ruleCount > MIN_RULES) {
            int delIdx = random(0, ruleCount); rules[delIdx] = rules[ruleCount - 1]; ruleCount--;
        }
        if (random(0, 1000) < mutationRate * 80 && ruleCount >= 2) {
            int a = random(0, ruleCount), b = random(0, ruleCount);
            if (a != b) { BehaviorRule tmp = rules[a]; rules[a] = rules[b]; rules[b] = tmp; }
        }
    }

    static void crossover(const Gene& p1, const Gene& p2, Gene& child) {
        int cut1 = random(0, p1.ruleCount), cut2 = random(0, p2.ruleCount);
        int fromP1 = cut1, fromP2 = p2.ruleCount - cut2;
        child.ruleCount = constrain(fromP1 + fromP2, MIN_RULES, MAX_RULES);
        for (int i = 0; i < fromP1 && i < child.ruleCount; i++) child.rules[i] = p1.rules[i];
        for (int i = 0; i < fromP2 && (fromP1 + i) < child.ruleCount; i++) child.rules[fromP1 + i] = p2.rules[cut2 + i];
        for (int i = fromP1 + fromP2; i < child.ruleCount; i++) child.rules[i] = p1.rules[i % p1.ruleCount];
        child.survival_time = 0; child.distance_ticks = 0;
        child.noveltyScore = 0; child.behavior.init();
    }
};

// ================================================================
// GeneStorage 类
// ================================================================
class GeneStorage {
private:
    static const uint32_t MAX_GENERATIONS_PER_EXPERIMENT = 20;
    static const uint16_t FILE_VERSION = 0x0002;
    static const uint32_t FILE_MAGIC = 0x47454E45;
    static const char* POP_PREFIX;
    static const char* GEN_RECORD_PREFIX;
    static const char* FRAME_LOG_PREFIX;
    static const char* EXPERIMENT_MARKER;
    static uint32_t currentExperimentId;
    static uint32_t currentGeneration;
    static bool experimentActive;
    
public:
    static void init() {
        currentExperimentId = 0;
        currentGeneration = 0;
        experimentActive = false;
        if (!RobustStorage::isReady()) {
            Logger::log("⚠️ SPIFFS不可用，基因存储使用RAM模式");
            return;
        }
        loadExperimentState();
        Logger::logf("🧬 基因存储系统初始化 (v8.9-chaos-v4)");
    }
    
    static void startNewExperiment() {
        if (!RobustStorage::isReady()) return;
        clearAllExperimentData();
        currentExperimentId = (uint32_t)millis();
        currentGeneration = 0;
        experimentActive = true;
        saveExperimentState();
        Logger::logf("✅ 新实验已开始 (ID: %lu)", currentExperimentId);
    }
    
    static bool shouldStartNewExperiment() {
        if (!RobustStorage::isReady()) return true;
        if (!SPIFFS.exists(EXPERIMENT_MARKER)) return true;
        String content = FileUtils::safeRead(EXPERIMENT_MARKER);
        if (content.length() == 0) return true;
        int commaPos = content.indexOf(',');
        if (commaPos < 0) return true;
        uint32_t expId = content.substring(0, commaPos).toInt();
        uint32_t gen = content.substring(commaPos + 1).toInt();
        if (gen >= MAX_GENERATIONS_PER_EXPERIMENT) {
            Logger::logf("📌 上一轮实验已完成 (ID: %lu, 共%lu代)", expId, gen);
            return true;
        }
        currentExperimentId = expId;
        currentGeneration = gen;
        experimentActive = true;
        Logger::logf("📌 恢复实验 (ID: %lu, 当前代: %lu)", expId, gen);
        return false;
    }
    
    static bool isExperimentActive() { return experimentActive; }
    static uint32_t getCurrentGeneration() { return currentGeneration; }
    static uint32_t getMaxGenerations() { return MAX_GENERATIONS_PER_EXPERIMENT; }
    static float getProgress() { return (float)currentGeneration / MAX_GENERATIONS_PER_EXPERIMENT; }
    static bool isExperimentComplete() { return currentGeneration >= MAX_GENERATIONS_PER_EXPERIMENT; }
    static void incrementGeneration() { currentGeneration++; saveExperimentState(); }
    
    static bool savePopulation(Gene* population, int size) {
        if (!RobustStorage::isReady() || !experimentActive) return false;
        size_t totalSize = 4 + 2 + 2 + 4 + 4;
        for (int i = 0; i < size; i++) {
            totalSize += 1 + population[i].ruleCount * sizeof(BehaviorRule) + 12;
        }
        uint8_t* buffer = (uint8_t*)malloc(totalSize);
        if (!buffer) return false;
        uint8_t* ptr = buffer;
        uint32_t magic = FILE_MAGIC; memcpy(ptr, &magic, 4); ptr += 4;
        uint16_t version = FILE_VERSION; memcpy(ptr, &version, 2); ptr += 2;
        uint16_t popSize = size; memcpy(ptr, &popSize, 2); ptr += 2;
        uint32_t gen = currentGeneration; memcpy(ptr, &gen, 4); ptr += 4;
        uint32_t expId = currentExperimentId; memcpy(ptr, &expId, 4); ptr += 4;
        for (int i = 0; i < size; i++) {
            *ptr = population[i].ruleCount; ptr += 1;
            for (int j = 0; j < population[i].ruleCount; j++) {
                memcpy(ptr, &population[i].rules[j], sizeof(BehaviorRule));
                ptr += sizeof(BehaviorRule);
            }
            memcpy(ptr, &population[i].survival_time, 4); ptr += 4;
            memcpy(ptr, &population[i].distance_ticks, 4); ptr += 4;
            memcpy(ptr, &population[i].noveltyScore, 4); ptr += 4;
        }
        String path = String(POP_PREFIX) + String(currentGeneration) + ".bin";
        bool success = FileUtils::atomicWrite(path, buffer, totalSize);
        free(buffer);
        return success;
    }
    
    static bool saveIndividualRecord(uint32_t generation, int individual, const Gene& gene) {
        if (!RobustStorage::isReady() || !experimentActive) return false;
        String path = String(GEN_RECORD_PREFIX) + String(generation) + "_id_" + String(individual) + ".csv";
        String content = "ruleIndex,condType,condValue,condOp,motorL,motorR,durationMs,nextRule,survival_time,distance_ticks,noveltyScore\n";
        for (int i = 0; i < gene.ruleCount; i++) {
            const BehaviorRule& r = gene.rules[i];
            content += String(i) + "," + String(r.condType) + "," + String(r.condValue) + ",";
            content += String(r.condOp) + "," + String(r.motorL) + "," + String(r.motorR) + ",";
            content += String(r.durationMs) + "," + String(r.nextRule) + ",";
            content += String(gene.survival_time) + "," + String(gene.distance_ticks) + ",";
            content += String(gene.noveltyScore, 6) + "\n";
        }
        return FileUtils::atomicWriteString(path, content);
    }
    
    static bool saveFrameLog(uint32_t generation, int individual, const FrameLogEntry* log, int count) {
        if (!RobustStorage::isReady() || !experimentActive || count == 0) return false;
        int exportCount = min(count, FRAME_LOG_SIZE);
        size_t totalSize = exportCount * 11;
        uint8_t* buffer = (uint8_t*)malloc(totalSize);
        if (!buffer) return false;
        uint8_t* ptr = buffer;
        for (int i = 0; i < exportCount; i++) {
            const FrameLogEntry& e = log[i];
            memcpy(ptr, &e.timestamp_ms, 4); ptr += 4;
            memcpy(ptr, &e.sensorLeft, 2); ptr += 2;
            memcpy(ptr, &e.sensorRight, 2); ptr += 2;
            *ptr = e.motorLeftPWM; ptr += 1;
            *ptr = e.motorRightPWM; ptr += 1;
            uint8_t dir = (e.directionL ? 0x01 : 0x00) | (e.directionR ? 0x02 : 0x00);
            *ptr = dir; ptr += 1;
        }
        String path = String(FRAME_LOG_PREFIX) + String(generation) + "_i" + String(individual) + ".bin";
        bool success = FileUtils::atomicWrite(path, buffer, totalSize);
        free(buffer);
        return success;
    }
    
    static bool loadPopulation(uint32_t generation, Gene* population, int size) {
        if (!RobustStorage::isReady()) return false;
        String path = String(POP_PREFIX) + String(generation) + ".bin";
        size_t fileSize = FileUtils::getFileSize(path);
        if (fileSize == 0) return false;
        File file = SPIFFS.open(path, FILE_READ);
        if (!file) return false;
        uint8_t* buffer = (uint8_t*)malloc(fileSize);
        if (!buffer) { file.close(); return false; }
        file.read(buffer, fileSize);
        file.close();
        uint8_t* ptr = buffer;
        uint32_t magic; memcpy(&magic, ptr, 4); ptr += 4;
        if (magic != FILE_MAGIC) { free(buffer); return false; }
        ptr += 2;
        uint16_t popSize; memcpy(&popSize, ptr, 2); ptr += 2;
        if (popSize != size) { free(buffer); return false; }
        ptr += 4; ptr += 4;
        for (int i = 0; i < size; i++) {
            population[i].ruleCount = *ptr; ptr += 1;
            for (int j = 0; j < population[i].ruleCount && j < MAX_RULES; j++) {
                memcpy(&population[i].rules[j], ptr, sizeof(BehaviorRule));
                ptr += sizeof(BehaviorRule);
            }
            memcpy(&population[i].survival_time, ptr, 4); ptr += 4;
            memcpy(&population[i].distance_ticks, ptr, 4); ptr += 4;
            memcpy(&population[i].noveltyScore, ptr, 4); ptr += 4;
            population[i].behavior.init();
        }
        free(buffer);
        return true;
    }
    
    static void clearAllExperimentData() {
        if (!RobustStorage::isReady()) return;
        File root = SPIFFS.open("/");
        if (!root) return;
        while (File file = root.openNextFile()) {
            String name = String(file.name());
            if (name.startsWith("/pop_gen_") || name.startsWith("/gen_") || 
                name.startsWith("/frm_") || name == "/experiment_state.mrk" || name == "/oe_history.csv") {
                file.close();
                SPIFFS.remove(name);
            }
        }
        root.close();
        currentExperimentId = 0;
        currentGeneration = 0;
        experimentActive = false;
    }
    
    static void saveHistoryRecord(const HistoryRecord& record) {
        if (!RobustStorage::isReady()) return;
        char line[256];
        snprintf(line, sizeof(line), "%lu,%lu,%.6f,%lu,%ld,%d\n",
                 record.timestamp, record.generation, record.noveltyScore,
                 record.survivalTime, record.distance_ticks, record.ruleCount);
        File file = SPIFFS.open("/oe_history.csv", FILE_APPEND);
        if (!file) {
            file = SPIFFS.open("/oe_history.csv", FILE_WRITE);
            if (file) file.print("timestamp,generation,noveltyScore,survivalTime,distance_ticks,ruleCount\n");
        }
        if (file) { file.print(line); file.close(); }
    }
    
private:
    static void saveExperimentState() {
        if (!RobustStorage::isReady()) return;
        String content = String(currentExperimentId) + "," + String(currentGeneration);
        FileUtils::atomicWriteString(EXPERIMENT_MARKER, content);
    }
    
    static void loadExperimentState() {
        if (!RobustStorage::isReady()) return;
        String content = FileUtils::safeRead(EXPERIMENT_MARKER);
        if (content.length() == 0) { experimentActive = false; return; }
        int commaPos = content.indexOf(',');
        if (commaPos < 0) { experimentActive = false; return; }
        currentExperimentId = content.substring(0, commaPos).toInt();
        currentGeneration = content.substring(commaPos + 1).toInt();
        experimentActive = true;
    }
};

const char* GeneStorage::POP_PREFIX = "/pop_gen_";
const char* GeneStorage::GEN_RECORD_PREFIX = "/gen_";
const char* GeneStorage::FRAME_LOG_PREFIX = "/frm_";
const char* GeneStorage::EXPERIMENT_MARKER = "/experiment_state.mrk";
uint32_t GeneStorage::currentExperimentId = 0;
uint32_t GeneStorage::currentGeneration = 0;
bool GeneStorage::experimentActive = false;

// ================================================================
// NoveltyArchive 类
// ================================================================
class NoveltyArchive {
private:
    BehaviorDescriptor archive[NOVELTY_ARCHIVE_MAX];
    int archiveSize;
    BehaviorDescriptor maxValues;

    void updateMaxValues(const BehaviorDescriptor& desc) {
        if (desc.leftSensorMean > maxValues.leftSensorMean) maxValues.leftSensorMean = desc.leftSensorMean;
        if (desc.rightSensorMean > maxValues.rightSensorMean) maxValues.rightSensorMean = desc.rightSensorMean;
        if (desc.sensorVariance > maxValues.sensorVariance) maxValues.sensorVariance = desc.sensorVariance;
        if (desc.avgSpeed > maxValues.avgSpeed) maxValues.avgSpeed = desc.avgSpeed;
        if (desc.speedVariance > maxValues.speedVariance) maxValues.speedVariance = desc.speedVariance;
        if (desc.totalDistance > maxValues.totalDistance) maxValues.totalDistance = desc.totalDistance;
    }

public:
    void init() { archiveSize = 0; maxValues.init(); }

    float computeNovelty(const BehaviorDescriptor& desc) {
        if (archiveSize == 0) return 1.0f;
        BehaviorDescriptor norm = desc;
        norm.normalize(maxValues);
        float distances[NOVELTY_ARCHIVE_MAX];
        int count = 0;
        for (int i = 0; i < archiveSize; i++) {
            BehaviorDescriptor archNorm = archive[i];
            archNorm.normalize(maxValues);
            distances[count++] = norm.distance(archNorm);
        }
        int k = min(NOVELTY_K_NEAREST, count);
        for (int i = 0; i < k; i++)
            for (int j = i + 1; j < count; j++)
                if (distances[j] < distances[i]) {
                    float tmp = distances[i]; distances[i] = distances[j]; distances[j] = tmp;
                }
        float sum = 0;
        for (int i = 0; i < k; i++) sum += distances[i];
        return sum / k;
    }

    bool addIfNovel(const BehaviorDescriptor& desc) {
        float novelty = computeNovelty(desc);
        if (novelty < NOVELTY_ADD_THRESHOLD && archiveSize > 0) return false;
        if (archiveSize < NOVELTY_ARCHIVE_MAX) {
            archive[archiveSize++] = desc;
        } else {
            archive[archiveSize % NOVELTY_ARCHIVE_MAX] = desc;
            archiveSize = (archiveSize % NOVELTY_ARCHIVE_MAX) + 1;
        }
        updateMaxValues(desc);
        return true;
    }

    BehaviorDescriptor extractFromFrameLog(const FrameLogEntry* frameLog, int frameCount, int32_t totalDistance) {
        BehaviorDescriptor desc; desc.init();
        if (frameCount == 0) return desc;
        float sumL = 0, sumR = 0, sumSpeed = 0, sumSpeedSq = 0, sumTurnDiff = 0;
        int forwardFrames = 0, turnFrames = 0, reverseFrames = 0, idleFrames = 0;
        for (int i = 0; i < frameCount; i++) {
            const FrameLogEntry& e = frameLog[i];
            sumL += e.sensorLeft; sumR += e.sensorRight;
            float speed = (e.motorLeftPWM + e.motorRightPWM) / 2.0f;
            sumSpeed += speed; sumSpeedSq += speed * speed;
            sumTurnDiff += (float)e.motorLeftPWM - (float)e.motorRightPWM;
            if (e.motorLeftPWM < 10 && e.motorRightPWM < 10) idleFrames++;
            else if (e.directionL == 0 && e.directionR == 0) reverseFrames++;
            else if (abs((int)e.motorLeftPWM - (int)e.motorRightPWM) > 50) turnFrames++;
            else forwardFrames++;
        }
        int n = frameCount;
        desc.leftSensorMean = sumL / n;
        desc.rightSensorMean = sumR / n;
        desc.avgSpeed = sumSpeed / n;
        desc.speedVariance = (sumSpeedSq / n) - (desc.avgSpeed * desc.avgSpeed);
        if (desc.speedVariance < 0) desc.speedVariance = 0;
        desc.turnBias = sumTurnDiff / (float)n / 255.0f;
        desc.sensorAsymmetry = (desc.leftSensorMean - desc.rightSensorMean) / max(desc.leftSensorMean + desc.rightSensorMean, 1.0f);
        desc.totalDistance = (float)abs(totalDistance) / 1000.0f;
        int activeFrames = n - idleFrames;
        if (activeFrames > 0) {
            desc.forwardRatio = (float)forwardFrames / activeFrames;
            desc.turnRatio = (float)turnFrames / activeFrames;
            desc.reverseRatio = (float)reverseFrames / activeFrames;
        }
        desc.idleRatio = (float)idleFrames / n;
        float varL = 0, varR = 0;
        for (int i = 0; i < frameCount; i++) {
            float dL = frameLog[i].sensorLeft - desc.leftSensorMean;
            float dR = frameLog[i].sensorRight - desc.rightSensorMean;
            varL += dL*dL; varR += dR*dR;
        }
        desc.sensorVariance = (varL + varR) / (2.0f * n);
        return desc;
    }

    int getArchiveSize() const { return archiveSize; }
};

// ================================================================
// MotorController 类
// ================================================================
class MotorController {
private:
    static int      currentSpeedL, currentSpeedR;
    static volatile int32_t distanceTicks;
    static uint32_t lastMoveTime;
    static bool     motorEnabled;
    static uint32_t testStartTime;
    static int      leftSensorRaw, rightSensorRaw;
    static int      currentRuleIndex;
    static uint32_t ruleStartTime;
    static bool     ruleActive;
    static FrameLogEntry frameLog[FRAME_LOG_SIZE];
    static int      frameLogHead;
    static int      frameLogCount;
    
    static bool     lastLeftA, lastRightA;
    static uint32_t lastEncoderReadTime;

    static bool     actionInProgress;
    static uint32_t actionStartTime;
    static int32_t  actionLastTicks;
    static int      actionStallFrames;
    static int      actionTargetL;
    static int      actionTargetR;
    static uint16_t actionMinDuration;
    static uint8_t  actionNextRule;

    // ================================================================
    // 【v8.9-chaos-v4】卡死检测变量
    // ================================================================
    static volatile int32_t leftTicks;
    static volatile int32_t rightTicks;
    static bool stuckFlag;
    static uint32_t stuckStartTime;
    static int32_t lastDiff;
    static bool escapeActive;

    static void setMotorSpeed(int leftPWM, int rightPWM) {
        if (!motorEnabled) {
            ledcWrite(LEDC_CHANNEL_LEFT, 0);
            ledcWrite(LEDC_CHANNEL_RIGHT, 0);
            digitalWrite(PIN_LEFT_DIR2, LOW);
            digitalWrite(PIN_RIGHT_DIR2, LOW);
            currentSpeedL = 0;
            currentSpeedR = 0;
            return;
        }
        int outL = constrain((int)(leftPWM * LEFT_GAIN), -255, 255);
        int outR = constrain((int)(rightPWM * RIGHT_GAIN), -255, 255);
        if (outL > 0) {
            digitalWrite(PIN_LEFT_DIR2, LEFT_FORWARD);
            ledcWrite(LEDC_CHANNEL_LEFT, outL);
        } else if (outL < 0) {
            digitalWrite(PIN_LEFT_DIR2, LEFT_REVERSE);
            ledcWrite(LEDC_CHANNEL_LEFT, -outL);
        } else {
            digitalWrite(PIN_LEFT_DIR2, LOW);
            ledcWrite(LEDC_CHANNEL_LEFT, 0);
        }
        if (outR > 0) {
            digitalWrite(PIN_RIGHT_DIR2, RIGHT_FORWARD);
            ledcWrite(LEDC_CHANNEL_RIGHT, outR);
        } else if (outR < 0) {
            digitalWrite(PIN_RIGHT_DIR2, RIGHT_REVERSE);
            ledcWrite(LEDC_CHANNEL_RIGHT, -outR);
        } else {
            digitalWrite(PIN_RIGHT_DIR2, LOW);
            ledcWrite(LEDC_CHANNEL_RIGHT, 0);
        }
        currentSpeedL = abs(outL);
        currentSpeedR = abs(outR);
        if (outL != 0 || outR != 0) lastMoveTime = millis();
    }

    static void updateEncoders() {
        if (millis() - lastEncoderReadTime < 10) return;
        lastEncoderReadTime = millis();
        
        bool leftA = digitalRead(PIN_LEFT_ENC_A);
        bool rightA = digitalRead(PIN_RIGHT_ENC_A);
        
        if (leftA && !lastLeftA) {
            if (digitalRead(PIN_LEFT_ENC_B) == HIGH) {
                leftTicks--;
            } else {
                leftTicks++;
            }
        }
        
        if (rightA && !lastRightA) {
            if (digitalRead(PIN_RIGHT_ENC_B) == HIGH) {
                rightTicks++;
            } else {
                rightTicks--;
            }
        }
        
        // 总距离 = 左轮行程 + 右轮行程（始终为正）
        distanceTicks = abs(leftTicks) + abs(rightTicks);
        
        lastLeftA = leftA;
        lastRightA = rightA;
    }

public:
    static bool isStuck() { return stuckFlag; }
    static bool isEscapeActive() { return escapeActive; }
    static void setEscapeActive(bool val) { escapeActive = val; }
    static void resetStuck() { stuckFlag = false; stuckStartTime = 0; }
    static int32_t getLeftTicks() { return leftTicks; }
    static int32_t getRightTicks() { return rightTicks; }
    static int32_t getEncoderDiff() { return abs(leftTicks - rightTicks); }

    static void init() {
        currentSpeedL = 0; currentSpeedR = 0;
        distanceTicks = 0;
        leftTicks = 0;
        rightTicks = 0;
        lastMoveTime = millis();
        testStartTime = 0;
        leftSensorRaw = 0; rightSensorRaw = 0;
        currentRuleIndex = 0; ruleStartTime = 0; ruleActive = false;
        frameLogHead = 0; frameLogCount = 0;
        motorEnabled = false;
        lastLeftA = false; lastRightA = false;
        lastEncoderReadTime = 0;
        actionInProgress = false;
        actionStartTime = 0;
        actionLastTicks = 0;
        actionStallFrames = 0;
        actionTargetL = 0; actionTargetR = 0;
        actionMinDuration = 0; actionNextRule = 0;

        stuckFlag = false;
        stuckStartTime = 0;
        lastDiff = 0;
        escapeActive = false;

        pinMode(PIN_LEFT_DIR2, OUTPUT);
        pinMode(PIN_RIGHT_DIR2, OUTPUT);
        digitalWrite(PIN_LEFT_DIR2, LOW);
        digitalWrite(PIN_RIGHT_DIR2, LOW);
        pinMode(PIN_LED, OUTPUT);

        ledcSetup(LEDC_CHANNEL_LEFT, LEDC_FREQ, LEDC_RESOLUTION);
        ledcSetup(LEDC_CHANNEL_RIGHT, LEDC_FREQ, LEDC_RESOLUTION);
        ledcAttachPin(PIN_LEFT_PWM, LEDC_CHANNEL_LEFT);
        ledcAttachPin(PIN_RIGHT_PWM, LEDC_CHANNEL_RIGHT);
        ledcWrite(LEDC_CHANNEL_LEFT, 0);
        ledcWrite(LEDC_CHANNEL_RIGHT, 0);
        
        stopMotors();
        Logger::log("✅ Motor Controller initialized (v8.9-chaos-v4)");
        Logger::logf("   LEFT: PWM=GPIO%d, DIR=GPIO%d", PIN_LEFT_PWM, PIN_LEFT_DIR2);
        Logger::logf("   RIGHT: PWM=GPIO%d, DIR=GPIO%d", PIN_RIGHT_PWM, PIN_RIGHT_DIR2);
        Logger::log("   ✅ 双模式卡死检测: 差值>50 或 单轮卡死");
    }

    static void stopMotors() {
        setMotorSpeed(0, 0);
        digitalWrite(PIN_LEFT_DIR2, LOW);
        digitalWrite(PIN_RIGHT_DIR2, LOW);
        actionInProgress = false;
        ruleActive = false;
        stuckFlag = false;
        stuckStartTime = 0;
    }

    static void enableMotor() { motorEnabled = true; stopMotors(); Logger::log("电机已解锁"); }
    static void disableMotor() { motorEnabled = false; stopMotors(); Logger::log("电机已锁定"); }
    static bool isMotorEnabled() { return motorEnabled; }

    static void startPhysicsAction(int leftPWM, int rightPWM, uint16_t minDurationMs) {
        if (!motorEnabled) { Logger::log("⚠️ 电机已锁定"); return; }
        if (actionInProgress) stopMotors();
        actionInProgress = true;
        actionStartTime = millis();
        actionLastTicks = distanceTicks;
        actionStallFrames = 0;
        actionTargetL = leftPWM;
        actionTargetR = rightPWM;
        actionMinDuration = minDurationMs;
        actionNextRule = 0;
        setMotorSpeed(leftPWM, rightPWM);
    }

    static void updatePhysicsAction() {
        if (!actionInProgress) return;
        updateEncoders();
        int32_t currentTicks = distanceTicks;
        int deltaTicks = abs((int)(currentTicks - actionLastTicks));
        actionLastTicks = currentTicks;
        if (deltaTicks == 0) actionStallFrames++;
        else actionStallFrames = max(0, actionStallFrames - 1);
        uint32_t elapsed = millis() - actionStartTime;
        if (elapsed >= actionMinDuration && 
            (actionStallFrames > PHYSICS_STALL_FRAMES || elapsed > PHYSICS_MAX_ACTION_MS)) {
            actionInProgress = false;
            stopMotors();
        }
    }

    static void forceStopAction() {
        if (actionInProgress) { actionInProgress = false; stopMotors(); }
    }
    static bool isActionInProgress() { return actionInProgress; }

    static void startFrameLog() { frameLogHead = 0; frameLogCount = 0; testStartTime = millis(); }

    static void logFrame() {
        if (frameLogCount < FRAME_LOG_SIZE * 2) {
            FrameLogEntry& entry = frameLog[frameLogHead];
            entry.timestamp_ms = millis() - testStartTime;
            entry.sensorLeft = leftSensorRaw;
            entry.sensorRight = rightSensorRaw;
            entry.motorLeftPWM = currentSpeedL;
            entry.motorRightPWM = currentSpeedR;
            entry.directionL = (digitalRead(PIN_LEFT_DIR2) == LEFT_FORWARD) ? 1 : 0;
            entry.directionR = (digitalRead(PIN_RIGHT_DIR2) == RIGHT_FORWARD) ? 1 : 0;
            frameLogHead = (frameLogHead + 1) % FRAME_LOG_SIZE;
            frameLogCount++;
        }
    }

    // ================================================================
    // 【v8.9-chaos-v4】核心更新函数 - 双模式卡死检测
    // ================================================================
    static void update(const Gene& gene) {
        if (!motorEnabled) { stopMotors(); return; }
        
        if (actionInProgress) {
            leftSensorRaw = SensorCalibration::getLeftRaw();
            rightSensorRaw = SensorCalibration::getRightRaw();
            logFrame();
            return;
        }
        
        updateEncoders();
        leftSensorRaw = SensorCalibration::getLeftRaw();
        rightSensorRaw = SensorCalibration::getRightRaw();

        // ================================================================
        // 【v8.9-chaos-v4】双模式卡死检测
        // ================================================================
        int32_t diff = abs(leftTicks - rightTicks);
        bool diffIncreasing = (diff > lastDiff + ENCODER_DIFF_MIN);
        
        // 检测轮子状态
        bool leftSpinning = (currentSpeedL > WHEEL_SPIN_THRESHOLD);
        bool rightSpinning = (currentSpeedR > WHEEL_SPIN_THRESHOLD);
        bool leftStopped = (currentSpeedL < WHEEL_STOP_THRESHOLD);
        bool rightStopped = (currentSpeedR < WHEEL_STOP_THRESHOLD);
        bool anySpinning = leftSpinning || rightSpinning;
        
        // 模式1：编码器差值卡死 (两轮都转但差值持续增大)
        bool diffStuck = (diff > ENCODER_DIFF_THRESHOLD && diffIncreasing && 
                          leftSpinning && rightSpinning && !escapeActive);
        
        // 模式2：单轮卡死 (一个轮子转，另一个轮子停)
        bool oneWheelStuck = ((leftSpinning && rightStopped) || 
                              (rightSpinning && leftStopped)) && !escapeActive;
        
        // 模式3：大差值兜底
        bool largeDiffStuck = (diff > ENCODER_DIFF_THRESHOLD * 2 && 
                               anySpinning && !escapeActive);
        
        bool isStuckCondition = diffStuck || oneWheelStuck || largeDiffStuck;
        
        if (isStuckCondition) {
            if (!stuckFlag) {
                stuckStartTime = millis();
                stuckFlag = true;
                if (diffStuck) {
                    Logger::logf("⚠️ 卡死预检测(差值): diff=%ld", diff);
                } else if (oneWheelStuck) {
                    Logger::logf("⚠️ 卡死预检测(单轮): L=%d R=%d", 
                                 currentSpeedL, currentSpeedR);
                } else {
                    Logger::logf("⚠️ 卡死预检测(大差值): diff=%ld", diff);
                }
            } else {
                uint32_t stuckDuration = millis() - stuckStartTime;
                if (stuckDuration > ENCODER_STUCK_DURATION) {
                    stuckFlag = true;
                    if (diffStuck) {
                        Logger::logf("⚠️ 卡死确认(差值)! %dms, diff=%ld", 
                                     stuckDuration, diff);
                    } else if (oneWheelStuck) {
                        Logger::logf("⚠️ 卡死确认(单轮)! %dms, L=%d R=%d", 
                                     stuckDuration, currentSpeedL, currentSpeedR);
                    } else {
                        Logger::logf("⚠️ 卡死确认(大差值)! %dms, diff=%ld", 
                                     stuckDuration, diff);
                    }
                }
            }
        } else {
            if (stuckFlag) {
                bool shouldClear = false;
                if (diff < 30 || !diffIncreasing) shouldClear = true;
                if (oneWheelStuck && (leftSpinning == rightSpinning || 
                    (!leftSpinning && !rightSpinning))) shouldClear = true;
                if (leftSpinning && rightSpinning && diff < 30) shouldClear = true;
                if (shouldClear) {
                    stuckFlag = false;
                    stuckStartTime = 0;
                    Logger::logf("✅ 卡死解除: diff=%ld", diff);
                }
            }
            if (!diffStuck && !oneWheelStuck && !largeDiffStuck) {
                stuckFlag = false;
                stuckStartTime = 0;
            }
        }
        lastDiff = diff;

        static int debugCounter = 0;
        if (++debugCounter % 100 == 0) {
            const char* stuckReason = "正常";
            if (diffStuck) stuckReason = "差值卡死";
            else if (oneWheelStuck) stuckReason = "单轮卡死";
            else if (largeDiffStuck) stuckReason = "大差值";
            Logger::logf("📊 编码器: L=%ld R=%ld diff=%ld | 卡死: %s | 脱困: %s | %s",
                         leftTicks, rightTicks, diff,
                         stuckFlag ? "⚠️" : "✅",
                         escapeActive ? "🔄" : "⏸",
                         stuckReason);
        }

        // ================================================================
        // 规则评估
        // ================================================================
        float noise = (float)(SensorCalibration::readNoise() % 1000) / 1000.0f;
        uint32_t elapsed = millis() - testStartTime;
        int32_t dist = distanceTicks;

        if (!ruleActive) {
            for (int i = 0; i < gene.ruleCount; i++) {
                if (gene.evaluateCondition(i, leftSensorRaw, rightSensorRaw, dist, elapsed)) {
                    currentRuleIndex = i;
                    ruleStartTime = millis();
                    ruleActive = true;

                    const BehaviorRule& r = gene.rules[i];
                    float noiseMod = 0.7f + noise * 0.6f;
                    int modMotorL = constrain((int)(r.motorL * noiseMod), -255, 255);
                    int modMotorR = constrain((int)(r.motorR * noiseMod), -255, 255);
                    uint16_t modDuration = constrain((uint16_t)(r.durationMs * noiseMod), 
                                                     MIN_RULE_DURATION, MAX_RULE_DURATION);

                    if (r.condType == COND_STUCK) {
                        escapeActive = true;
                        stuckFlag = false;
                        Logger::log("🔄 触发脱困规则!");
                    }
                    
                    if (r.condType == COND_ESCAPE) {
                        escapeActive = false;
                        Logger::log("✅ 脱困完成");
                    }

                    startPhysicsAction(modMotorL, modMotorR, modDuration);
                    logFrame();
                    return;
                }
            }
            if (!actionInProgress) stopMotors();
        } else {
            if (!actionInProgress) {
                const BehaviorRule& r = gene.rules[currentRuleIndex];
                if (r.nextRule > 0 && r.nextRule <= gene.ruleCount) {
                    currentRuleIndex = r.nextRule - 1;
                    ruleStartTime = millis();
                } else {
                    ruleActive = false;
                }
            }
        }
        logFrame();
    }

    static int32_t getDistanceTicks() { return distanceTicks; }
    static void resetDistanceTicks() { distanceTicks = 0; leftTicks = 0; rightTicks = 0; }
    static const FrameLogEntry* getFrameLog() { return frameLog; }
    static int getFrameLogCount() { return frameLogCount; }
    static int getCurrentSpeedL() { return currentSpeedL; }
    static int getCurrentSpeedR() { return currentSpeedR; }
};

// ================================================================
// MotorController 静态变量定义
// ================================================================
int MotorController::currentSpeedL = 0;
int MotorController::currentSpeedR = 0;
volatile int32_t MotorController::distanceTicks = 0;
uint32_t MotorController::lastMoveTime = 0;
uint32_t MotorController::testStartTime = 0;
int MotorController::leftSensorRaw = 0;
int MotorController::rightSensorRaw = 0;
int MotorController::currentRuleIndex = 0;
uint32_t MotorController::ruleStartTime = 0;
bool MotorController::ruleActive = false;
FrameLogEntry MotorController::frameLog[FRAME_LOG_SIZE];
int MotorController::frameLogHead = 0;
int MotorController::frameLogCount = 0;
bool MotorController::motorEnabled = false;
bool MotorController::lastLeftA = false;
bool MotorController::lastRightA = false;
uint32_t MotorController::lastEncoderReadTime = 0;

bool MotorController::actionInProgress = false;
uint32_t MotorController::actionStartTime = 0;
int32_t MotorController::actionLastTicks = 0;
int MotorController::actionStallFrames = 0;
int MotorController::actionTargetL = 0;
int MotorController::actionTargetR = 0;
uint16_t MotorController::actionMinDuration = 0;
uint8_t MotorController::actionNextRule = 0;

// ================================================================
// 【v8.9-chaos-v4】卡死检测变量定义
// ================================================================
volatile int32_t MotorController::leftTicks = 0;
volatile int32_t MotorController::rightTicks = 0;
bool MotorController::stuckFlag = false;
uint32_t MotorController::stuckStartTime = 0;
int32_t MotorController::lastDiff = 0;
bool MotorController::escapeActive = false;

// ================================================================
// Gene::evaluateCondition 实现
// ================================================================
bool Gene::evaluateCondition(int ruleIdx, int leftSensor, int rightSensor, 
                             int32_t distance, uint32_t elapsed) const {
    const BehaviorRule& r = rules[ruleIdx];
    int value = 0;
    switch (r.condType) {
        case COND_SENSOR_LEFT:  value = leftSensor; break;
        case COND_SENSOR_RIGHT: value = rightSensor; break;
        case COND_SENSOR_BOTH:  return (leftSensor > OBSTACLE_ADC_THRESH) && (rightSensor > OBSTACLE_ADC_THRESH);
        case COND_SENSOR_ANY:   return (leftSensor > OBSTACLE_ADC_THRESH) || (rightSensor > OBSTACLE_ADC_THRESH);
        case COND_DISTANCE:     value = (int)distance; break;
        case COND_TIME:         value = (int)elapsed; break;
        case COND_IDLE:         return (leftSensor < CLEAR_ADC_THRESH) && (rightSensor < CLEAR_ADC_THRESH);
        case COND_ALWAYS:       return true;
        case COND_STUCK:        return MotorController::isStuck() && !MotorController::isEscapeActive();
        case COND_ESCAPE:       return MotorController::isEscapeActive();
        default: return false;
    }
    return r.compare(value, r.condOp, r.condValue);
}

// ================================================================
// EvolutionEngine 类
// ================================================================
class EvolutionEngine {
private:
    static EvolutionEngine instance;
    Gene population[POPULATION_SIZE];
    NoveltyArchive archive;
    uint32_t currentGeneration;
    int currentIndividual;
    uint32_t testStartTime;
    bool testActive;
    bool pendingTransition;
    bool controlMode;
    float mutationRate;
    float bestNoveltyEver;

    void createSeedIndividual(Gene& gene) {
        gene.ruleCount = 6;
        gene.rules[0] = {COND_SENSOR_LEFT, OBSTACLE_ADC_THRESH, OP_GREATER, -150, 150, 300, 0, 0};
        gene.rules[1] = {COND_SENSOR_RIGHT, OBSTACLE_ADC_THRESH, OP_GREATER, 150, -150, 300, 0, 0};
        gene.rules[2] = {COND_IDLE, 0, OP_GREATER, 150, 150, 100, 0, 0};
        gene.rules[3] = {COND_STUCK, 0, OP_GREATER, -180, 100, 500, 4, 0};
        gene.rules[4] = {COND_ESCAPE, 0, OP_GREATER, 0, 0, 50, 0, 0};
        gene.rules[5] = {COND_ALWAYS, 0, OP_GREATER, 120, 120, 100, 0, 0};
        gene.survival_time = 0; gene.distance_ticks = 0;
        gene.noveltyScore = 0; gene.behavior.init();
        Logger::log("🧬 植入混沌种子个体 (双模式卡死检测, 6条规则)");
    }

    void initImpl() {
        currentGeneration = GeneStorage::getCurrentGeneration();
        if (currentGeneration == 0) currentGeneration = 1;
        currentIndividual = 0;
        testActive = false; pendingTransition = false; controlMode = false;
        mutationRate = 0.15f; bestNoveltyEver = 0;
        
        Logger::log("初始化进化引擎 (双模式卡死检测)...");
        archive.init();
        
        Gene loadedPop[POPULATION_SIZE];
        if (GeneStorage::loadPopulation(currentGeneration, loadedPop, POPULATION_SIZE)) {
            for (int i = 0; i < POPULATION_SIZE; i++) population[i] = loadedPop[i];
            Logger::logf("🔄 已恢复第 %lu 代种群", currentGeneration);
        } else {
            for (int i = 0; i < POPULATION_SIZE; i++) population[i].init();
            createSeedIndividual(population[0]);
            createSeedIndividual(population[1]);
            population[1].rules[3].motorL = 100;
            population[1].rules[3].motorR = -180;
            Logger::logf("种群初始化完成: %d 个个体", POPULATION_SIZE);
            GeneStorage::savePopulation(population, POPULATION_SIZE);
        }
    }

    void startCurrentTestImpl() {
        testActive = true; testStartTime = millis();
        MotorController::resetDistanceTicks();
        MotorController::enableMotor();
        MotorController::startFrameLog();
        MotorController::resetStuck();
        MotorController::setEscapeActive(false);
        Logger::logf("测试个体 %d/%d (代 %lu) [规则数=%d]",
                     currentIndividual+1, POPULATION_SIZE, currentGeneration,
                     population[currentIndividual].ruleCount);
    }

    void endCurrentTestImpl() {
        if (!testActive) return;
        testActive = false;
        MotorController::forceStopAction();
        MotorController::disableMotor();
        delay(50);
        MotorController::stopMotors();
        
        Gene& g = population[currentIndividual];
        g.survival_time = millis() - testStartTime;
        g.distance_ticks = MotorController::getDistanceTicks();

        g.behavior = archive.extractFromFrameLog(
            MotorController::getFrameLog(), MotorController::getFrameLogCount(), g.distance_ticks);
        g.noveltyScore = archive.computeNovelty(g.behavior);
        bool added = archive.addIfNovel(g.behavior);

        HistoryRecord record;
        record.timestamp = millis();
        record.generation = currentGeneration;
        record.noveltyScore = g.noveltyScore;
        record.survivalTime = g.survival_time;
        record.distance_ticks = g.distance_ticks;
        record.ruleCount = g.ruleCount;
        
        GeneStorage::saveHistoryRecord(record);
        RobustStorage::addRecord(record);
        RobustStorage::forceSave();

        Logger::logf("个体 %d 完成: 新奇度=%.4f 规则数=%d %s",
                     currentIndividual+1, g.noveltyScore, g.ruleCount, added ? "[新行为!]" : "");

        GeneStorage::saveIndividualRecord(currentGeneration, currentIndividual, g);
        GeneStorage::saveFrameLog(currentGeneration, currentIndividual,
                                  MotorController::getFrameLog(),
                                  MotorController::getFrameLogCount());

        if (g.noveltyScore > bestNoveltyEver) {
            bestNoveltyEver = g.noveltyScore;
            Logger::logf("新行为纪录! 新奇度=%.4f", g.noveltyScore);
        }
    }

    void nextIndividualImpl() {
        endCurrentTestImpl();
        currentIndividual++;
        if (currentIndividual >= POPULATION_SIZE) {
            evolveImpl();
            currentIndividual = 0;
            GeneStorage::incrementGeneration();
            currentGeneration = GeneStorage::getCurrentGeneration();
            Logger::logf("进入第 %lu 代 (档案: %d 行为)", currentGeneration, archive.getArchiveSize());
        }
        startCurrentTestImpl();
    }

    void evolveImpl() {
        if (controlMode) {
            Logger::log("对照组模式: 跳过进化");
            for (int i = 0; i < POPULATION_SIZE; i++) {
                population[i].noveltyScore = 0;
                population[i].behavior.init();
            }
            return;
        }

        std::sort(population, population + POPULATION_SIZE,
            [](const Gene& a, const Gene& b) { return a.noveltyScore > b.noveltyScore; });

        int eliteCount = max(1, POPULATION_SIZE / 4);
        Gene newPopulation[POPULATION_SIZE];
        for (int i = 0; i < eliteCount; i++) {
            newPopulation[i] = population[i];
            newPopulation[i].noveltyScore = 0;
            newPopulation[i].behavior.init();
        }
        for (int i = eliteCount; i < POPULATION_SIZE; i++) {
            int p1 = tournamentSelectByNovelty();
            int p2 = tournamentSelectByNovelty();
            Gene::crossover(population[p1], population[p2], newPopulation[i]);
            newPopulation[i].mutate(mutationRate);
            newPopulation[i].noveltyScore = 0;
            newPopulation[i].behavior.init();
        }
        for (int i = 0; i < POPULATION_SIZE; i++) population[i] = newPopulation[i];
        
        float avg = getAvgNovelty();
        if (avg < bestNoveltyEver * 0.5f) mutationRate = min(mutationRate + 0.03f, 0.5f);
        else if (avg > bestNoveltyEver * 0.8f) mutationRate = max(mutationRate - 0.01f, 0.05f);
        Logger::logf("进化完成, 变异率=%.2f", mutationRate);
        
        GeneStorage::savePopulation(population, POPULATION_SIZE);
        if (GeneStorage::isExperimentComplete()) {
            Logger::log("🏁 本轮20代实验完成！所有数据已保存。");
        }
    }

    int tournamentSelectByNovelty() {
        int tournamentSize = 3, best = random(0, POPULATION_SIZE);
        for (int i = 1; i < tournamentSize; i++) {
            int candidate = random(0, POPULATION_SIZE);
            if (population[candidate].noveltyScore > population[best].noveltyScore) best = candidate;
        }
        return best;
    }

    float getAvgNovelty() {
        float sum = 0;
        for (int i = 0; i < POPULATION_SIZE; i++) sum += population[i].noveltyScore;
        return sum / POPULATION_SIZE;
    }

public:
    static void init() { instance.initImpl(); }
    static void startCurrentTest() { instance.startCurrentTestImpl(); }
    static void endCurrentTest() { instance.endCurrentTestImpl(); }
    static void nextIndividual() { instance.nextIndividualImpl(); }
    static bool isTestActive() { return instance.testActive; }
    static uint32_t getTestStartTime() { return instance.testStartTime; }
    static uint32_t getGeneration() { return instance.currentGeneration; }
    static int getIndividual() { return instance.currentIndividual; }
    static float getMutationRate() { return instance.mutationRate; }
    static float getBestNoveltyEver() { return instance.bestNoveltyEver; }
    static int getArchiveSize() { return instance.archive.getArchiveSize(); }
    static Gene& getCurrentGene() { return instance.population[instance.currentIndividual]; }
    static void setPendingTransition(bool p) { instance.pendingTransition = p; }
    static bool getPendingTransition() { return instance.pendingTransition; }
    static void clearPendingTransition() { instance.pendingTransition = false; }
    static void setMutationRate(float rate) { instance.mutationRate = constrain(rate, 0.01f, 1.0f); }
    static void setControlMode(bool enable) { 
        instance.controlMode = enable; 
        Logger::logf("对照组模式: %s", enable ? "开启" : "关闭");
    }
};

EvolutionEngine EvolutionEngine::instance;

// ================================================================
// CarWebServer 类
// ================================================================
class CarWebServer {
private:
    static WebServer server;
    
public:
    static void init() {
        server.on("/", handleRoot);
        server.on("/status", handleStatus);
        server.on("/archive", handleArchive);
        server.on("/evolution", handleEvolution);
        server.on("/motor", handleMotor);
        server.on("/reset", handleReset);
        server.on("/download/history", handleDownloadHistory);
        server.on("/download/all", handleDownloadAll);
        server.on("/download/pop", handleDownloadPopulation);
        server.on("/download/current-population", handleDownloadCurrentPopulation);
        server.on("/download/current-evolution", handleDownloadCurrentEvolution);
        server.on("/list/files", handleListFiles);
        server.on("/experiment/status", handleExperimentStatus);
        server.on("/version", handleVersion);
        server.on("/admin/clean", handleAdminClean);
        server.onNotFound(handleNotFound);
        server.begin();
        Logger::log("Web 控制台就绪 (v8.9-chaos-v4)");
    }

    static void handleClient() { server.handleClient(); }

    static void handleRoot() {
        String html = R"rawliteral(<!DOCTYPE html><html><head>
<meta charset='UTF-8'><meta name='viewport' content='width=device-width,initial-scale=1'>
<title>进化小车 v8.9-chaos-v4</title>
<style>
*{box-sizing:border-box;}body{font-family:sans-serif;background:#0d1117;color:#c9d1d9;padding:20px;margin:0;}
h1{color:#58a6ff;font-size:20px;margin:0 0 10px 0;}
h2{color:#f0f6fc;font-size:14px;margin:0 0 10px 0;border-bottom:1px solid #21262d;padding-bottom:8px;}
.card{background:#161b22;border:1px solid #30363d;border-radius:8px;padding:15px;margin:10px 0;}
button{background:#21262d;color:#c9d1d9;border:1px solid #30363d;padding:8px 16px;border-radius:6px;cursor:pointer;margin:4px;font-size:12px;}
button:hover{background:#30363d;border-color:#58a6ff;}
button.primary{background:#238636;border-color:#2ea043;color:#fff;}
button.danger{background:#da3633;border-color:#f85149;color:#fff;}
button.download{background:#1f6feb;border-color:#58a6ff;color:#fff;}
button.download:hover{background:#388bfd;}
.status{font-size:12px;line-height:1.8;font-family:monospace;}
.val{color:#58a6ff;}.high{color:#3fb950;}.warn{color:#d29922;}
.notice{background:#1f2937;border-left:4px solid #3fb950;padding:8px 12px;margin:8px 0;font-size:12px;}
.warning-box{background:#1f2937;border-left:4px solid #d29922;padding:8px 12px;margin:8px 0;font-size:12px;}
.grid{display:grid;grid-template-columns:1fr 1fr;gap:10px;}
input[type=number]{background:#0d1117;color:#c9d1d9;border:1px solid #30363d;border-radius:4px;padding:4px 8px;width:70px;}
@media(max-width:600px){.grid{grid-template-columns:1fr;}}
</style>
</head><body>
<h1>🧬 进化小车 v8.9-chaos-v4</h1>
<div class="notice">✅ 双模式卡死检测: 差值>50 或 单轮卡死</div>
<div class="warning-box">⚠️ 模式1: 两轮都转但差值>50持续增大 | 模式2: 一轮转一轮停</div>
<div class="grid">
<div class='card'><h2>📊 状态</h2><div id='status' class='status'>加载中...</div></div>
<div class='card'><h2>📚 档案</h2><div id='archive' class='status'>加载中...</div></div>
</div>
<div class='card'><h2>🧬 实验</h2><div id='experiment' class='status'>加载中...</div></div>
<div class='card'><h2>🎮 控制</h2>
<button class='primary' onclick="api('/evolution?action=start')">▶ 开始</button>
<button class='danger' onclick="api('/evolution?action=stop')">⏹ 停止</button>
<button onclick="api('/evolution?action=next')">⏭ 下一个</button>
<button onclick="location.reload()">🔄 刷新</button>
</div>
<div class='card'><h2>🛑 电机</h2>
<button class='primary' onclick="motorCtrl('enable')">🔓 解锁</button>
<button class='danger' onclick="motorCtrl('disable')">🔒 锁定</button>
<button onclick="motorCtrl('forward')">⬆ 前进</button>
<button onclick="motorCtrl('backward')">⬇ 后退</button>
<button onclick="motorCtrl('left')">⬅ 左转</button>
<button onclick="motorCtrl('right')">➡ 右转</button>
<button onclick="motorCtrl('stop')">⏹ 停止</button>
<div id='motorStatus' class='status' style='margin-top:8px;'>电机: 加载中...</div>
</div>
<div class='card'><h2>📥 数据导出</h2>
<div style='display:flex;flex-wrap:wrap;gap:5px;'>
<button class='download' onclick="downloadFile('/download/history')">📊 历史CSV</button>
<button class='download' onclick="downloadFile('/download/all')">📦 全部数据</button>
<button class='primary' onclick="downloadCurrentPopulation()">🧬 当前种群基因</button>
<button class='download' onclick="downloadFile('/download/current-evolution')">📈 进化数据</button>
<button onclick="listFiles()">📋 列出文件</button>
</div>
<div id='downloadGenArea' style='margin-top:8px;display:flex;align-items:center;gap:8px;flex-wrap:wrap;'>
<span style='font-size:12px;color:#8b949e;'>下载指定代数基因:</span>
<input type='number' id='genInput' value='1' min='1' max='99'>
<button class='download' onclick="downloadGenPopulation()">📥 下载</button>
<span style='font-size:11px;color:#8b949e;' id='genStatus'></span>
</div>
<div id='fileList' style='font-size:11px;font-family:monospace;max-height:150px;overflow-y:auto;background:#0d1117;padding:8px;border-radius:4px;margin-top:8px;'>点击"列出文件"查看SPIFFS内容</div>
</div>
<div class='card'><h2>⚙️ 系统</h2>
<div id='versionInfo' style='font-size:12px;color:#8b949e;margin-bottom:8px;'></div>
<button onclick="if(confirm('确认重置?')){api('/reset')}">🗑 重置</button>
<button onclick="if(confirm('清理数据?')){api('/admin/clean')}">🧹 清理</button>
</div>
<script>
function api(url){fetch(url).then(r=>r.json()).then(d=>console.log(d)).catch(e=>console.error(e));}
function motorCtrl(a){fetch('/motor?action='+a).then(r=>r.json()).then(d=>{document.getElementById('motorStatus').innerHTML='电机: '+d.status;});}
function downloadFile(url){
    fetch(url).then(r=>{if(!r.ok)throw new Error('下载失败');return r.blob();})
    .then(blob=>{const a=document.createElement('a');a.href=URL.createObjectURL(blob);a.download=url.split('/').pop()||'download';document.body.appendChild(a);a.click();document.body.removeChild(a);URL.revokeObjectURL(a.href);})
    .catch(e=>alert('下载失败: '+e.message));
}
function downloadCurrentPopulation(){
    document.getElementById('genStatus').innerText='下载中...';
    fetch('/download/current-population').then(r=>{if(!r.ok)throw new Error('文件不存在');return r.blob();})
    .then(blob=>{const a=document.createElement('a');a.href=URL.createObjectURL(blob);a.download='pop_current_gen.bin';document.body.appendChild(a);a.click();document.body.removeChild(a);URL.revokeObjectURL(a.href);document.getElementById('genStatus').innerText='✅ 完成';})
    .catch(e=>{document.getElementById('genStatus').innerText='❌ '+e.message;alert('下载失败: '+e.message);});
}
function downloadGenPopulation(){
    const gen=document.getElementById('genInput').value;
    if(!gen||gen<1){alert('请输入有效代数');return;}
    document.getElementById('genStatus').innerText='下载中...';
    fetch('/download/pop?gen='+gen).then(r=>{if(!r.ok)throw new Error('文件不存在');return r.blob();})
    .then(blob=>{const a=document.createElement('a');a.href=URL.createObjectURL(blob);a.download='pop_gen_'+gen+'.bin';document.body.appendChild(a);a.click();document.body.removeChild(a);URL.revokeObjectURL(a.href);document.getElementById('genStatus').innerText='✅ 完成';})
    .catch(e=>{document.getElementById('genStatus').innerText='❌ '+e.message;alert('下载失败: '+e.message);});
}
function listFiles(){
    fetch('/list/files').then(r=>r.json()).then(d=>{
        let h='';if(d.files){d.files.forEach(f=>{h+='<div style=\"color:#58a6ff;\">📄 '+f+'</div>';});}
        document.getElementById('fileList').innerHTML=h||'<span style="color:#8b949e;">无文件</span>';
    });
}
setInterval(function(){
fetch('/status').then(r=>r.json()).then(d=>{
document.getElementById('status').innerHTML=
'代数: <span class=val>'+d.generation+'</span><br>'+
'个体: <span class=val>'+(d.individual+1)+'/'+d.population+'</span><br>'+
'新奇度: <span class=high>'+d.novelty.toFixed(4)+'</span><br>'+
'规则数: <span class=val>'+d.ruleCount+'</span><br>'+
'⚡ 卡死: '+(d.stuckFlag?'<span class=warn>⚠️ 卡死中!</span>':'<span class=high>✅ 正常</span>')+
'<br>🔄 脱困: '+(d.escapeActive?'<span class=warn>🔄 执行中</span>':'<span class=val>⏸ 空闲</span>')+
'<br>编码器差值: <span class=val>'+d.encoderDiff+' (阈值50)</span>'+
'<br>L: <span class=val>'+d.leftTicks+'</span> R: <span class=val>'+d.rightTicks+'</span>'+
'<br>存活: <span class=val>'+d.survival+'ms</span><br>'+
'距离: <span class=val>'+d.distance+'</span><br>'+
'电机: '+(d.motorEnabled?'<span class=high>🔓 已解锁</span>':'<span class=warn>🔒 已锁定</span>');
});
fetch('/archive').then(r=>r.json()).then(d=>{
document.getElementById('archive').innerHTML='档案大小: <span class=high>'+d.size+'</span><br>最佳新奇度: <span class=high>'+d.bestNovelty.toFixed(4)+'</span>';
});
fetch('/experiment/status').then(r=>r.json()).then(d=>{
document.getElementById('experiment').innerHTML=
'实验: '+(d.experimentActive?'<span class=high>🟢 运行中</span>':'<span class=warn>⏸ 未开始</span>')+
'<br>代数: <span class=val>'+d.currentGeneration+'/'+d.maxGenerations+'</span>'+
'<br>进度: <span class=high>'+(d.progress*100).toFixed(1)+'%</span>';
});
fetch('/version').then(r=>r.json()).then(d=>{
document.getElementById('versionInfo').innerHTML='固件: <span class=val>'+d.firmwareVersion+'</span> | 文件: '+d.filesCount;
});
},500);
</script>
</body></html>)rawliteral";
        server.send(200, "text/html", html);
    }

    static void handleStatus() {
        Gene& g = EvolutionEngine::getCurrentGene();
        String json = "{";
        json += "\"generation\":" + String(EvolutionEngine::getGeneration()) + ",";
        json += "\"individual\":" + String(EvolutionEngine::getIndividual()) + ",";
        json += "\"population\":" + String(POPULATION_SIZE) + ",";
        json += "\"novelty\":" + String(g.noveltyScore, 4) + ",";
        json += "\"ruleCount\":" + String(g.ruleCount) + ",";
        json += "\"survival\":" + String(millis() - EvolutionEngine::getTestStartTime()) + ",";
        json += "\"distance\":" + String(MotorController::getDistanceTicks()) + ",";
        json += "\"mutationRate\":" + String(EvolutionEngine::getMutationRate(), 2) + ",";
        json += "\"motorEnabled\":" + String(MotorController::isMotorEnabled() ? "true" : "false") + ",";
        json += "\"actionInProgress\":" + String(MotorController::isActionInProgress() ? "true" : "false") + ",";
        json += "\"storageReady\":" + String(RobustStorage::isReady() ? "true" : "false") + ",";
        json += "\"sensorLeft\":" + String(SensorCalibration::getLeftRaw()) + ",";
        json += "\"sensorRight\":" + String(SensorCalibration::getRightRaw()) + ",";
        json += "\"leftTicks\":" + String(MotorController::getLeftTicks()) + ",";
        json += "\"rightTicks\":" + String(MotorController::getRightTicks()) + ",";
        json += "\"encoderDiff\":" + String(MotorController::getEncoderDiff()) + ",";
        json += "\"stuckFlag\":" + String(MotorController::isStuck() ? "true" : "false") + ",";
        json += "\"escapeActive\":" + String(MotorController::isEscapeActive() ? "true" : "false");
        json += "}";
        server.send(200, "application/json", json);
    }

    static void handleArchive() {
        String json = "{";
        json += "\"size\":" + String(EvolutionEngine::getArchiveSize()) + ",";
        json += "\"bestNovelty\":" + String(EvolutionEngine::getBestNoveltyEver(), 4);
        json += "}";
        server.send(200, "application/json", json);
    }

    static void handleEvolution() {
        if (!server.hasArg("action")) { server.send(400, "{}"); return; }
        String action = server.arg("action");
        if (action == "start") {
            if (GeneStorage::isExperimentComplete()) {
                GeneStorage::startNewExperiment();
                EvolutionEngine::init();
            }
            EvolutionEngine::startCurrentTest();
            server.send(200, "application/json", "{\"status\":\"started\"}");
        } else if (action == "stop") {
            EvolutionEngine::endCurrentTest();
            MotorController::stopMotors();
            server.send(200, "application/json", "{\"status\":\"stopped\"}");
        } else if (action == "next") {
            EvolutionEngine::nextIndividual();
            server.send(200, "application/json", "{\"status\":\"next\"}");
        } else {
            server.send(400, "{}");
        }
    }

    static void handleMotor() {
        if (!server.hasArg("action")) { server.send(400, "{}"); return; }
        String action = server.arg("action");
        String status = "ok";
        if (action == "enable") { MotorController::enableMotor(); status = "已解锁"; }
        else if (action == "disable") { MotorController::disableMotor(); status = "已锁定"; }
        else if (action == "stop") { MotorController::forceStopAction(); MotorController::stopMotors(); status = "已停止"; }
        else if (action == "forward") { MotorController::enableMotor(); MotorController::startPhysicsAction(150, 150, 100); status = "前进中"; }
        else if (action == "backward") { MotorController::enableMotor(); MotorController::startPhysicsAction(-150, -150, 100); status = "后退中"; }
        else if (action == "left") { MotorController::enableMotor(); MotorController::startPhysicsAction(-120, 120, 100); status = "左转中"; }
        else if (action == "right") { MotorController::enableMotor(); MotorController::startPhysicsAction(120, -120, 100); status = "右转中"; }
        else { server.send(400, "{}"); return; }
        server.send(200, "application/json", "{\"status\":\"" + status + "\"}");
    }

    static void handleReset() { server.send(200, "{}"); delay(500); ESP.restart(); }
    static void handleAdminClean() { FirmwareVersionManager::cleanAllData(); server.send(200, "{}"); }
    static void handleExperimentStatus() {
        String json = "{";
        json += "\"experimentActive\":" + String(GeneStorage::isExperimentActive() ? "true" : "false") + ",";
        json += "\"currentGeneration\":" + String(GeneStorage::getCurrentGeneration()) + ",";
        json += "\"maxGenerations\":" + String(GeneStorage::getMaxGenerations()) + ",";
        json += "\"progress\":" + String(GeneStorage::getProgress(), 3) + ",";
        json += "\"complete\":" + String(GeneStorage::isExperimentComplete() ? "true" : "false");
        json += "}";
        server.send(200, "application/json", json);
    }

    static void handleVersion() {
        String json = "{\"firmwareVersion\":\"" + String(FIRMWARE_VERSION) + "\",\"filesCount\":" + String(getFileCount()) + "}";
        server.send(200, "application/json", json);
    }

    static void handleDownloadHistory() {
        String data = RobustStorage::getCSVData();
        server.sendHeader("Content-Type", "text/csv");
        server.sendHeader("Content-Disposition", "attachment; filename=oe_history.csv");
        server.send(200, "text/csv", data);
    }

    static void handleDownloadAll() {
        String data = "=== 进化历史 ===\n" + RobustStorage::getCSVData();
        server.sendHeader("Content-Type", "text/csv");
        server.sendHeader("Content-Disposition", "attachment; filename=all_data.csv");
        server.send(200, "text/csv", data);
    }

    static void handleDownloadPopulation() {
        if (!server.hasArg("gen")) {
            server.send(400, "application/json", "{\"error\":\"需要 gen 参数\"}");
            return;
        }
        uint32_t gen = server.arg("gen").toInt();
        if (gen < 1) { server.send(400, "application/json", "{\"error\":\"代数必须 >= 1\"}"); return; }
        
        String path = "/pop_gen_" + String(gen) + ".bin";
        if (!RobustStorage::isReady()) {
            server.send(500, "application/json", "{\"error\":\"SPIFFS不可用\"}");
            return;
        }
        File file = SPIFFS.open(path, FILE_READ);
        if (!file) {
            server.send(404, "application/json", "{\"error\":\"文件不存在: " + path + "\"}");
            return;
        }
        server.sendHeader("Content-Type", "application/octet-stream");
        server.sendHeader("Content-Disposition", "attachment; filename=" + path.substring(1));
        server.streamFile(file, "application/octet-stream");
        file.close();
    }

    static void handleDownloadCurrentPopulation() {
        uint32_t gen = EvolutionEngine::getGeneration();
        if (gen == 0) gen = 1;
        String path = "/pop_gen_" + String(gen) + ".bin";
        if (!RobustStorage::isReady()) {
            server.send(500, "application/json", "{\"error\":\"SPIFFS不可用\"}");
            return;
        }
        if (!SPIFFS.exists(path)) {
            for (uint32_t g = gen; g > 0; g--) {
                String testPath = "/pop_gen_" + String(g) + ".bin";
                if (SPIFFS.exists(testPath)) { path = testPath; break; }
            }
            if (!SPIFFS.exists(path)) {
                for (uint32_t g = 1; g <= gen; g++) {
                    String testPath = "/pop_gen_" + String(g) + ".bin";
                    if (SPIFFS.exists(testPath)) { path = testPath; break; }
                }
            }
        }
        File file = SPIFFS.open(path, FILE_READ);
        if (!file) {
            server.send(404, "application/json", "{\"error\":\"种群文件不存在\"}");
            return;
        }
        server.sendHeader("Content-Type", "application/octet-stream");
        server.sendHeader("Content-Disposition", "attachment; filename=" + path.substring(1));
        server.streamFile(file, "application/octet-stream");
        file.close();
    }

    static void handleDownloadCurrentEvolution() {
        String data = "";
        data += "========================================\n";
        data += "  进化小车数据导出 (v8.9-chaos-v4)\n";
        data += "  导出时间: " + String(millis() / 1000) + "s\n";
        data += "========================================\n\n";
        
        data += "=== 系统信息 ===\n";
        data += "固件版本: " + String(FIRMWARE_VERSION) + "\n";
        data += "SPIFFS状态: " + String(RobustStorage::isReady() ? "已挂载" : "未挂载") + "\n";
        data += "进化代数: " + String(EvolutionEngine::getGeneration()) + "\n";
        data += "当前个体: " + String(EvolutionEngine::getIndividual() + 1) + "/" + String(POPULATION_SIZE) + "\n";
        data += "变异率: " + String(EvolutionEngine::getMutationRate(), 2) + "\n";
        data += "最佳新奇度: " + String(EvolutionEngine::getBestNoveltyEver(), 4) + "\n";
        data += "档案大小: " + String(EvolutionEngine::getArchiveSize()) + "\n";
        data += "卡死检测: 差值>50 或 单轮卡死\n\n";
        
        Gene& g = EvolutionEngine::getCurrentGene();
        data += "=== 当前个体基因 ===\n";
        data += "规则数: " + String(g.ruleCount) + "\n";
        data += "存活时间: " + String(g.survival_time) + "ms\n";
        data += "行驶距离: " + String(g.distance_ticks) + " ticks\n";
        data += "新奇度: " + String(g.noveltyScore, 6) + "\n\n";
        
        data += "=== 编码器状态 ===\n";
        data += "左编码器: " + String(MotorController::getLeftTicks()) + "\n";
        data += "右编码器: " + String(MotorController::getRightTicks()) + "\n";
        data += "编码器差值: " + String(MotorController::getEncoderDiff()) + "\n";
        data += "卡死状态: " + String(MotorController::isStuck() ? "卡死中" : "正常") + "\n";
        data += "脱困状态: " + String(MotorController::isEscapeActive() ? "脱困中" : "空闲") + "\n\n";
        
        data += "=== 历史数据 ===\n";
        data += RobustStorage::getCSVData();
        
        data += "\n=== SPIFFS文件列表 ===\n";
        if (RobustStorage::isReady()) {
            File root = SPIFFS.open("/");
            if (root) {
                while (File file = root.openNextFile()) {
                    data += String(file.name()) + " (" + String(file.size()) + " 字节)\n";
                }
                root.close();
            }
        }
        
        server.sendHeader("Content-Type", "text/plain");
        server.sendHeader("Content-Disposition", "attachment; filename=evolution_data.txt");
        server.send(200, "text/plain", data);
    }

    static void handleListFiles() {
        String json = "{\"files\":[";
        if (RobustStorage::isReady()) {
            File root = SPIFFS.open("/");
            bool first = true;
            while (File f = root.openNextFile()) {
                if (!first) json += ",";
                json += "\"" + String(f.name()) + "\"";
                first = false;
            }
            root.close();
        }
        json += "]}";
        server.send(200, "application/json", json);
    }

    static int getFileCount() {
        if (!RobustStorage::isReady()) return 0;
        File root = SPIFFS.open("/");
        int c = 0;
        while (File f = root.openNextFile()) { c++; }
        root.close();
        return c;
    }

    static void handleNotFound() { server.send(404, "{}"); }
};

WebServer CarWebServer::server(80);

// ================================================================
// WiFi 初始化
// ================================================================
static bool wifiInitialized = false;
static bool wifiReady = false;

void initWiFi() {
    if (wifiInitialized) return;
    wifiInitialized = true;
    WiFi.mode(WIFI_AP);
    if (WiFi.softAP(WIFI_SSID, WIFI_PASSWORD)) {
        wifiReady = true;
        Logger::logf("WiFi AP: %s", WIFI_SSID);
        Logger::logf("IP: %s", WiFi.softAPIP().toString().c_str());
        CarWebServer::init();
    }
}

// ================================================================
// setup()
// ================================================================
void setup() {
    Serial.begin(115200);
    delay(1000);

    Logger::log("========================================");
    Logger::logf("  🧬 进化小车 %s", FIRMWARE_VERSION);
    Logger::log("  (双模式卡死检测 + 完整Web下载)");
    Logger::log("========================================");

    RobustStorage::init();
    if (FirmwareVersionManager::isNewVersion()) {
        FirmwareVersionManager::cleanAllData();
    }

    GeneStorage::init();
    if (GeneStorage::shouldStartNewExperiment()) {
        GeneStorage::startNewExperiment();
    }

    pinMode(PIN_NOISE_SOURCE, INPUT);
    randomSeed(SensorCalibration::readNoise());

    SensorCalibration::calibrate();
    MotorController::init();
    EvolutionEngine::init();

    Logger::log("========================================");
    Logger::logf("  ✅ 就绪 (%s)", FIRMWARE_VERSION);
    Logger::log("  📡 WiFi: CarLogger / 12345678");
    Logger::log("  🌐 http://192.168.4.1");
    Logger::log("  🔄 双模式卡死检测:");
    Logger::log("     - 差值 > 50 持续增大 1秒");
    Logger::log("     - 单轮卡死 持续 1秒");
    Logger::log("========================================");
}

// ================================================================
// loop()
// ================================================================
void loop() {
    if (!wifiInitialized) initWiFi();

    MotorController::updatePhysicsAction();

    if (EvolutionEngine::isTestActive()) {
        Gene& gene = EvolutionEngine::getCurrentGene();
        MotorController::update(gene);
        if (millis() - EvolutionEngine::getTestStartTime() > TEST_DURATION_MS) {
            EvolutionEngine::endCurrentTest();
            EvolutionEngine::nextIndividual();
        }
    }

    if (wifiReady) CarWebServer::handleClient();

    if (EvolutionEngine::getPendingTransition()) {
        EvolutionEngine::clearPendingTransition();
        EvolutionEngine::nextIndividual();
    }

    RobustStorage::tick();
    delay(LOOP_DELAY_MS);
}
/* ================================================================
 * 【v8.9-chaos 新增内容总结】
 * ================================================================
 * 
 * 1. enum CondType 增加 COND_STUCK=8, COND_ESCAPE=9
 * 
 * 2. MotorController 增加静态变量:
 *    - stuckFlag, stuckCounter, escapeActive, lastSensorSum, lastSpeedSum
 *    - 类外定义确保链接正确
 * 
 * 3. MotorController::update() 增加卡死检测逻辑:
 *    - 轮子转(速度>50) 且 传感器变化小(<30) 持续50帧 → stuckFlag=true
 * 
 * 4. Gene::evaluateCondition() 支持 COND_STUCK 和 COND_ESCAPE
 * 
 * 5. 规则触发时管理 escapeActive 状态
 * 
 * 6. 种子个体包含混沌脱困规则:
 *    - 规则3: COND_STUCK → 后退右转脱困 (nextRule=4)
 *    - 规则4: COND_ESCAPE → 清除状态
 *    - 规则5: COND_ALWAYS → 兜底前进
 * 
 * 7. Web界面显示卡死/脱困状态
 * 
 * 8. MotorController::stopMotors() 重置卡死状态
 * 
 * ================================================================
 * 【硬件初始化失败根因修复】
 * ================================================================
 * 
 * 问题: 静态成员变量在类中声明但未在类外定义
 * 修复: 在文件末尾为所有静态成员提供定义
 * 位置: MotorController 静态变量定义区域
 * 
 * ================================================================ */
/*
 * ================================================================
 * 【Python 解析二进制数据的方法】
 * ================================================================
 * 
 * 将以下代码保存为 parse_evolution_data.py，与数据文件放在同一目录。
 * 
 * ================================================================
 * 使用方法：
 *   1. 通过Web下载 /pop_gen_1.bin, /frm_1_i0.bin 等文件
 *   2. 将文件放在脚本同级目录
 *   3. 运行：python parse_evolution_data.py
 * 
 * ================================================================
 * 
 * import struct
 * import pandas as pd
 * import os
 * import glob
 * 
 * # ---- 解析种群快照 ----
 * def parse_population(filepath):
 *     with open(filepath, 'rb') as f:
 *         data = f.read()
 *     
 *     ptr = 0
 *     magic, = struct.unpack('<I', data[ptr:ptr+4]); ptr += 4
 *     if magic != 0x47454E45:
 *         raise ValueError(f"无效魔数: {hex(magic)}")
 *     
 *     version, = struct.unpack('<H', data[ptr:ptr+2]); ptr += 2
 *     pop_size, = struct.unpack('<H', data[ptr:ptr+2]); ptr += 2
 *     generation, = struct.unpack('<I', data[ptr:ptr+4]); ptr += 4
 *     exp_id, = struct.unpack('<I', data[ptr:ptr+4]); ptr += 4
 *     
 *     individuals = []
 *     for i in range(pop_size):
 *         rule_count = data[ptr]; ptr += 1
 *         rules = []
 *         for j in range(rule_count):
 *             cond_type = data[ptr]; ptr += 1
 *             cond_value, = struct.unpack('<h', data[ptr:ptr+2]); ptr += 2
 *             cond_op = data[ptr]; ptr += 1
 *             motor_l, = struct.unpack('<h', data[ptr:ptr+2]); ptr += 2
 *             motor_r, = struct.unpack('<h', data[ptr:ptr+2]); ptr += 2
 *             duration_ms, = struct.unpack('<H', data[ptr:ptr+2]); ptr += 2
 *             next_rule = data[ptr]; ptr += 1
 *             ptr += 1  # padding
 *             rules.append({
 *                 'condType': cond_type, 'condValue': cond_value, 'condOp': cond_op,
 *                 'motorL': motor_l, 'motorR': motor_r,
 *                 'durationMs': duration_ms, 'nextRule': next_rule
 *             })
 *         survival_time, = struct.unpack('<I', data[ptr:ptr+4]); ptr += 4
 *         distance, = struct.unpack('<i', data[ptr:ptr+4]); ptr += 4
 *         novelty, = struct.unpack('<f', data[ptr:ptr+4]); ptr += 4
 *         
 *         individuals.append({
 *             'ruleCount': rule_count,
 *             'rules': rules,
 *             'survivalTime': survival_time,
 *             'distance': distance,
 *             'noveltyScore': novelty
 *         })
 *     
 *     return {
 *         'version': version,
 *         'generation': generation,
 *         'experimentId': exp_id,
 *         'populationSize': pop_size,
 *         'individuals': individuals
 *     }
 * 
 * # ---- 解析帧日志 ----
 * def parse_frame_log(filepath):
 *     frame_size = 11
 *     with open(filepath, 'rb') as f:
 *         data = f.read()
 *     
 *     num_frames = len(data) // frame_size
 *     frames = []
 *     
 *     for i in range(num_frames):
 *         offset = i * frame_size
 *         ts, = struct.unpack('<I', data[offset:offset+4])
 *         s_l, = struct.unpack('<h', data[offset+4:offset+6])
 *         s_r, = struct.unpack('<h', data[offset+6:offset+8])
 *         m_l = data[offset+8]
 *         m_r = data[offset+9]
 *         dir_byte = data[offset+10]
 *         
 *         frames.append({
 *             'timestamp_ms': ts,
 *             'sensorLeft': s_l,
 *             'sensorRight': s_r,
 *             'motorLeftPWM': m_l,
 *             'motorRightPWM': m_r,
 *             'dirL': (dir_byte >> 0) & 1,
 *             'dirR': (dir_byte >> 1) & 1
 *         })
 *     
 *     return pd.DataFrame(frames)
 * 
 * # ---- 使用示例 ----
 * if __name__ == "__main__":
 *     # 解析种群
 *     pop = parse_population("pop_gen_1.bin")
 *     print(f"代数: {pop['generation']}, 个体数: {pop['populationSize']}")
 *     
 *     for i, ind in enumerate(pop['individuals'][:3]):
 *         print(f"个体{i}: 规则数={ind['ruleCount']}, 新奇度={ind['noveltyScore']:.4f}")
 *     
 *     # 解析帧日志
 *     df = parse_frame_log("frm_1_i0.bin")
 *     print(f"\n帧日志: {len(df)}帧")
 *     print(df.head(10))
 *     
 *     # 可选：保存为CSV
 *     # df.to_csv("frm_1_i0.csv", index=False)
 * 
 * ================================================================
 */